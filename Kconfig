## components/esp_driver_spi/Kconfig
```kconfig
menu "ESP-驱动：SPI 配置"
    depends on SOC_GPSPI_SUPPORTED
    config SPI_MASTER_IN_IRAM
        bool "将 SPI 主机的传输功能放入 IRAM"
        default n
        depends on !FREERTOS_PLACE_FUNCTIONS_INTO_FLASH
        select SPI_MASTER_ISR_IN_IRAM
        select ESP_SPI_BUS_LOCK_FUNCS_IN_IRAM
        help
            通常只有 SPI 主机的 ISR 被放置在 IRAM 中，以便在触发中断时可以在没有闪存的情况下工作。
            对于其他功能，在 SPI 功能内部和外部运行时可能会出现闪存缓存未命中的情况，这可能会增加 SPI 事务的间隔。
            启用此选项可将 ``queue_trans``、``get_trans_result`` 和 ``transmit`` 函数放入 IRAM，以避免可能的缓存未命中。

            如果启用了 `CONFIG_FREERTOS_PLACE_FUNCTIONS_INTO_FLASH`，则此配置将不可用。

            在单元测试期间，启用此选项以测量 API 的理想情况。

    config SPI_MASTER_ISR_IN_IRAM
        bool "将 SPI 主机 ISR 函数放入 IRAM"
        default y
        depends on !HEAP_PLACE_FUNCTION_INTO_FLASH
        select PERIPH_CTRL_FUNC_IN_IRAM
        select HAL_SPI_MASTER_FUNC_IN_IRAM
        select ESP_SPI_BUS_LOCK_ISR_FUNCS_IN_IRAM
        select GDMA_CTRL_FUNC_IN_IRAM if SOC_GDMA_SUPPORTED
        help
            将 SPI 主机 ISR 放入 IRAM 以避免可能的缓存未命中。

            只有在禁用 HEAP_PLACE_FUNCTION_INTO_FLASH 时才能启用此配置，因为 SPI 主机使用可以使用堆组件 API 将事务缓冲区分配到 DMA 内存部分，而该 API 必须放置在 IRAM 中。

            此外，您可以在初始化驱动程序时添加 ESP_INTR_FLAG_IRAM，以禁止在闪存写入访问期间禁用 ISR。

    config SPI_SLAVE_IN_IRAM
        bool "将 SPI 从机的传输功能放入 IRAM"
        default n
        select SPI_SLAVE_ISR_IN_IRAM
        help
            通常只有 SPI 从机的 ISR 被放置在 IRAM 中，以便在触发中断时可以在没有闪存的情况下工作。
            对于其他功能，在 SPI 功能内部和外部运行时可能会出现闪存缓存未命中的情况，这可能会增加 SPI 事务的间隔。
            启用此选项可将 ``queue_trans``、``get_trans_result`` 和 ``transmit`` 函数放入 IRAM，以避免可能的缓存未命中。

    config SPI_SLAVE_ISR_IN_IRAM
        bool "将 SPI 从机 ISR 函数放入 IRAM"
        default y
        select PERIPH_CTRL_FUNC_IN_IRAM
        select HAL_SPI_SLAVE_FUNC_IN_IRAM
        help
            将 SPI 从机 ISR 放入 IRAM 以避免可能的缓存未命中。

            此外，您可以在初始化驱动程序时添加 ESP_INTR_FLAG_IRAM，以禁止在闪存写入访问期间禁用 ISR。

endmenu # SPI Configuration
```

## components/esp_driver_touch_sens/Kconfig
```kconfig
menu "ESP-驱动：触摸传感器配置"
    depends on SOC_TOUCH_SENSOR_SUPPORTED
    config TOUCH_CTRL_FUNC_IN_IRAM
        bool "将触摸传感器控制函数放入 IRAM"
        default n
        help
            将触摸传感器单次扫描和连续扫描函数放入 IRAM，
            以便这些函数可以在 IRAM 中安全运行，并能够在闪存缓存禁用时被调用。
            启用此选项还可以提高驱动程序性能。

    config TOUCH_ISR_IRAM_SAFE
        bool "触摸传感器 ISR IRAM 安全"
        default n
        help
            通过允许中断处理程序在缓存禁用时（例如 SPI Flash 写入）可执行，
            确保触摸传感器中断是 IRAM 安全的。

    config TOUCH_ENABLE_DEBUG_LOG
        bool "启用调试日志"
        default n
        help
            是否为触摸驱动程序启用调试日志消息。
            注意，此选项仅控制触摸驱动程序日志，不会影响其他驱动程序。

endmenu # Touch Sensor Configuration
```
