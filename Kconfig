## components/bt/Kconfig
```kconfig
menu "蓝牙"

    config BT_ENABLED
        bool "蓝牙"
        depends on !APP_NO_BLOBS
        help
            选择此选项以启用蓝牙并显示包含蓝牙配置选项的子菜单。

    choice BT_HOST
        prompt "主机"
        depends on BT_ENABLED
        default BT_BLUEDROID_ENABLED
        help
            这有助于选择蓝牙主机协议栈

        config BT_BLUEDROID_ENABLED
            bool "Bluedroid - 双模式"
            help
                对于经典蓝牙或双模式用例，推荐使用此选项

        config BT_NIMBLE_ENABLED
            bool "NimBLE - 仅BLE"
            help
                对于仅BLE用例，推荐使用此选项以节省内存

        config BT_CONTROLLER_ONLY
            depends on SOC_BT_SUPPORTED
            bool "禁用"
            help
                当您想直接与控制器通信（无需任何主机）或使用Espressif不支持的任何其他主机协议栈（此处未提及）时，推荐使用此选项。

    endchoice

    choice BT_CONTROLLER
        prompt "控制器"
        depends on BT_ENABLED
        default BT_CONTROLLER_ENABLED
        help
            这有助于选择蓝牙控制器协议栈

        config BT_CONTROLLER_ENABLED
            depends on SOC_BT_SUPPORTED
            bool "启用"
            help
                对于蓝牙控制器用例，推荐使用此选项

        config BT_CONTROLLER_DISABLED
            bool "禁用"
            help
                对于仅蓝牙主机用例，推荐使用此选项

    endchoice

    menu "Bluedroid 选项"
        depends on BT_BLUEDROID_ENABLED
        source "$IDF_PATH/components/bt/host/bluedroid/Kconfig.in"
    endmenu

    menu "NimBLE 选项"
        depends on BT_NIMBLE_ENABLED
        source "$IDF_PATH/components/bt/host/nimble/Kconfig.in"
    endmenu

    menu "控制器选项"
        depends on BT_CONTROLLER_ENABLED
        source "$IDF_PATH/components/bt/controller/$IDF_TARGET/Kconfig.in"
    endmenu

    config BT_RELEASE_IRAM
        depends on BT_ENABLED && BT_LE_RELEASE_IRAM_SUPPORTED
        bool "释放蓝牙文本（请先阅读文档）"
        default n
        help
            此选项在调用esp_bt_mem_release时释放蓝牙文本部分，并将蓝牙数据、bss和文本合并到一个大的空闲堆区域中，总共节省约21kB或更多的IRAM。
            ESP32-C2只有3个可配置的PMP条目可用，其余的是硬编码的。
            我们无法将内存分成3个不同的区域（IRAM、BLE-IRAM、DRAM）。
            因此，此选项将禁用PMP（ESP_SYSTEM_PMP_IDRAM_SPLIT）

    menu "通用选项"
        visible if (BT_BLUEDROID_ENABLED || BT_NIMBLE_ENABLED)

        source "$IDF_PATH/components/bt/common/Kconfig.in"
    endmenu

    config BT_HCI_LOG_DEBUG_EN
        depends on BT_BLUEDROID_ENABLED || BT_NIMBLE_ENABLED
        bool "启用蓝牙HCI调试模式"
        default n
        help
            此选项用于启用蓝牙调试模式，保存HCI层数据流。

    config BT_HCI_LOG_DATA_BUFFER_SIZE
        depends on BT_HCI_LOG_DEBUG_EN
        int "蓝牙HCI调试模式下用于HCI数据的缓存大小（N*1024字节）"
        range 1 100
        default 5
        help
            此选项用于配置HCI调试模式下HCI数据流缓存的缓冲区大小。
            这是一个环形缓冲区，如果缓冲区已满，新数据将覆盖最旧的数据。

    config BT_HCI_LOG_ADV_BUFFER_SIZE
        depends on BT_HCI_LOG_DEBUG_EN
        int "蓝牙HCI调试模式下用于广告报告的缓存大小（N*1024字节）"
        range 1 100
        default 8
        help
            此选项用于配置HCI调试模式下HCI广告报告缓存的缓冲区大小。
            这是一个环形缓冲区，如果缓冲区已满，新数据将覆盖最旧的数据。

endmenu

menuconfig BLE_MESH
    bool "ESP BLE Mesh 支持"
    depends on BT_ENABLED
    help
        此选项启用ESP BLE Mesh支持。可用的具体功能可能取决于堆栈中启用的其他功能，
        如蓝牙支持、Bluedroid支持和GATT支持。

source "$IDF_PATH/components/bt/esp_ble_mesh/Kconfig.in"
```

## components/console/Kconfig
```kconfig
menu "控制台库"

    config CONSOLE_SORTED_HELP
        bool "启用排序帮助"
        default n
        help
            如果启用此选项，帮助命令将按排序顺序列出可用命令，
            而不是按照注册顺序列出命令。

endmenu
```

## components/driver/Kconfig
```kconfig
menu "驱动程序配置"

    orsource "./twai/Kconfig.twai"

    menu "传统 ADC 驱动程序配置"

        config ADC_DISABLE_DAC
            depends on SOC_DAC_SUPPORTED
            bool "当 ADC2 在 GPIO 25 和 26 上使用时禁用 DAC"
            default y
            help
                如果设置此项，ADC2 驱动程序将禁用与指定通道对应的 DAC 输出。这是默认值。

                为了测试，禁用此选项，以便我们可以通过内部 ADC 测量 DAC 的输出。

        config ADC_SUPPRESS_DEPRECATE_WARN
            bool "抑制传统驱动程序弃用警告"
            default n
            help
                是否在使用传统 adc 驱动程序（driver/adc.h）时抑制弃用警告。
                如果您想继续使用传统驱动程序，并且不想看到相关的弃用警告，
                您可以启用此选项。

        menu "传统 ADC 校准配置"

            config ADC_CAL_EFUSE_TP_ENABLE
                depends on IDF_TARGET_ESP32
                bool "使用两点值"
                default "y"
                help
                    一些 ESP32 在 eFuse BLOCK3 中烧录了两点校准值。
                    如果可用，此选项将允许 ADC 校准组件使用两点值来表征
                    ADC-电压曲线。

            config ADC_CAL_EFUSE_VREF_ENABLE
                depends on IDF_TARGET_ESP32
                bool "使用 eFuse Vref"
                default "y"
                help
                    一些 ESP32 在 eFuse BLOCK0 中烧录了 Vref。如果可用，此选项将允许
                    ADC 校准组件使用 eFuse Vref 来表征 ADC-电压曲线。

            config ADC_CAL_LUT_ENABLE
                depends on IDF_TARGET_ESP32
                bool "使用查找表"
                default "y"
                help
                    此选项将允许 ADC 校准组件使用查找表
                    来校正 11db 衰减中的非线性行为。其他衰减
                    不表现出非线性行为，因此不会受此选项影响。

            config ADC_CALI_SUPPRESS_DEPRECATE_WARN
                bool "抑制传统驱动程序弃用警告"
                default n
                help
                    是否在使用传统 adc 校准驱动程序（esp_adc_cal.h）时抑制弃用警告。
                    如果您想继续使用传统驱动程序，并且不想看到相关的
                    弃用警告，您可以启用此选项。

        endmenu # Legacy ADC Calibration Configuration
    endmenu  # Legacy ADC Driver Configuration

    menu "传统 DAC 驱动程序配置"
        depends on SOC_DAC_SUPPORTED
        config DAC_SUPPRESS_DEPRECATE_WARN
            bool "抑制传统驱动程序弃用警告"
            default n
            help
                是否在使用传统 dac 驱动程序（driver/dac.h）时抑制弃用警告。
                如果您想继续使用传统驱动程序，并且不想看到相关的弃用警告，
                您可以启用此选项。
    endmenu # Legacy DAC Driver Configurations

    menu "传统 MCPWM 驱动程序配置"
        depends on SOC_MCPWM_SUPPORTED
        config MCPWM_SUPPRESS_DEPRECATE_WARN
            bool "抑制传统驱动程序弃用警告"
            default n
            help
                是否在使用传统 MCPWM 驱动程序（driver/mcpwm.h）时抑制弃用警告。
                如果您想继续使用传统驱动程序，并且不想看到相关的弃用警告，
                您可以启用此选项。
    endmenu # Legacy MCPWM Driver Configurations

    menu "传统定时器组驱动程序配置"
        depends on SOC_GPTIMER_SUPPORTED
        config GPTIMER_SUPPRESS_DEPRECATE_WARN
            bool "抑制传统驱动程序弃用警告"
            default n
            help
                是否在使用传统定时器组驱动程序（driver/timer.h）时抑制弃用警告。
                如果您想继续使用传统驱动程序，并且不想看到相关的弃用警告，
                您可以启用此选项。

    endmenu # Legacy Timer Group Driver Configurations

    menu "传统 RMT 驱动程序配置"
        depends on SOC_RMT_SUPPORTED
        config RMT_SUPPRESS_DEPRECATE_WARN
            bool "抑制传统驱动程序弃用警告"
            default n
            help
                是否在使用传统 rmt 驱动程序（driver/rmt.h）时抑制弃用警告。
                如果您想继续使用传统驱动程序，并且不想看到相关的弃用警告，
                您可以启用此选项。
    endmenu # Legacy RMT Driver Configurations

    menu "传统 I2S 驱动程序配置"
        depends on SOC_I2S_SUPPORTED
        config I2S_SUPPRESS_DEPRECATE_WARN
            bool "抑制传统驱动程序弃用警告"
            default n
            help
                是否在使用传统 i2s 驱动程序（driver/i2s.h）时抑制弃用警告。
                如果您想继续使用传统驱动程序，并且不想看到相关的弃用警告，
                您可以启用此选项。
    endmenu # Legacy I2S Driver Configurationss

    menu "传统 PCNT 驱动程序配置"
        depends on SOC_PCNT_SUPPORTED
        config PCNT_SUPPRESS_DEPRECATE_WARN
            bool "抑制传统驱动程序弃用警告"
            default n
            help
                是否在使用传统 PCNT 驱动程序（driver/pcnt.h）时抑制弃用警告。
                如果您想继续使用传统驱动程序，并且不想看到相关的弃用警告，
                您可以启用此选项。
    endmenu # Legacy PCNT Driver Configurationss

    menu "传统 SDM 驱动程序配置"
        depends on SOC_SDM_SUPPORTED
        config SDM_SUPPRESS_DEPRECATE_WARN
            bool "抑制传统驱动程序弃用警告"
            default n
            help
                是否在使用传统 SDM 驱动程序（driver/sigmadelta.h）时抑制弃用警告。
                如果您想继续使用传统驱动程序，并且不想看到相关的弃用警告，
                您可以启用此选项。
    endmenu # Legacy SDM Driver Configurationss

    menu "传统温度传感器驱动程序配置"
        depends on SOC_TEMP_SENSOR_SUPPORTED
        config TEMP_SENSOR_SUPPRESS_DEPRECATE_WARN
            bool "抑制传统驱动程序弃用警告"
            default n
            help
                是否在使用传统温度传感器驱动程序（driver/temp_sensor.h）时抑制弃用警告。
                如果您想继续使用传统驱动程序，并且不想看到相关的弃用警告，
                您可以启用此选项。
    endmenu # Legacy Temperature Sensor Driver Configurationss

endmenu  # Driver configurations
```

## components/driver/twai/Kconfig.twai
```kconfig
menu "TWAI 配置"
    depends on SOC_TWAI_SUPPORTED

    config TWAI_ISR_IN_IRAM
        bool "将 TWAI ISR 函数放入 IRAM"
        default n
        help
            将 TWAI ISR 放入 IRAM。这将允许 ISR 避免缓存未命中，
            并且在缓存禁用时也能运行（例如写入 SPI Flash 时）。
            请注意，如果启用此选项：
            - 用户在安装驱动程序时还应在驱动程序配置结构中设置
              ESP_INTR_FLAG_IRAM（具体请参阅文档）。
            - 警报日志记录（即设置 TWAI_ALERT_AND_LOG 标志）将
              不起作用。

    config TWAI_ERRATA_FIX_BUS_OFF_REC
        bool "为总线关闭期间的 REC 变化添加软件解决方案"
        depends on IDF_TARGET_ESP32
        default y
        help
            当达到总线关闭条件时，REC 应该被驱动程序的 ISR 重置为 0
            并冻结（通过 LOM）。然而在 ESP32 上，存在一种边缘情况，
            即 REC 会在驱动程序的 ISR 来不及响应时增加（例如，由于
            总线错误的快速发生），从而导致总线关闭后 REC 不为零。
            非零 REC 可能会阻止总线关闭恢复，因为总线关闭恢复的条件
            是 TEC 和 REC 都变为 0。启用此选项将在驱动程序中添加一个
            解决方案，在达到总线关闭时强制将 REC 重置为零。

    config TWAI_ERRATA_FIX_TX_INTR_LOST
        bool "为 TX 中断丢失勘误添加软件解决方案"
        depends on IDF_TARGET_ESP32
        default y
        help
            在 ESP32 上，当发生发送中断，并且在同一 APB 时钟周期内
            读取中断寄存器时，发送中断可能会丢失。启用此选项将添加
            一个解决方案，通过检查发送缓冲区状态位来恢复任何丢失的
            发送中断。

    config TWAI_ERRATA_FIX_RX_FRAME_INVALID
        bool "为无效 RX 帧勘误添加软件解决方案"
        depends on IDF_TARGET_ESP32
        default y
        help
            在 ESP32 上，当接收数据或远程帧时，如果在数据或 CRC 字段
            发生总线错误，下一个接收帧的数据可能无效。启用此选项将
            添加一个解决方案，在检测到这种勘误条件时重置外设。请注意，
            如果在重置过程中在总线上发送了一个帧，该消息将不会被外设
            接收，在重置期间发送到总线上的消息将丢失。

    config TWAI_ERRATA_FIX_RX_FIFO_CORRUPT
        bool "为 RX FIFO 损坏勘误添加软件解决方案"
        depends on IDF_TARGET_ESP32
        default y
        help
            在 ESP32 上，当 RX FIFO 溢出且 RX 消息计数器达到最大值
            64 条消息时，整个 RX FIFO 将无法恢复。启用此选项将添加
            一个解决方案，在检测到这种勘误条件时重置外设。请注意，
            如果在重置期间在总线上发送了一个帧，该消息将丢失。

    config TWAI_ERRATA_FIX_LISTEN_ONLY_DOM
        bool "为仅监听模式发送显性位勘误添加软件解决方案"
        depends on IDF_TARGET_ESP32 || IDF_TARGET_ESP32S2 || IDF_TARGET_ESP32S3 || IDF_TARGET_ESP32C3
        default y
        help
            在仅监听模式下，TWAI 控制器不得影响 TWAI 总线（即不得
            发送任何显性位）。然而，在 ESP32/ESP32-S2/ESP32-S3/ESP32-C3
            的仅监听模式下，TWAI 控制器在检测到错误时仍会发送显性位
            （即作为主动错误帧的一部分）。启用此选项将添加一个解决
            方案，在初始化时强制 TWAI 控制器进入错误被动状态，从而
            防止发送任何显性位。

endmenu # TWAI Configuration
```

## components/efuse/Kconfig
```kconfig
menu "eFuse 位管理器"

    config EFUSE_CUSTOM_TABLE
        bool "使用自定义 eFuse 表"
        default n
        help
            允许从CSV文件生成eFuse的结构。

    config EFUSE_CUSTOM_TABLE_FILENAME
        string "自定义 eFuse CSV 文件"
        depends on EFUSE_CUSTOM_TABLE
        default "main/esp_efuse_custom_table.csv"
        help
            自定义eFuse CSV文件的名称。此路径相对于项目根目录进行评估。

    config EFUSE_VIRTUAL
        bool "在 RAM 中模拟 eFuse 操作"
        default n
        help
            如果为"n" - 无虚拟模式。所有eFuse操作都是真实的，并使用eFuse寄存器。
            如果为"y" - 虚拟模式被启用，所有eFuse操作（读和写）都被重定向到RAM而不是eFuse寄存器，
            所有永久性更改（通过eFuse）都被禁用。日志输出将显示将要应用的更改，但实际上不会应用。

            如果为"y"，则不能使用SECURE_FLASH_ENCRYPTION_MODE_RELEASE。
            因为EFUSE VIRT模式仅用于测试。

            在启动期间，eFuses被复制到RAM中。这种模式对于快速测试很有用。

    config EFUSE_VIRTUAL_KEEP_IN_FLASH
        bool "在闪存中保留 eFuses"
        depends on EFUSE_VIRTUAL
        help
            除了"在RAM中模拟eFuse操作"选项外，此选项只是添加了一个功能，
            在重启后将eFuses保存在闪存中。要使用此模式，partition_table应该有`efuse`分区。
            partition.csv: "efuse_em, data, efuse,   ,   0x2000,"

            在启动期间，eFuses从闪存复制，或者如果闪存为空，则从真实eFuse复制到RAM，然后更新闪存。
            当需要在重启后保持更改时（测试secure_boot和flash_encryption），这种模式很有用。

    config EFUSE_VIRTUAL_LOG_ALL_WRITES
        bool "记录所有虚拟写入"
        depends on EFUSE_VIRTUAL
        help
            如果启用，记录efuse烧写。这将显示将要进行的更改。

    choice EFUSE_CODE_SCHEME_SELECTOR
        prompt "编码方案兼容性"
        default EFUSE_CODE_SCHEME_COMPAT_3_4
        depends on IDF_TARGET_ESP32
        help
            eFuse编码方案选择器。

        config EFUSE_CODE_SCHEME_COMPAT_NONE
            bool "仅无"
        config EFUSE_CODE_SCHEME_COMPAT_3_4
            bool "3/4 和无"
        config EFUSE_CODE_SCHEME_COMPAT_REPEAT
            bool "重复、3/4 和无（通用表不支持）"
    endchoice

    config EFUSE_MAX_BLK_LEN
        int "最大块长度"
        default 256 if EFUSE_CODE_SCHEME_COMPAT_NONE
        default 192 if EFUSE_CODE_SCHEME_COMPAT_3_4
        default 128 if EFUSE_CODE_SCHEME_COMPAT_REPEAT
        default 256 if !IDF_TARGET_ESP32

endmenu
```
