## components/esp-tls/Kconfig
```kconfig
menu "ESP-TLS"
    choice ESP_TLS_LIBRARY_CHOOSE
        prompt "为 ESP-TLS 选择 SSL/TLS 库（查看帮助获取更多信息）"
        default ESP_TLS_USING_MBEDTLS
        help
            ESP-TLS API 支持多个后端 TLS 库。目前支持 mbedTLS 和 WolfSSL。
            不同的 TLS 库可能支持不同的功能并具有不同的资源使用情况。
            请查阅 ESP-IDF 编程指南中的 ESP-TLS 文档以获取更多详细信息。
        config ESP_TLS_USING_MBEDTLS
            bool "mbedTLS"
        config ESP_TLS_USING_WOLFSSL
            depends on TLS_STACK_WOLFSSL
            bool "wolfSSL（许可信息请参阅 wolfSSL 目录中的 README）"
    endchoice

    config ESP_TLS_USE_SECURE_ELEMENT
        bool "在 ESP-TLS 中使用安全元件（ATECC608A）"
        depends on IDF_TARGET_ESP32 && ESP_TLS_USING_MBEDTLS
        select ATCA_MBEDTLS_ECDSA
        select ATCA_MBEDTLS_ECDSA_SIGN
        select ATCA_MBEDTLS_ECDSA_VERIFY
        help
            为 ESP-TLS 启用安全元件的使用，这将启用对 ATECC608A 外设的内部支持，
            该外设可用于 TLS 连接。

    config ESP_TLS_USE_DS_PERIPHERAL
        bool "在 ESP-TLS 中使用数字签名（DS）外设"
        depends on ESP_TLS_USING_MBEDTLS && SOC_DIG_SIGN_SUPPORTED
        default y
        help
            为 ESP-TLS 启用数字签名外设的使用。DS 外设只能在为 TLS 适当配置时使用。
            请查阅 ESP-IDF 编程指南中的 ESP-TLS 文档以获取更多详细信息。

    config ESP_TLS_CLIENT_SESSION_TICKETS
        bool "启用客户端会话票证"
        depends on ESP_TLS_USING_MBEDTLS && MBEDTLS_CLIENT_SSL_SESSION_TICKETS
        help
            启用 RFC5077 中指定的会话票证支持。

    config ESP_TLS_SERVER_SESSION_TICKETS
        bool "启用服务器会话票证"
        depends on ESP_TLS_USING_MBEDTLS && MBEDTLS_SERVER_SSL_SESSION_TICKETS
        help
            启用 RFC5077 中指定的会话票证支持

    config ESP_TLS_SERVER_SESSION_TICKET_TIMEOUT
        int "服务器会话票证超时时间（秒）"
        depends on ESP_TLS_SERVER_SESSION_TICKETS
        default 86400
        help
            设置 TLS 服务器中使用的会话票证超时时间。

    config ESP_TLS_SERVER_CERT_SELECT_HOOK
        bool "证书选择钩子"
        depends on ESP_TLS_USING_MBEDTLS
        help
            能够在服务器握手期间配置和使用证书选择回调，
            根据客户端 hello 中提供的 TLS 扩展（alpn、sni 等）选择要呈现给客户端的证书。

    config ESP_TLS_SERVER_MIN_AUTH_MODE_OPTIONAL
        bool "ESP-TLS 服务器：将最小证书验证模式设置为可选"
        depends on ESP_TLS_USING_MBEDTLS
        help
            启用此选项后，服务器会检查对等方（此处为客户端）证书，
            但即使验证失败，握手也会继续。默认情况下，
            服务器不检查对等方证书并忽略它。

            握手完成后可以调用 mbedtls_ssl_get_verify_result() 来检索验证状态。

    config ESP_TLS_PSK_VERIFICATION
        bool "启用 PSK 验证"
        select MBEDTLS_PSK_MODES if ESP_TLS_USING_MBEDTLS
        select MBEDTLS_KEY_EXCHANGE_PSK if ESP_TLS_USING_MBEDTLS
        select MBEDTLS_KEY_EXCHANGE_DHE_PSK if ESP_TLS_USING_MBEDTLS && MBEDTLS_DHM_C
        select MBEDTLS_KEY_EXCHANGE_ECDHE_PSK if ESP_TLS_USING_MBEDTLS && MBEDTLS_ECDH_C
        select MBEDTLS_KEY_EXCHANGE_RSA_PSK if ESP_TLS_USING_MBEDTLS
        help
            启用对预共享密钥密码的支持，支持 mbedTLS 和 wolfSSL TLS 库。

    config ESP_TLS_INSECURE
        bool "允许潜在不安全的选项"
        help
            您可以启用一些潜在的不安全选项。这些选项应该只用于测试目的。
            只有在您非常确定的情况下才启用这些选项。

    config ESP_TLS_SKIP_SERVER_CERT_VERIFY
        bool "默认跳过服务器证书验证（警告：仅用于测试目的，请阅读帮助）"
        depends on ESP_TLS_INSECURE
        help
            启用此选项后，esp-tls 客户端默认将跳过服务器证书验证。
            请注意，此选项仅修改 esp-tls 客户端关于服务器证书验证的默认行为。
            默认行为应仅在 esp-tls 配置中未选择其他服务器证书验证选项时适用
            （例如 crt_bundle_attach、use_global_ca_store 等）。
            警告：启用此选项存在潜在风险，可能会与具有虚假身份的服务器建立 TLS 连接，
            前提是未通过 API 或其他机制（如 ca_store 等）提供服务器证书。

    config ESP_WOLFSSL_SMALL_CERT_VERIFY
        bool "启用 SMALL_CERT_VERIFY"
        depends on ESP_TLS_USING_WOLFSSL
        default y
        help
            启用使用中间 CA 证书进行服务器验证，不验证直到根 CA 证书的完整信任链
            （启用此选项后，客户端只需要服务器的中间 CA 证书来验证服务器，不需要根 CA 证书）。

    config ESP_DEBUG_WOLFSSL
        bool "为 wolfSSL 启用调试日志"
        depends on ESP_TLS_USING_WOLFSSL
        help
            为 wolfSSL SSL 库启用详细的调试打印。

endmenu
```

## components/esp_adc/Kconfig
```kconfig
menu "ADC和ADC校准"

    config ADC_ONESHOT_CTRL_FUNC_IN_IRAM
        bool "将ISR版本的ADC单次模式读取函数放入IRAM"
        default n
        help
            将ISR版本的ADC单次模式读取函数放入IRAM。

    config ADC_CONTINUOUS_ISR_IRAM_SAFE
        depends on SOC_ADC_DMA_SUPPORTED
        bool "ADC连续模式驱动程序ISR IRAM安全"
        default n
        select GDMA_ISR_IRAM_SAFE if SOC_ADC_DMA_SUPPORTED && SOC_GDMA_SUPPORTED
        help
            确保ADC连续模式ISR是IRAM安全的。启用后，当缓存被禁用时，ISR处理程序将可用。

    menu "ADC校准配置"
        depends on IDF_TARGET_ESP32

        config ADC_CALI_EFUSE_TP_ENABLE
            bool "使用两点值"
            default "y"
            help
                一些ESP32在eFuse BLOCK3中烧录了两点校准值。
                如果可用，此选项将允许ADC校准组件使用两点值来表征ADC-电压曲线。

        config ADC_CALI_EFUSE_VREF_ENABLE
            bool "使用eFuse Vref"
            default "y"
            help
                一些ESP32在eFuse BLOCK0中烧录了Vref。如果可用，此选项将允许
                ADC校准组件使用eFuse Vref来表征ADC-电压曲线。

        config ADC_CALI_LUT_ENABLE
            bool "使用查找表"
            default "y"
            help
                此选项将允许ADC校准组件使用查找表来校正11db衰减下的非线性行为。
                其他衰减不表现出非线性行为，因此不会受此选项影响。
    endmenu

    config ADC_DISABLE_DAC_OUTPUT
        depends on SOC_DAC_SUPPORTED
        bool "当ADC2使用时禁用DAC"
        default y
        help
            默认情况下，此选项被设置。ADC单次驱动程序将禁用相应DAC通道的输出：
            ESP32：IO25和IO26
            ESP32S2：IO17和IO18

            禁用此选项以便通过内部ADC测量DAC的输出，用于测试目的。

    config ADC_CONTINUOUS_FORCE_USE_ADC2_ON_C3_S3
        depends on IDF_TARGET_ESP32C3 || IDF_TARGET_ESP32S3
        bool "在ESP32S3或ESP32C3上强制使用ADC2连续模式"
        default n
        help
            在ESP32C3和ESP32S3上，ADC2数字控制器不稳定。因此，
            不建议在ESP32S3和ESP32C3上使用ADC2连续模式。

            如果您坚持使用，可以启用此选项以在上述条件下强制使用ADC2。
            有关更多详细信息，您可以在乐鑫网站上搜索勘误表。

    config ADC_ONESHOT_FORCE_USE_ADC2_ON_C3
        depends on IDF_TARGET_ESP32C3
        bool "在ESP32C3上强制使用ADC2单次模式"
        default n
        help
            在ESP32C3上，ADC2数字控制器不稳定。因此，
            不建议在ESP32C3上使用ADC2单次模式。

            如果您坚持使用，可以启用此选项以在上述条件下强制使用ADC2。
            有关更多详细信息，您可以在乐鑫网站上搜索勘误表。

    config ADC_ENABLE_DEBUG_LOG
        bool "启用ADC调试日志"
        default n
        help
            是否为ADC驱动程序启用调试日志消息。
            请注意，此选项仅控制ADC驱动程序日志，不会影响其他驱动程序。

            注意：这不能在ADC遗留驱动程序中使用。
endmenu
```

## components/esp_app_format/Kconfig.projbuild
```kconfig
menu "应用程序管理器"

    config APP_COMPILE_TIME_DATE
        bool "为应用程序使用时间/日期戳"
        default y
        depends on !APP_REPRODUCIBLE_BUILD
        help
            如果设置，应用程序将使用当前的时间/日期戳进行构建。它存储在应用程序描述结构中。
            如果不设置，时间/日期戳将从应用程序镜像中排除。这对于从相同源代码但在不同时间
            生成相同的二进制镜像文件可能有用。

    config APP_EXCLUDE_PROJECT_VER_VAR
        bool "从固件镜像中排除 PROJECT_VER"
        default n
        help
            构建系统中的 PROJECT_VER 变量将不会影响固件镜像。
            这个值不会包含在 esp_app_desc 结构中。

    config APP_EXCLUDE_PROJECT_NAME_VAR
        bool "从固件镜像中排除 PROJECT_NAME"
        default n
        help
            构建系统中的 PROJECT_NAME 变量将不会影响固件镜像。
            这个值不会包含在 esp_app_desc 结构中。

    config APP_PROJECT_VER_FROM_CONFIG
        bool "从 Kconfig 获取项目版本"
        default n
        help
            如果启用此选项，则配置项 APP_PROJECT_VER 将用于变量 PROJECT_VER。
            其他设置 PROJECT_VER 的方式将被忽略。

    config APP_PROJECT_VER
        string "项目版本"
        default "1"
        depends on APP_PROJECT_VER_FROM_CONFIG
        help
            项目版本

    config APP_RETRIEVE_LEN_ELF_SHA
        int "存储在 RAM 中的 APP ELF SHA 长度（字符）"
        default 9
        range 8 64
        help
            在启动时，应用程序将从闪存中读取嵌入的 APP ELF SHA-256 哈希值，
            将其转换为字符串并存储在 RAM 缓冲区中。
            这确保了即使在禁用缓存时，紧急处理程序和核心转储也能打印此字符串。
            缓冲区的大小是 APP_RETRIEVE_LEN_ELF_SHA 加上空终止符。
            更改此值将改变此缓冲区的大小（以字节为单位）。

endmenu # "Application manager"
```

## components/esp_bootloader_format/Kconfig.bootloader
```kconfig
menu "引导加载程序管理器"

    config BOOTLOADER_COMPILE_TIME_DATE
        bool "为引导加载程序使用时间/日期戳"
        default y
        depends on !APP_REPRODUCIBLE_BUILD
        help
            如果设置，则引导加载程序将使用当前时间/日期戳构建。
            它存储在引导加载程序描述结构中。如果未设置，时间/日期戳将从引导加载程序镜像中排除。
            这对于从同一源代码获取相同的二进制镜像文件，但在不同时间生成时很有用。

    config BOOTLOADER_PROJECT_VER
        int "项目版本"
        default 1
        range 0 4294967295
        help
            项目版本。它被放置在esp_bootloader_desc结构的"version"字段中。
            此字段的类型为"uint32_t"。
endmenu # "Bootloader manager"
```

## components/esp_coex/Kconfig
```kconfig
menu "无线共存"

    config ESP_COEX_ENABLED
        bool
        default y if (!SOC_WIRELESS_HOST_SUPPORTED)

    if(ESP_COEX_ENABLED)
        config ESP_COEX_SW_COEXIST_ENABLE
            bool "软件控制WiFi/蓝牙共存"
            depends on (ESP_WIFI_ENABLED && BT_ENABLED) || \
                (ESP_WIFI_ENABLED && IEEE802154_ENABLED)   || \
                (IEEE802154_ENABLED && BT_ENABLED)
            default y
            select ESP_WIFI_STA_DISCONNECTED_PM_ENABLE if (ESP_WIFI_ENABLED)
            help
                如果启用，WiFi和蓝牙的共存将由软件而不是硬件控制。
                推荐用于高流量场景。两种共存配置选项都会自动管理，无需用户干预。
                如果只使用蓝牙，建议禁用此选项以减小二进制文件大小。

        config ESP_COEX_EXTERNAL_COEXIST_ENABLE
            bool "外部共存"
            default n
            depends on (!(BT_ENABLED||NIMBLE_ENABLED)&&(!IDF_TARGET_ESP32))
            help
                如果启用，硬件外部共存仲裁将由GPIO引脚管理。
                目前可以支持三种有线组合，分别是1线/2线/3线。
                用户可以在应用程序代码中使用配置接口选择GPIO引脚。

                此功能依赖于蓝牙关闭，
                因为目前我们不支持同时使用外部共存和内部共存。

        config ESP_COEX_POWER_MANAGEMENT
            bool "支持共存下的电源管理"
            default n
            depends on (ESP_COEX_SW_COEXIST_ENABLE)
            help
                如果启用，将启用共存电源管理。
    endif

endmenu  # Wireless Coexistence
```

## components/esp_common/Kconfig
```kconfig
menu "常见ESP相关"

    config ESP_ERR_TO_NAME_LOOKUP
        bool "启用错误代码字符串查找"
        default "y"
        help
            函数esp_err_to_name()和esp_err_to_name_r()从预生成的查找表中返回错误代码的字符串表示。
            此选项可用于关闭查找表的使用，以节省内存，但代价是牺牲可区分（有意义）的输出字符串表示。

    config ESP_ALLOW_BSS_SEG_EXTERNAL_MEMORY
        # Invisible option that is set by SPIRAM_ALLOW_BSS_SEG_EXTERNAL_MEMORY, but
        # exists even if SPIRAM is not supported
        bool

endmenu # Common ESP-related
```

## components/esp_driver_gpio/Kconfig
```kconfig
menu "ESP-驱动：GPIO 配置"
    config GPIO_ESP32_SUPPORT_SWITCH_SLP_PULL
        bool "支持 ESP32 的轻度睡眠 GPIO 上拉/下拉配置"
        depends on IDF_TARGET_ESP32
        help
            此选项旨在修复 ESP32 在睡眠状态下无法切换到配置的上拉/下拉模式的错误。
            如果选择此选项，芯片将自动模拟切换行为，
            并将约 450B 的源代码放置到 IRAM 中。

    config GPIO_CTRL_FUNC_IN_IRAM
        bool "将 GPIO 控制函数放入 IRAM"
        default n
        help
            将 GPIO 控制函数（如 intr_disable/set_level）放入 IRAM，
            以便这些函数可以在 IRAM 中安全使用，并能够在其他 IRAM 中断上下文中被调用。
endmenu
```

## components/esp_driver_gptimer/Kconfig
```kconfig
menu "ESP-驱动：GPTimer 配置"
    depends on SOC_GPTIMER_SUPPORTED
    config GPTIMER_ISR_HANDLER_IN_IRAM
        bool "将 GPTimer ISR 处理程序放入 IRAM"
        default y
        help
            将 GPTimer ISR 处理程序放入 IRAM 以获得更好的性能和更少的缓存未命中。

    config GPTIMER_CTRL_FUNC_IN_IRAM
        bool "将 GPTimer 控制函数放入 IRAM"
        default n
        help
            将 GPTimer 控制函数（如启动/停止）放入 IRAM，
            以便这些函数可以在 IRAM 中安全运行，并能够在其他 IRAM 中断上下文中被调用。
            启用此选项还可以提高驱动程序的性能。

    config GPTIMER_ISR_IRAM_SAFE
        bool "GPTimer ISR IRAM 安全"
        select GPTIMER_ISR_HANDLER_IN_IRAM
        default n
        help
            通过允许中断处理程序在缓存禁用时（例如 SPI Flash 写入）可执行，
            确保 GPTimer 中断是 IRAM 安全的。

    config GPTIMER_ENABLE_DEBUG_LOG
        bool "启用调试日志"
        default n
        help
            是否为 GPTimer 驱动程序启用调试日志消息。
            注意，此选项仅控制 GPTimer 驱动程序日志，不会影响其他驱动程序。
endmenu
```

## components/esp_driver_i2c/Kconfig
```kconfig
menu "ESP-驱动：I2C 配置"
    depends on SOC_I2C_SUPPORTED
    config I2C_ISR_IRAM_SAFE
        bool "I2C ISR IRAM 安全"
        default n
        help
            通过允许中断处理程序在缓存禁用时（例如 SPI Flash 写入）可执行，
            确保 I2C 中断是 IRAM 安全的。
            注意：这不能在 I2C 遗留驱动程序中使用。

    config I2C_ENABLE_DEBUG_LOG
        bool "启用 I2C 调试日志"
        default n
        help
            是否为 I2C 驱动程序启用调试日志消息。
            注意，此选项仅控制 I2C 驱动程序日志，不会影响其他驱动程序。

            注意：这不能在 I2C 遗留驱动程序中使用。

endmenu # I2C Configurations
```

## components/esp_driver_i2s/Kconfig
```kconfig
menu "ESP-驱动：I2S 配置"
    depends on SOC_I2S_SUPPORTED
    config I2S_ISR_IRAM_SAFE
        bool "I2S ISR IRAM 安全"
        default n
        help
            通过允许中断处理程序在缓存禁用时（例如 SPI Flash 写入）可执行，
            确保 I2S 中断是 IRAM 安全的。

    config I2S_ENABLE_DEBUG_LOG
        bool "启用 I2S 调试日志"
        default n
        help
            是否启用 I2S 驱动程序的调试日志消息。
            注意，此选项仅控制 I2S 驱动程序日志，不会影响其他驱动程序。
endmenu # I2S Configuration
```

## components/esp_driver_ledc/Kconfig
```kconfig
menu "ESP-驱动：LEDC 配置"

    config LEDC_CTRL_FUNC_IN_IRAM
        bool "将 LEDC 控制函数放入 IRAM"
        default n
        help
            将 LEDC 控制函数（ledc_update_duty 和 ledc_stop）放入 IRAM，
            以便这些函数可以在 IRAM 上下文中安全调用。
            启用此选项还可以提高驱动程序性能。

endmenu
```

## components/esp_driver_mcpwm/Kconfig
```kconfig
menu "ESP-驱动：MCPWM 配置"
    depends on SOC_MCPWM_SUPPORTED
    config MCPWM_ISR_IRAM_SAFE
        bool "将 MCPWM ISR 函数放入 IRAM"
        default n
        help
            这将确保 MCPWM 中断处理程序是 IRAM 安全的，允许避免闪存
            缓存未命中，并且还能够在缓存禁用时运行。
            （例如，SPI 闪存写入）

    config MCPWM_CTRL_FUNC_IN_IRAM
        bool "将 MCPWM 控制函数放入 IRAM"
        default n
        help
            将 MCPWM 控制函数（如 set_compare_value）放入 IRAM，
            以便这些函数可以是 IRAM 安全的，并能够在其他 IRAM 中断上下文中被调用。
            启用此选项还可以提高驱动程序性能。

    config MCPWM_ENABLE_DEBUG_LOG
        bool "启用调试日志"
        default n
        help
            是否为 MCPWM 驱动程序启用调试日志消息。
            注意，此选项仅控制 MCPWM 驱动程序日志，不会影响其他驱动程序。
endmenu
```

## components/esp_driver_pcnt/Kconfig
```kconfig
menu "ESP-驱动：PCNT 配置"
    depends on SOC_PCNT_SUPPORTED
    config PCNT_CTRL_FUNC_IN_IRAM
        bool "将 PCNT 控制函数放入 IRAM"
        default n
        help
            将 PCNT 控制函数（如启动/停止）放入 IRAM，
            以便这些函数可以在 IRAM 中安全运行，并能够在其他 IRAM 中断上下文中被调用。
            启用此选项还可以提高驱动程序的性能。

    config PCNT_ISR_IRAM_SAFE
        bool "PCNT ISR IRAM 安全"
        default n
        help
            通过允许中断处理程序在缓存禁用时（例如 SPI Flash 写入）可执行，
            确保 PCNT 中断是 IRAM 安全的。

    config PCNT_ENABLE_DEBUG_LOG
        bool "启用调试日志"
        default n
        help
            是否为 PCNT 驱动程序启用调试日志消息。
            注意，此选项仅控制 PCNT 驱动程序日志，不会影响其他驱动程序。
endmenu
```

## components/esp_driver_rmt/Kconfig
```kconfig
menu "ESP-驱动：RMT 配置"
    depends on SOC_RMT_SUPPORTED
    config RMT_ISR_IRAM_SAFE
        bool "RMT ISR IRAM 安全"
        default n
        select GDMA_ISR_IRAM_SAFE if SOC_RMT_SUPPORT_DMA     # RMT basic functionality relies on GDMA callback
        select GDMA_CTRL_FUNC_IN_IRAM if SOC_RMT_SUPPORT_DMA # RMT needs to restart the GDMA in the interrupt
        help
            通过允许中断处理程序在缓存禁用时（例如 SPI Flash 写入）可执行，
            确保 RMT 中断是 IRAM 安全的。

    config RMT_RECV_FUNC_IN_IRAM
        bool "将 RMT 接收函数放入 IRAM"
        default n
        select GDMA_CTRL_FUNC_IN_IRAM if SOC_RMT_SUPPORT_DMA # RMT needs to start the GDMA in the receive function
        help
            将 RMT 接收函数放入 IRAM，
            使接收函数可以 IRAM 安全，并且在 flash 缓存禁用时可以被调用。
            启用此选项还可以提高驱动程序性能。

    config RMT_ENABLE_DEBUG_LOG
        bool "启用调试日志"
        default n
        help
            是否为 RMT 驱动程序启用调试日志消息。
            注意，此选项仅控制 RMT 驱动程序日志，不会影响其他驱动程序。
endmenu
```

## components/esp_driver_sdm/Kconfig
```kconfig
menu "ESP-驱动：Sigma Delta 调制器配置"
    depends on SOC_SDM_SUPPORTED
    config SDM_CTRL_FUNC_IN_IRAM
        bool "将 SDM 控制函数放入 IRAM"
        default n
        help
            将 SDM 控制函数（如 set_duty）放入 IRAM，
            以便这些函数可以在 IRAM 中安全运行，并能够在其他 IRAM 中断上下文中被调用。
            启用此选项还可以提高驱动程序的性能。

    config SDM_ENABLE_DEBUG_LOG
        bool "启用调试日志"
        default n
        help
            是否为 SDM 驱动程序启用调试日志消息。
            注意，此选项仅控制 SDM 驱动程序日志，不会影响其他驱动程序。
endmenu # Sigma Delta Modulator Configurations
```
