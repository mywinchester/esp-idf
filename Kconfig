## components/app_trace/Kconfig
```kconfig
menu "应用程序级别跟踪"

    choice APPTRACE_DESTINATION1
        prompt "数据目标1"
        default APPTRACE_DEST_NONE
        help
            选择应用程序跟踪的目标：JTAG或无（禁用）。

        config APPTRACE_DEST_JTAG
            bool "JTAG"
            select APPTRACE_DEST_TRAX if IDF_TARGET_ARCH_XTENSA
            select APPTRACE_MEMBUFS_APPTRACE_PROTO_ENABLE
            select APPTRACE_ENABLE

        config APPTRACE_DEST_NONE
            bool "无"
    endchoice

    config APPTRACE_DEST_UART
        bool

    config APPTRACE_DEST_UART_NOUSB
        bool

    choice APPTRACE_DESTINATION2
        prompt "数据目标2"
        default APPTRACE_DEST_UART_NONE
        help
            选择应用程序跟踪的目标：UART(XX)或无（禁用）。

        config APPTRACE_DEST_UART0
            bool "UART0"
            select APPTRACE_ENABLE
            select APPTRACE_DEST_UART
            select APPTRACE_DEST_UART_NOUSB
            depends on (ESP_CONSOLE_UART_NUM !=0)

        config APPTRACE_DEST_UART1
            bool "UART1"
            select APPTRACE_ENABLE
            select APPTRACE_DEST_UART
            select APPTRACE_DEST_UART_NOUSB
            depends on (ESP_CONSOLE_UART_NUM !=1)

        config APPTRACE_DEST_UART2
            bool "UART2"
            select APPTRACE_ENABLE
            select APPTRACE_DEST_UART
            select APPTRACE_DEST_UART_NOUSB
            depends on (ESP_CONSOLE_UART_NUM !=2) && (SOC_UART_NUM > 2)

        config APPTRACE_DEST_USB_CDC
            bool "USB_CDC"
            select APPTRACE_ENABLE
            select APPTRACE_DEST_UART
            depends on !ESP_CONSOLE_USB_CDC && (IDF_TARGET_ESP32C3 || IDF_TARGET_ESP32S3) && !USB_ENABLED

        config APPTRACE_DEST_UART_NONE
            bool "无"
    endchoice

    config APPTRACE_UART_TX_GPIO
        int "UART TX 使用的GPIO#"
        depends on APPTRACE_DEST_UART_NOUSB
        range 0 46
        default 12 if IDF_TARGET_ESP32
        default 12 if IDF_TARGET_ESP32C3
        default 12
        help
            此GPIO用于UART TX引脚。

    config APPTRACE_UART_RX_GPIO
        int "UART RX 使用的GPIO#"
        depends on APPTRACE_DEST_UART_NOUSB
        range 0 46
        default 13 if IDF_TARGET_ESP32
        default 13 if IDF_TARGET_ESP32C3
        default 13
        help
            此GPIO用于UART RX引脚。

    config APPTRACE_UART_BAUDRATE
        int
        prompt "UART 波特率" if APPTRACE_DEST_UART
        depends on APPTRACE_DEST_UART
        default 1000000
        range 1200 8000000
        range 1200 1000000
        help
            此波特率用于UART。

            应用程序的最大波特率取决于UART时钟源。如果禁用电源管理，
            UART时钟源是APB时钟，可用范围内的所有波特率都将足够准确。
            如果启用电源管理，则使用REF_TICK时钟源，因此波特率从1MHz分频。
            超过1Mbps的波特率是不可能的，500Kbps到1Mbps之间的值可能不准确。

    config APPTRACE_UART_RX_BUFF_SIZE
        int
        prompt "UART RX环形缓冲区大小" if APPTRACE_DEST_UART
        depends on APPTRACE_DEST_UART
        default 128
        range 64 32768
        help
            UART输入环形缓冲区的大小。
            此大小与波特率、系统滴答频率和要传输的数据量相关。
            数据在发送到接口之前放置在此缓冲区中。

    config APPTRACE_UART_TX_BUFF_SIZE
        int
        prompt "UART TX环形缓冲区大小" if APPTRACE_DEST_UART
        depends on APPTRACE_DEST_UART
        default 4096
        range 2048 32768
        help
            UART输出环形缓冲区的大小。
            此大小与波特率、系统滴答频率和要传输的数据量相关。

    config APPTRACE_UART_TX_MSG_SIZE
        int
        prompt "UART TX消息大小" if APPTRACE_DEST_UART
        depends on APPTRACE_DEST_UART
        default 128
        range 64 32768
        help
            要传输的单个消息的最大大小。

    config APPTRACE_UART_TASK_PRIO
        int
        prompt "UART任务优先级" if APPTRACE_DEST_UART
        default 1
        range 1 32
        help
            UART任务优先级。在高事件率的情况下，
            此参数可以更改为(configMAX_PRIORITIES-1)。

    config APPTRACE_DEST_TRAX
        bool
        depends on IDF_TARGET_ARCH_XTENSA && !ESP32_TRAX && !ESP32S2_TRAX && !ESP32S3_TRAX
        select ESP32_MEMMAP_TRACEMEM
        select ESP32S2_MEMMAP_TRACEMEM
        select ESP32S3_MEMMAP_TRACEMEM
        select ESP32_MEMMAP_TRACEMEM_TWOBANKS
        select ESP32S2_MEMMAP_TRACEMEM_TWOBANKS
        select ESP32S3_MEMMAP_TRACEMEM_TWOBANKS
        default n
        help
            启用/禁用TRAX跟踪硬件。

    config APPTRACE_MEMBUFS_APPTRACE_PROTO_ENABLE
        bool
        default n
        help
            启用/禁用交换内存缓冲区跟踪协议。

    config APPTRACE_ENABLE
        bool
        default n
        help
            启用/禁用应用程序跟踪模块。

    config APPTRACE_LOCK_ENABLE
        bool
        default !APPTRACE_SV_ENABLE
        help
            启用/禁用应用程序跟踪模块内部同步锁。

    config APPTRACE_ONPANIC_HOST_FLUSH_TMO
        int "在发生紧急情况时将最后的跟踪数据刷新到主机的超时时间"
        depends on APPTRACE_ENABLE
        range -1 5000
        default -1
        help
            在发生紧急情况时将最后的跟踪数据刷新到主机的超时时间。单位为毫秒。
            使用-1禁用超时并永远等待。

    config APPTRACE_POSTMORTEM_FLUSH_THRESH
        int "在发生紧急情况时将最后的跟踪数据刷新到主机的阈值"
        depends on APPTRACE_ENABLE
        range 0 16384
        default 0
        help
            在后死亡模式下，在发生紧急情况时将最后的跟踪数据刷新到主机的阈值。
            这是执行刷新所需的最小数据量。单位为字节。

    config APPTRACE_BUF_SIZE
        int "应用程序跟踪缓冲区大小"
        depends on APPTRACE_MEMBUFS_APPTRACE_PROTO_ENABLE && !APPTRACE_DEST_TRAX
        default 16384
        help
            跟踪数据的内存缓冲区大小，单位为字节。

    config APPTRACE_PENDING_DATA_SIZE_MAX
        int "待处理数据缓冲区大小"
        depends on APPTRACE_MEMBUFS_APPTRACE_PROTO_ENABLE
        default 0
        help
            事件缓冲区的大小，单位为字节。它用于缓冲来自
            时间关键代码（调度器、ISR等）的事件。如果此参数为0，
            则当主硬件缓冲区已满时，事件将被丢弃。

    menu "FreeRTOS SystemView跟踪"
        depends on APPTRACE_ENABLE
        config APPTRACE_SV_ENABLE
            bool "启用SystemView跟踪"
            depends on APPTRACE_ENABLE
            default n
            help
                启用对SEGGER SystemView跟踪功能的支持。

        choice APPTRACE_SV_DEST
            prompt "SystemView目标"
            depends on APPTRACE_SV_ENABLE
            default APPTRACE_SV_DEST_JTAG
            help
                SystemView将通过定义的接口传输数据。

            config APPTRACE_SV_DEST_JTAG
                bool "数据目标JTAG"
                depends on  !PM_ENABLE && !APPTRACE_DEST_NONE
                help
                    通过JTAG接口发送SEGGER SystemView事件。

            config APPTRACE_SV_DEST_UART
                bool "数据目标UART"
                depends on APPTRACE_DEST_UART
                help
                    通过UART接口发送SEGGER SystemView事件。

        endchoice

        choice APPTRACE_SV_CPU
            prompt "要跟踪的CPU"
            depends on APPTRACE_SV_DEST_UART && !ESP_SYSTEM_SINGLE_CORE_MODE
            default APPTRACE_SV_DEST_CPU_0
            help
                定义SystemView要跟踪的CPU。

            config APPTRACE_SV_DEST_CPU_0
                bool "CPU0"
                help
                    为Pro CPU发送SEGGER SystemView事件。

            config APPTRACE_SV_DEST_CPU_1
                bool "CPU1"
                help
                    为App CPU发送SEGGER SystemView事件。

        endchoice


        choice APPTRACE_SV_TS_SOURCE
            prompt "用作时间戳源的定时器"
            depends on APPTRACE_SV_ENABLE
            default APPTRACE_SV_TS_SOURCE_CCOUNT if ESP_SYSTEM_SINGLE_CORE_MODE && !PM_ENABLE && !IDF_TARGET_ESP32C3
            default APPTRACE_SV_TS_SOURCE_GPTIMER if !ESP_SYSTEM_SINGLE_CORE_MODE && !PM_ENABLE && !IDF_TARGET_ESP32C3
            default APPTRACE_SV_TS_SOURCE_ESP_TIMER if PM_ENABLE || IDF_TARGET_ESP32C3
            help
                SystemView在跟踪时需要使用硬件定时器作为时间戳源。
                此选项选择用于此目的的定时器。

            config APPTRACE_SV_TS_SOURCE_CCOUNT
                bool "CPU周期计数器（CCOUNT）"
                depends on ESP_SYSTEM_SINGLE_CORE_MODE && !PM_ENABLE && !IDF_TARGET_ESP32C3

            config APPTRACE_SV_TS_SOURCE_GPTIMER
                bool "通用定时器（定时器组）"
                depends on !PM_ENABLE && !IDF_TARGET_ESP32C3

            config APPTRACE_SV_TS_SOURCE_ESP_TIMER
                bool "esp_timer高分辨率定时器"

        endchoice

        config APPTRACE_SV_MAX_TASKS
            int "最大支持的任务数"
            depends on APPTRACE_SV_ENABLE
            range 1 64
            default 16
            help
                配置sysview调试中支持的最大任务数

        config APPTRACE_SV_BUF_WAIT_TMO
            int "跟踪缓冲区等待超时"
            depends on APPTRACE_SV_ENABLE
            default 500
            help
                配置等待跟踪缓冲区中的可用空间的超时时间（以微秒为单位）。
                设置为-1以永远等待并避免丢失事件。

        config APPTRACE_SV_EVT_OVERFLOW_ENABLE
            bool "跟踪缓冲区溢出事件"
            depends on APPTRACE_SV_ENABLE
            default y
            help
                启用"跟踪缓冲区溢出"事件。

        config APPTRACE_SV_EVT_ISR_ENTER_ENABLE
            bool "ISR进入事件"
            depends on APPTRACE_SV_ENABLE
            default y
            help
                启用"ISR进入"事件。

        config APPTRACE_SV_EVT_ISR_EXIT_ENABLE
            bool "ISR退出事件"
            depends on APPTRACE_SV_ENABLE
            default y
            help
                启用"ISR退出"事件。

        config APPTRACE_SV_EVT_ISR_TO_SCHED_ENABLE
            bool "ISR退出到调度器事件"
            depends on APPTRACE_SV_ENABLE
            default y
            help
                启用"ISR到调度器"事件。

        config APPTRACE_SV_EVT_TASK_START_EXEC_ENABLE
            bool "任务开始执行事件"
            depends on APPTRACE_SV_ENABLE
            default y
            help
                启用"任务开始执行"事件。

        config APPTRACE_SV_EVT_TASK_STOP_EXEC_ENABLE
            bool "任务停止执行事件"
            depends on APPTRACE_SV_ENABLE
            default y
            help
                启用"任务停止执行"事件。

        config APPTRACE_SV_EVT_TASK_START_READY_ENABLE
            bool "任务开始就绪状态事件"
            depends on APPTRACE_SV_ENABLE
            default y
            help
                启用"任务开始就绪状态"事件。
        config APPTRACE_SV_EVT_TASK_STOP_READY_ENABLE
            bool "任务停止就绪状态事件"
            depends on APPTRACE_SV_ENABLE
            default y
            help
                启用"任务停止就绪状态"事件。

        config APPTRACE_SV_EVT_TASK_CREATE_ENABLE
            bool "任务创建事件"
            depends on APPTRACE_SV_ENABLE
            default y
            help
                启用"任务创建"事件。

        config APPTRACE_SV_EVT_TASK_TERMINATE_ENABLE
            bool "任务终止事件"
            depends on APPTRACE_SV_ENABLE
            default y
            help
                启用"任务终止"事件。

        config APPTRACE_SV_EVT_IDLE_ENABLE
            bool "系统空闲事件"
            depends on APPTRACE_SV_ENABLE
            default y
            help
                启用"系统空闲"事件。

        config APPTRACE_SV_EVT_TIMER_ENTER_ENABLE
            bool "定时器进入事件"
            depends on APPTRACE_SV_ENABLE
            default y
            help
                启用"定时器进入"事件。

        config APPTRACE_SV_EVT_TIMER_EXIT_ENABLE
            bool "定时器退出事件"
            depends on APPTRACE_SV_ENABLE
            default y
            help
                启用"定时器退出"事件。

    endmenu

    config APPTRACE_GCOV_ENABLE
        bool "启用GCOV到主机"
        depends on APPTRACE_ENABLE && !APPTRACE_SV_ENABLE
        select ESP_DEBUG_STUBS_ENABLE
        default n
        help
            启用对GCOV数据传输到主机的支持。

    config APPTRACE_GCOV_DUMP_TASK_STACK_SIZE
        int "Gcov转储任务栈大小"
        depends on APPTRACE_GCOV_ENABLE
        default 2048
        help
            配置Gcov转储任务的栈大小

endmenu
```
