## components/esp_hw_support/port/esp32s3/Kconfig.mac
```kconfig
choice ESP32S3_UNIVERSAL_MAC_ADDRESSES
    bool "IEEE通用管理MAC地址数量"
    default ESP32S3_UNIVERSAL_MAC_ADDRESSES_FOUR
    help
        配置IEEE通用管理MAC地址的数量。
        在初始化期间，每个网络接口的MAC地址都是从单个基本MAC地址生成或派生的。
        如果通用MAC地址的数量为四个，则所有四个接口（WiFi站点、WiFi软AP、蓝牙和以太网）
        都会收到一个通用管理的MAC地址。这些地址是通过在基本MAC地址的最后一个八位字节
        上依次添加0、1、2和3（分别对应）来生成的。
        如果通用MAC地址的数量为两个，则只有两个接口（WiFi站点和蓝牙）会收到通用管理的
        MAC地址。这些地址是通过在基本MAC地址上依次添加0和1（分别对应）来生成的。剩下的
        两个接口（WiFi软AP和以太网）会收到本地MAC地址。这些地址分别从通用WiFi站点和
        蓝牙MAC地址派生而来。
        当使用默认（Espressif分配的）基本MAC地址时，可以使用任一设置。当使用自定义通用
        MAC地址范围时，正确的设置将取决于此范围内MAC地址的分配（每个设备2个或4个）。

    config ESP32S3_UNIVERSAL_MAC_ADDRESSES_TWO
        bool "两个"
        select ESP_MAC_UNIVERSAL_MAC_ADDRESSES_TWO
        select ESP_MAC_ADDR_UNIVERSE_WIFI_STA
        select ESP_MAC_ADDR_UNIVERSE_BT

    config ESP32S3_UNIVERSAL_MAC_ADDRESSES_FOUR
        bool "四个"
        select ESP_MAC_UNIVERSAL_MAC_ADDRESSES_FOUR
        select ESP_MAC_ADDR_UNIVERSE_WIFI_STA
        select ESP_MAC_ADDR_UNIVERSE_WIFI_AP
        select ESP_MAC_ADDR_UNIVERSE_BT
        select ESP_MAC_ADDR_UNIVERSE_ETH
endchoice

config ESP32S3_UNIVERSAL_MAC_ADDRESSES
    int
    default 2 if ESP32S3_UNIVERSAL_MAC_ADDRESSES_TWO
    default 4 if ESP32S3_UNIVERSAL_MAC_ADDRESSES_FOUR
```

## components/esp_hw_support/port/esp32s3/Kconfig.rtc
```kconfig
choice RTC_CLK_SRC
    prompt "RTC时钟源"
    default RTC_CLK_SRC_INT_RC
    help
        选择用作RTC时钟源的时钟。

    config RTC_CLK_SRC_INT_RC
        bool "内部136kHz RC振荡器"
    config RTC_CLK_SRC_EXT_CRYS
        bool "外部32kHz晶体"
        select ESP_SYSTEM_RTC_EXT_XTAL
    config RTC_CLK_SRC_EXT_OSC
        bool "32K_XP引脚上的外部32kHz振荡器"
        select ESP_SYSTEM_RTC_EXT_OSC
    config RTC_CLK_SRC_INT_8MD256
        bool "内部17.5MHz振荡器，除以256"
endchoice

config RTC_CLK_CAL_CYCLES
    int "RTC_SLOW_CLK校准的周期数"
    default 3000 if RTC_CLK_SRC_EXT_CRYS || RTC_CLK_SRC_EXT_OSC || RTC_CLK_SRC_INT_8MD256
    default 1024 if RTC_CLK_SRC_INT_RC
    range 0 8190 if RTC_CLK_SRC_EXT_CRYS || RTC_CLK_SRC_EXT_OSC || RTC_CLK_SRC_INT_8MD256
    range 0 32766 if RTC_CLK_SRC_INT_RC
    help
        当启动代码初始化RTC_SLOW_CLK时，它可以通过比较RTC_SLOW_CLK频率与主XTAL
        频率来执行校准。此选项设置校准例程测量的RTC_SLOW_CLK周期数。较高的数字
        会增加校准精度，这对于长时间处于深度睡眠状态的应用程序可能很重要。较低
        的数字会减少启动时间。

        当此选项设置为0时，启动时不会执行时钟校准，并且将假设近似的时钟频率：

        - 如果使用内部RC振荡器作为时钟源，则为150000 Hz。对此使用值1024。
        - 如果使用32k晶体振荡器，则为32768 Hz。对此使用3000或更多的值。
            在这种情况下，更多的值将有助于改善晶体启动的定义。
            如果晶体无法启动，它将切换到内部RC。
```

## components/esp_lcd/Kconfig
```kconfig
menu "LCD 和触摸面板"
    comment "LCD Touch Drivers are maintained in the IDF Component Registry"

    menu "LCD 外设配置"
        config LCD_ENABLE_DEBUG_LOG
            bool "启用调试日志"
            default n
            help
                是否为 LCD 驱动启用调试日志消息。
                注意，此选项仅控制 LCD 驱动日志，不会影响其他驱动程序。

        if SOC_LCD_RGB_SUPPORTED
            config LCD_RGB_ISR_IRAM_SAFE
                bool "RGB LCD ISR IRAM 安全"
                default n
                help
                    通过允许中断处理程序在缓存禁用时（例如 SPI Flash 写入）可执行，
                    确保 LCD 中断是 IRAM 安全的。
                    如果您希望 LCD 驱动程序在缓存操作禁用时继续刷新屏幕，
                    可以启用此选项。注意，这也会增加 IRAM 的使用量。

            config LCD_RGB_RESTART_IN_VSYNC
                bool "在 VSYNC 中重新启动传输"
                default n
                select GDMA_CTRL_FUNC_IN_IRAM # need to restart GDMA in the LCD ISR
                help
                    每个 VBlank 重置 GDMA 通道以防止永久性不同步发生。
                    仅在您的应用程序中 DMA 无法像 LCD 消耗数据那样快速传输数据时才需要启用它。
        endif # SOC_LCD_RGB_SUPPORTED

        if SOC_MIPI_DSI_SUPPORTED
            config LCD_DSI_ISR_IRAM_SAFE
                bool "DSI LCD ISR IRAM 安全"
                default n
                select DW_GDMA_ISR_IRAM_SAFE
                select DW_GDMA_CTRL_FUNC_IN_IRAM
                select DW_GDMA_SETTER_FUNC_IN_IRAM
                select DW_GDMA_GETTER_FUNC_IN_IRAM
                help
                    通过允许中断处理程序在缓存禁用时（例如 SPI Flash 写入）可执行，
                    确保 LCD 中断是 IRAM 安全的。
                    如果您希望 LCD 驱动程序在缓存操作禁用时继续刷新屏幕，
                    可以启用此选项。注意，这也会增加 IRAM 的使用量。
        endif # SOC_MIPI_DSI_SUPPORTED
    endmenu
endmenu
```

## components/esp_netif/Kconfig
```kconfig
menu "ESP NETIF 适配器"

    config ESP_NETIF_IP_LOST_TIMER_INTERVAL
        int "IP 地址丢失计时器间隔（秒）"
        range 0 65535
        default 120
        help
            值为 0 表示 IP 丢失计时器被禁用，否则计时器将被启用。

            IP 地址可能因某些原因而丢失，例如当站点与软 AP 断开连接时，或当 DHCP IP 续约失败等。
            如果 IP 丢失计时器被启用，它将在每次 IP 丢失时启动。如果计时器到期，将触发 SYSTEM_EVENT_STA_LOST_IP 事件。
            如果站点在计时器到期之前重新获得 IP，IP 丢失计时器将停止。

    choice ESP_NETIF_USE_TCPIP_STACK_LIB
        prompt "TCP/IP 协议栈库"
        default ESP_NETIF_TCPIP_LWIP
        help
            选择要使用的 TCP/IP 协议栈，例如 LwIP、uIP 等。
        config ESP_NETIF_TCPIP_LWIP
            bool "LwIP"
            select ESP_NETIF_USES_TCPIP_WITH_BSD_API
            depends on LWIP_ENABLE
            help
                lwIP 是 TCP/IP 协议套件的一个小型独立实现。

        config ESP_NETIF_LOOPBACK
            bool "回环"
            help
                esp-netif 功能的虚拟实现，将驱动程序的发送功能连接到接收功能。此选项仅用于测试目的。

    endchoice

    config ESP_NETIF_USES_TCPIP_WITH_BSD_API
        bool # Set to true if the chosen TCP/IP stack provides BSD socket API

    config ESP_NETIF_RECEIVE_REPORT_ERRORS
        bool "使用 esp_err_t 报告 esp_netif_receive 的错误"
        default n
        help
            启用此选项，esp_netif_receive() 将返回错误代码。这对于通知上层数据包输入到 TCP/IP 协议栈失败很有用，
            以便上层可以实现流量控制。由于向后兼容性，此选项默认禁用，将在 v6.0 中启用（IDF-7194）。

    config ESP_NETIF_L2_TAP
        bool "启用 netif L2 TAP 支持"
        select ETH_TRANSMIT_MUTEX
        help
            用户程序可以从/向 ESP TAP 设备读取/写入链路层（L2）帧。
            ESP TAP 设备目前只能与以太网物理接口关联。

    config ESP_NETIF_L2_TAP_MAX_FDS
        depends on ESP_NETIF_L2_TAP
        int "打开的 L2 TAP 文件描述符的最大数量"
        range 1 10
        default 5
        help
            与 ESP TAP 设备关联的打开的文件描述符（FD）的最大数量。ESP TAP FD 会占用一定量的内存，
            允许同时打开较少的 FD 可以节省内存。

    config ESP_NETIF_L2_TAP_RX_QUEUE_SIZE
        depends on ESP_NETIF_L2_TAP
        int "L2 TAP 接收队列大小"
        range 1 100
        default 20
        help
            打开的文件描述符中排队的最大帧数。一旦队列满了，新到达的帧将被丢弃，
            直到队列有足够的空间接受传入流量（尾部丢弃队列管理）。

    config ESP_NETIF_BRIDGE_EN
        depends on ESP_NETIF_TCPIP_LWIP
        bool "启用 LwIP IEEE 802.1D 桥接"
        default n
        help
            在 ESP-NETIF 中启用 LwIP IEEE 802.1D 桥接支持。请注意，"存储在 netif 中的客户端数据数量"
            （LWIP_NUM_NETIF_CLIENT_DATA）选项需要正确配置才能使 LwIP 桥接可用！

    config ESP_NETIF_SET_DNS_PER_DEFAULT_NETIF
        bool "为每个接口启用 DNS 服务器"
        default n
        select LWIP_DNS_SETSERVER_WITH_NETIF
        help
            启用此选项以使用属于所选默认网络接口的 DNS 服务器。
            此功能从 LWIP 核心模块收集 DNS 服务器和 netif 信息。
            每当选择新的默认 netif 时，LWIP 中的全局 DNS 服务器将更新为与 netif 相关的服务器。

endmenu
```

## components/esp_phy/Kconfig
```kconfig
menu "物理层 (PHY)"

    config ESP_PHY_ENABLED
        bool
        default y if (SOC_PHY_SUPPORTED)

    if (ESP_PHY_ENABLED)
        config ESP_PHY_CALIBRATION_AND_DATA_STORAGE
            bool "在 NVS 中存储物理层校准数据"
            default y
            help
                如果启用此选项，NVS 将被初始化，并从中加载校准数据。
                在深度睡眠唤醒时，将跳过物理层校准。如果未找到校准数据，将执行完整校准并存储在 NVS 中。
                通常，只会执行部分校准。如果禁用此选项，将执行完整校准。

                如果您的板子容易校准出错误数据，请选择 'n'。
                例如，在以下两种情况下，您应该选择 'n'：
                1. 如果您的板子在天线断开的情况下容易启动。
                2. 由于您的板子设计，每次校准时结果都非常不稳定。
                如果不确定，请选择 'y'。

        menuconfig ESP_PHY_INIT_DATA_IN_PARTITION
            bool "使用分区存储物理层初始化数据"
            depends on SOC_WIFI_SUPPORTED
            default n
            help
                如果启用，物理层初始化数据将从分区加载。
                使用自定义分区表时，请确保包含物理层数据分区（类型：'data'，子类型：'phy'）。
                使用默认分区表时，这将自动完成。
                如果物理层初始化数据存储在分区中，必须将其刷写到该位置，
                否则将发生运行时错误。

                如果未启用此选项，物理层初始化数据将嵌入到应用程序二进制文件中。

                如果不确定，请选择 'n'。

        config ESP_PHY_DEFAULT_INIT_IF_INVALID
            bool "如果无效则重置为默认物理层初始化数据"
            default n
            depends on ESP_PHY_INIT_DATA_IN_PARTITION
            help
                如果启用，当物理层初始化数据无法成功验证时，
                将恢复为默认值以避免无限重启循环。

                如果不确定，请选择 'n'。

        if ESP_PHY_INIT_DATA_IN_PARTITION
            config ESP_PHY_MULTIPLE_INIT_DATA_BIN
                bool "支持多个物理层初始化数据二进制文件"
                depends on ESP_PHY_INIT_DATA_IN_PARTITION
                default n
                help
                    如果启用，可以根据国家代码自动切换相应的物理层初始化数据类型。
                    默认使用中国的物理层初始化数据二进制文件。
                    可以通过 API esp_wifi_set_country() 中的国家信息进行修改。
                    切换物理层初始化数据类型的优先级为：
                    1. 通过 API esp_wifi_set_country() 配置的国家，
                    且参数策略为 WIFI_COUNTRY_POLICY_MANUAL。
                    2. 连接的 AP 通知的国家。
                    3. 通过 API esp_wifi_set_country() 配置的国家，
                    且参数策略为 WIFI_COUNTRY_POLICY_AUTO。

            config ESP_PHY_MULTIPLE_INIT_DATA_BIN_EMBED
                bool "支持将多个物理层初始化数据二进制文件嵌入到应用程序二进制文件中"
                depends on ESP_PHY_MULTIPLE_INIT_DATA_BIN
                default n
                help
                    如果启用，多个物理层初始化数据二进制文件将嵌入到应用程序二进制文件中。
                    如果未启用，多个物理层初始化数据二进制文件将保持独立，需要用户手动刷写。

            config ESP_PHY_INIT_DATA_ERROR
                bool "物理层初始化数据错误时终止操作"
                depends on ESP_PHY_MULTIPLE_INIT_DATA_BIN
                default n
                help
                    如果启用，当更新物理层初始化数据时发生错误，
                    程序将终止并重新启动。
                    如果未启用，当发生错误时，物理层初始化数据将不会更新。
        endif

        config ESP_PHY_MAX_WIFI_TX_POWER
            int "最大 WiFi 发射功率 (dBm)"
            range 10 20
            default 20
            help
                设置 WiFi 无线电的最大发射功率。高数据速率的实际发射功率可能低于此设置。

        config ESP_PHY_MAX_TX_POWER
            int
            default ESP_PHY_MAX_WIFI_TX_POWER

        config ESP_PHY_MAC_BB_PD
            bool "当物理层禁用时关闭 Wi-Fi 和蓝牙的 MAC 和基带"
            depends on SOC_PM_SUPPORT_MAC_BB_PD && FREERTOS_USE_TICKLESS_IDLE
            default n
            help
                如果启用，当物理层禁用时，Wi-Fi 和蓝牙的 MAC 和基带将被关闭。
                启用此设置会略微减少功耗，但会增加约 4 KB（仅 Wi-Fi）、
                2 KB（仅蓝牙）或 5.3 KB（Wi-Fi + 蓝牙）的 RAM 使用。

        config ESP_PHY_REDUCE_TX_POWER
            bool "掉电复位时降低物理层发射功率"
            depends on ESP_BROWNOUT_DET
            default n
            help
                当发生掉电复位时，降低物理层发射功率以保持代码运行。

        config ESP_PHY_ENABLE_USB
            bool "初始化 WiFi 时保持 USB 物理层启用"
            depends on SOC_WIFI_PHY_NEEDS_USB_WORKAROUND
            default y if IDF_TARGET_ESP32C3 || IDF_TARGET_ESP32S3 \
                || ESP_CONSOLE_USB_SERIAL_JTAG || ESP_CONSOLE_SECONDARY_USB_SERIAL_JTAG
            default n
            help
                在某些 ESP 目标上，USB 物理层可能会干扰 WiFi，从而降低 WiFi 性能。
                因此，在受影响的 ESP 目标上，ESP 物理层库的初始化将自动禁用 USB 物理层，
                以获得最佳的 WiFi 性能。
                此选项控制 ESP 物理层库在初始化时是否保持 USB 物理层启用。

                注意：可以禁用此选项以提高 WiFi 性能。但是，禁用此选项也意味着
                在 WiFi 启用时无法使用 USB 物理层。

        config ESP_PHY_ENABLE_CERT_TEST
            bool "启用射频认证测试功能"
            default n
            depends on IDF_TARGET_ESP32C3 || IDF_TARGET_ESP32S3
            help
                如果启用，您可以使用射频认证测试 API。

        choice ESP_PHY_CALIBRATION_MODE
            prompt "校准模式"
            default ESP_PHY_RF_CAL_PARTIAL
            help
                选择物理层校准模式。在射频初始化期间，默认使用部分校准方法进行射频校准。
                完全校准比部分校准多花费约 100ms。如果启动时间不是关键因素，建议使用完全校准方法。
                仅在设备从深度睡眠唤醒时才使用无校准方法。

            config ESP_PHY_RF_CAL_PARTIAL
                bool "部分校准"
            config ESP_PHY_RF_CAL_NONE
                bool "无校准"
            config ESP_PHY_RF_CAL_FULL
                bool "完全校准"
        endchoice #ESP_PHY_CALIBRATION_MODE

        config ESP_PHY_CALIBRATION_MODE
            int
            default 0 if ESP_PHY_RF_CAL_PARTIAL
            default 1 if ESP_PHY_RF_CAL_NONE
            default 2 if ESP_PHY_RF_CAL_FULL

        config ESP_PHY_IMPROVE_RX_11B
            bool "改善 Wi-Fi 接收 11b 数据包"
            default n
            depends on SOC_PHY_IMPROVE_RX_11B
            help
                这是一个解决方案，用于改善某些使用交流-直流电源且干扰较高的模块的 Wi-Fi 接收 11b 数据包性能。
                启用此选项将牺牲 Wi-Fi OFDM 接收性能。
                但在这种情况下，保证 11b 接收性能作为底线。

        config ESP_PHY_PLL_TRACK_DEBUG
            bool "启用 PLL 跟踪日志"
            default n
            help
                如果启用，在 PLL 跟踪期间将会有一些日志输出。

    endif
endmenu  # PHY
```
