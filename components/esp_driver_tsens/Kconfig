## components/esp_system/port/soc/esp32c3/Kconfig.cpu
```kconfig
choice ESP_DEFAULT_CPU_FREQ_MHZ
    prompt "CPU 频率"
    default ESP_DEFAULT_CPU_FREQ_MHZ_40 if IDF_ENV_FPGA
    default ESP_DEFAULT_CPU_FREQ_MHZ_160
    help
        应用程序启动时要设置的 CPU 频率。

    config ESP_DEFAULT_CPU_FREQ_MHZ_40
        bool "40 MHz"
        depends on IDF_ENV_FPGA
    config ESP_DEFAULT_CPU_FREQ_MHZ_80
        bool "80 MHz"
    config ESP_DEFAULT_CPU_FREQ_MHZ_160
        bool "160 MHz"
endchoice

config ESP_DEFAULT_CPU_FREQ_MHZ
    int
    default 40 if ESP_DEFAULT_CPU_FREQ_MHZ_40
    default 80 if ESP_DEFAULT_CPU_FREQ_MHZ_80
    default 160 if ESP_DEFAULT_CPU_FREQ_MHZ_160
```

## components/esp_system/port/soc/esp32s3/Kconfig.cache
```kconfig
menu "缓存配置"

    choice ESP32S3_INSTRUCTION_CACHE_SIZE
        prompt "指令缓存大小"
        default ESP32S3_INSTRUCTION_CACHE_16KB
        help
            应用程序启动时要设置的指令缓存大小。
            如果您使用16KB指令缓存而不是32KB指令缓存，
            那么另外的16KB将由堆分配器管理。

        config ESP32S3_INSTRUCTION_CACHE_16KB
            bool "16KB"
        config ESP32S3_INSTRUCTION_CACHE_32KB
            bool "32KB"
    endchoice

    config ESP32S3_INSTRUCTION_CACHE_SIZE
        hex
        default 0x4000 if ESP32S3_INSTRUCTION_CACHE_16KB
        default 0x8000 if ESP32S3_INSTRUCTION_CACHE_32KB

    choice ESP32S3_ICACHE_ASSOCIATED_WAYS
        prompt "指令缓存关联路数"
        default ESP32S3_INSTRUCTION_CACHE_8WAYS
        help
            应用程序启动时要设置的指令缓存关联路数。

        config ESP32S3_INSTRUCTION_CACHE_4WAYS
            bool "4路"
        config ESP32S3_INSTRUCTION_CACHE_8WAYS
            bool "8路"
    endchoice

    config ESP32S3_ICACHE_ASSOCIATED_WAYS
        int
        default 4 if ESP32S3_INSTRUCTION_CACHE_4WAYS
        default 8 if ESP32S3_INSTRUCTION_CACHE_8WAYS

    choice ESP32S3_INSTRUCTION_CACHE_LINE_SIZE
        prompt "指令缓存行大小"
        default ESP32S3_INSTRUCTION_CACHE_LINE_32B
        help
            应用程序启动时要设置的指令缓存行大小。

        config ESP32S3_INSTRUCTION_CACHE_LINE_16B
            bool "16字节"
            depends on ESP32S3_INSTRUCTION_CACHE_16KB
        config ESP32S3_INSTRUCTION_CACHE_LINE_32B
            bool "32字节"
    endchoice

    config ESP32S3_INSTRUCTION_CACHE_LINE_SIZE
        int
        default 16 if ESP32S3_INSTRUCTION_CACHE_LINE_16B
        default 32 if ESP32S3_INSTRUCTION_CACHE_LINE_32B

    config ESP32S3_INSTRUCTION_CACHE_WRAP
        bool       ## TODO IDF-4307
        default "n"
        depends on !SPIRAM_ECC_ENABLE
        help
            如果启用，指令缓存将使用包装模式读取SPI闪存或SPI RAM。
            包装长度等于ESP32S3_INSTRUCTION_CACHE_LINE_SIZE。
            然而，这取决于复杂的条件。

    choice ESP32S3_DATA_CACHE_SIZE
        prompt "数据缓存大小"
        default ESP32S3_DATA_CACHE_32KB
        help
            应用程序启动时要设置的数据缓存大小。
            如果您使用32KB数据缓存而不是64KB数据缓存，
            另外的32KB将被添加到堆中。

        config ESP32S3_DATA_CACHE_16KB
            bool "16KB"
        config ESP32S3_DATA_CACHE_32KB
            bool "32KB"
        config ESP32S3_DATA_CACHE_64KB
            bool "64KB"
    endchoice

    config ESP32S3_DATA_CACHE_SIZE
        hex
        # For 16KB the actual configuration is 32kb cache, but 16kb will be reserved for heap at startup
        default 0x8000 if ESP32S3_DATA_CACHE_16KB
        default 0x8000 if ESP32S3_DATA_CACHE_32KB
        default 0x10000 if ESP32S3_DATA_CACHE_64KB

    choice ESP32S3_DCACHE_ASSOCIATED_WAYS
        prompt "数据缓存关联路数"
        default ESP32S3_DATA_CACHE_8WAYS
        help
            应用程序启动时要设置的数据缓存关联路数。

        config ESP32S3_DATA_CACHE_4WAYS
            bool "4路"
        config ESP32S3_DATA_CACHE_8WAYS
            bool "8路"
    endchoice

    config ESP32S3_DCACHE_ASSOCIATED_WAYS
        int
        default 4 if ESP32S3_DATA_CACHE_4WAYS
        default 8 if ESP32S3_DATA_CACHE_8WAYS

    choice ESP32S3_DATA_CACHE_LINE_SIZE
        prompt "数据缓存行大小"
        default ESP32S3_DATA_CACHE_LINE_32B
        help
            应用程序启动时要设置的数据缓存行大小。

        config ESP32S3_DATA_CACHE_LINE_16B
            bool "16字节"
            depends on ESP32S3_DATA_CACHE_16KB || ESP32S3_DATA_CACHE_32KB
        config ESP32S3_DATA_CACHE_LINE_32B
            bool "32字节"
        config ESP32S3_DATA_CACHE_LINE_64B
            bool "64字节"
    endchoice

    config ESP32S3_DATA_CACHE_LINE_SIZE
        int
        default 16 if ESP32S3_DATA_CACHE_LINE_16B
        default 32 if ESP32S3_DATA_CACHE_LINE_32B
        default 64 if ESP32S3_DATA_CACHE_LINE_64B

    config ESP32S3_DATA_CACHE_WRAP
        bool        ## TODO IDF-4307
        default "n"
        depends on !SPIRAM_ECC_ENABLE
        help
            如果启用，数据缓存将使用包装模式读取SPI闪存或SPI RAM。
            包装长度等于ESP32S3_DATA_CACHE_LINE_SIZE。
            然而，这取决于复杂的条件。

endmenu  # Cache config
```
