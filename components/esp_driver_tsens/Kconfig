## components/esp_driver_tsens/Kconfig
```kconfig
menu "ESP-驱动：温度传感器配置"
    depends on SOC_TEMP_SENSOR_SUPPORTED

    config TEMP_SENSOR_ENABLE_DEBUG_LOG
        bool "启用调试日志"
        default n
        help
            是否为温度传感器驱动启用调试日志消息。
            注意，此选项仅控制温度传感器驱动的日志，不会影响其他驱动。

    config TEMP_SENSOR_ISR_IRAM_SAFE
        depends on SOC_TEMPERATURE_SENSOR_INTR_SUPPORT
        bool "温度传感器 ISR IRAM 安全"
        default n
        help
            通过允许中断处理程序在缓存禁用时（例如 SPI Flash 写入）可执行，
            确保温度传感器中断是 IRAM 安全的。

endmenu # TEMP_SENSOR Configuration
```

## components/esp_driver_uart/Kconfig
```kconfig
menu "ESP-驱动：UART 配置"

    config UART_ISR_IN_IRAM
        bool "将 UART ISR 函数放入 IRAM"
        depends on !RINGBUF_PLACE_ISR_FUNCTIONS_INTO_FLASH
        select VFS_SELECT_IN_RAM if VFS_SUPPORT_SELECT
        default n
        help
            如果未选择此选项，UART 中断将被禁用很长时间，
            并可能在执行 SPI 闪存操作时导致数据丢失。

endmenu
```

## components/esp_driver_usb_serial_jtag/Kconfig
```kconfig
menu "ESP-驱动：USB 串口/JTAG 配置"
    depends on SOC_USB_SERIAL_JTAG_SUPPORTED

    config USJ_ENABLE_USB_SERIAL_JTAG
        bool "启用 USB-串口-JTAG 模块"
        default y
        help
            ESP芯片上的USB-串口-JTAG模块在上电后默认开启。
            如果您的应用程序不需要它，也不依赖它作为系统控制台或使用内置JTAG进行调试，
            您可以禁用此选项，然后在启动时将禁用此模块的时钟，这将节省一些功耗。

    config USJ_NO_AUTO_LS_ON_CONNECTION
        bool "当USB串口/JTAG端口连接时不自动进入浅睡眠模式"
        depends on PM_ENABLE && ESP_CONSOLE_USB_SERIAL_JTAG_ENABLED && !SOC_USB_SERIAL_JTAG_SUPPORT_LIGHT_SLEEP \
            && USJ_ENABLE_USB_SERIAL_JTAG
        default n
        help
            如果启用，芯片将持续监控USB串口/JTAG端口的连接状态。只要USB串口/JTAG
            处于连接状态，就会获取一个ESP_PM_NO_LIGHT_SLEEP电源管理锁，以防止系统
            进入浅睡眠模式。
            当启用电源管理且需要通过USB串口/JTAG进行串口监控时，此选项可能会很有用，
            因为USB串口/JTAG在浅睡眠模式下无法工作，且从浅睡眠唤醒后也无法工作。
            注意：此选项只能控制自动浅睡眠行为。如果在程序中手动调用esp_light_sleep_start()，
            即使USB串口/JTAG正在使用，启用此选项也不会阻止进入浅睡眠模式。
endmenu # USB Serial/JTAG Configuration
```

## components/esp_eth/Kconfig
```kconfig
menu "以太网"

    # Invisible item that is enabled if any Ethernet selection is made
    config ETH_ENABLED
        bool

    menuconfig ETH_USE_ESP32_EMAC
        depends on SOC_EMAC_SUPPORTED
        bool "支持ESP32内部EMAC控制器"
        default y
        select ETH_ENABLED
        help
            ESP32集成了一个10/100M以太网MAC控制器。

    if ETH_USE_ESP32_EMAC
        choice ETH_PHY_INTERFACE
            prompt "PHY接口"
            default ETH_PHY_INTERFACE_RMII
            help
                选择MAC和PHY芯片之间的通信接口。

            config ETH_PHY_INTERFACE_RMII
                bool "简化媒体独立接口（RMII）"
        endchoice

        if ETH_PHY_INTERFACE_RMII
            choice ETH_RMII_CLK_MODE # IDF-9724
                depends on IDF_TARGET_ESP32
                prompt "RMII时钟模式"
                default ETH_RMII_CLK_INPUT
                help
                    选择外部或内部RMII时钟。

                config ETH_RMII_CLK_INPUT
                    bool "从外部输入RMII时钟"
                    help
                        MAC将从外部获取RMII时钟。
                        注意，ESP32只支持从GPIO0输入RMII时钟。

                config ETH_RMII_CLK_OUTPUT
                    bool "从内部输出RMII时钟"
                    help
                        ESP32可以通过内部APLL生成RMII时钟。
                        这个时钟可以路由到外部PHY设备。
                        ESP32支持将RMII时钟路由到GPIO0/16/17。
            endchoice
        endif # ETH_PHY_INTERFACE_RMII

        if ETH_RMII_CLK_INPUT
            config ETH_RMII_CLK_IN_GPIO
                depends on IDF_TARGET_ESP32
                int
                range 0 0
                default 0
                help
                    ESP32只支持从GPIO0输入RMII时钟。
        endif # ETH_RMII_CLK_INPUT

        if ETH_RMII_CLK_OUTPUT
            config ETH_RMII_CLK_OUTPUT_GPIO0
                depends on IDF_TARGET_ESP32
                bool "从GPIO0输出RMII时钟（实验性！）"
                default n
                help
                    GPIO0可以被设置为输出预分频的PLL时钟（仅用于测试！）。
                    启用此选项将配置GPIO0输出50MHz的时钟。
                    实际上，这个时钟与EMAC外设没有直接关系。
                    有时这个时钟可能无法与您的PHY芯片很好地配合。您可能需要在GPIO0之后
                    添加一些额外的设备（例如，反相器）。
                    注意，在GPIO0上输出RMII时钟是一种实验性做法。
                    如果您希望以太网与WiFi一起工作，为了稳定性，请不要选择GPIO0输出模式。

            if !ETH_RMII_CLK_OUTPUT_GPIO0
                config ETH_RMII_CLK_OUT_GPIO
                    depends on IDF_TARGET_ESP32
                    int "RMII时钟GPIO编号"
                    range 16 17
                    default 17
                    help
                        设置用于输出RMII时钟的GPIO编号。
            endif # !ETH_RMII_CLK_OUTPUT_GPIO0
        endif # ETH_RMII_CLK_OUTPUT

        config ETH_DMA_BUFFER_SIZE
            int "以太网DMA缓冲区大小（字节）"
            range 256 1600
            default 512
            help
                设置以太网MAC DMA使用的每个缓冲区的大小。
                !! 重要 !! 确保对于ESP32P4来说，它是64字节对齐的！

        config ETH_DMA_RX_BUFFER_NUM
            int "以太网DMA接收缓冲区数量"
            range 3 30
            default 10 if IDF_TARGET_ESP32
            default 20 if IDF_TARGET_ESP32P4 #ESP32P4 has smaller internal Rx FIFO
            help
                DMA接收缓冲区的数量。每个缓冲区的大小为ETH_DMA_BUFFER_SIZE。
                更多的缓冲区可能会在某种程度上提高吞吐量。

        config ETH_DMA_TX_BUFFER_NUM
            int "以太网DMA发送缓冲区数量"
            range 3 30
            default 10
            help
                DMA发送缓冲区的数量。每个缓冲区的大小为ETH_DMA_BUFFER_SIZE。
                更多的缓冲区可能会在某种程度上提高吞吐量。

        if ETH_DMA_RX_BUFFER_NUM > 15
            config ETH_SOFT_FLOW_CONTROL
                bool "启用软件流控制"
                default n
                help
                    ESP32上的以太网MAC引擎不具备流控制逻辑。
                    如果您启用此选项，MAC驱动程序可以执行软件流控制。
                    注意，如果RX缓冲区数量较小，启用软件流控制将导致明显的性能损失。
        endif

        config ETH_IRAM_OPTIMIZATION
            bool "启用IRAM优化"
            default n
            help
                如果启用，与RX/TX相关的函数将被放置到IRAM中。这可以提高以太网吞吐量。
                如果禁用，所有函数都将被放置到FLASH中。

    endif # ETH_USE_ESP32_EMAC

    menuconfig ETH_USE_SPI_ETHERNET
        bool "支持SPI转以太网模块"
        default y
        select ETH_ENABLED
        help
            ESP-IDF还可以支持一些SPI-以太网模块。

    if ETH_USE_SPI_ETHERNET
        config ETH_SPI_ETHERNET_DM9051
            bool "使用DM9051"
            help
                DM9051是一个具有SPI接口的快速以太网控制器。
                它还集成了10/100M PHY和MAC。
                选择此项以启用DM9051驱动程序。

        config ETH_SPI_ETHERNET_W5500
            bool "使用W5500（MAC原始模式）"
            help
                W5500是一个硬件TCP/IP嵌入式以太网控制器。
                TCP/IP协议栈、10/100以太网MAC和PHY都集成在一个芯片中。
                然而，ESP-IDF中的驱动程序只启用了原始MAC模式，
                使其与软件TCP/IP协议栈兼容。
                选择是以启用W5500驱动程序。

        config ETH_SPI_ETHERNET_KSZ8851SNL
            bool "使用KSZ8851SNL"
            help
                KSZ8851SNL是一个单芯片快速以太网控制器，由
                10/100物理层收发器（PHY）、MAC和串行外设接口（SPI）组成。
                选择此项以启用KSZ8851SNL驱动程序。
    endif # ETH_USE_SPI_ETHERNET

    menuconfig ETH_USE_OPENETH
        bool "支持OpenCores以太网MAC（用于QEMU）"
        default n
        select ETH_ENABLED
        help
            当ESP-IDF应用程序在QEMU中执行时，可以使用OpenCores以太网MAC驱动程序。
            在实际芯片上运行时不支持此驱动程序。

    if ETH_USE_OPENETH
        config ETH_OPENETH_DMA_RX_BUFFER_NUM
            int "以太网DMA接收缓冲区数量"
            range 1 64
            default 4
            help
                DMA接收缓冲区的数量，每个缓冲区大小为1600字节。

        config ETH_OPENETH_DMA_TX_BUFFER_NUM
            int "以太网DMA发送缓冲区数量"
            range 1 64
            default 1
            help
                DMA发送缓冲区的数量，每个缓冲区大小为1600字节。
    endif # ETH_USE_OPENETH

    config ETH_TRANSMIT_MUTEX
        depends on ETH_ENABLED
        bool "启用发送互斥锁"
        default n
        help
            当以太网接口作为共享资源使用，并且多个功能可能同时尝试访问它时，
            防止多次访问。
endmenu
```

## components/esp_event/Kconfig
```kconfig
menu "事件循环库"

    config ESP_EVENT_LOOP_PROFILING
        bool "启用事件循环分析"
        default n
        help
            在事件循环库中启用统计信息的收集，例如发布到/被事件循环接收的事件数量、涉及的回调数量、
            由于事件循环队列已满而丢弃的事件数量、事件处理程序的运行时间，以及每个事件处理程序的
            运行次数/运行时间。

    config ESP_EVENT_POST_FROM_ISR
        bool "支持从中断服务程序（ISR）发布事件"
        default y
        help
            启用从中断处理程序发布事件。

    config ESP_EVENT_POST_FROM_IRAM_ISR
        bool "支持从放置在IRAM中的中断服务程序（ISR）发布事件"
        default y
        depends on ESP_EVENT_POST_FROM_ISR
        help
            启用从放置在IRAM中的中断处理程序发布事件。启用此选项会将API函数esp_event_post和
            esp_event_post_to放置在IRAM中。

endmenu
```

## components/esp_gdbstub/Kconfig
```kconfig
menu "GDB 调试桩"

    # Hidden option which adds GDBStub on panic option to the "Panic handler behavior"
    # menu in the target component.
    config ESP_GDBSTUB_ENABLED
        bool
        default y

    config ESP_SYSTEM_GDBSTUB_RUNTIME
        bool "运行时 GDBStub"
        select ESP_GDBSTUB_ENABLED
        help
            启用内置 GDBStub。
            这允许使用串口调试目标设备：
            - 运行 'idf.py monitor'。
            - 等待设备初始化。
            - 按 Ctrl+C 中断执行并进入 GDB，连接到您的设备进行调试。
            注意：所有 UART 输入将由 GDBStub 处理。

    config ESP_GDBSTUB_SUPPORT_TASKS
        bool "通过 GDB Stub 启用列出 FreeRTOS 任务"
        depends on ESP_GDBSTUB_ENABLED
        default y
        help
            如果启用，GDBStub 可以向 GDB 提供 FreeRTOS 任务列表。
            可以使用 'info threads' 命令从 GDB 查询线程列表。
            注意，如果 GDB 任务列表被损坏，此功能可能无法工作。
            如果 GDBStub 失败，请尝试禁用此功能。

    config ESP_GDBSTUB_MAX_TASKS
        int "GDB Stub 支持的最大任务数"
        default 32
        depends on ESP_GDBSTUB_SUPPORT_TASKS
        help
            设置 GDB Stub 将支持的任务数量。

endmenu
```

## components/esp_http_client/Kconfig
```kconfig
menu "ESP HTTP 客户端"


    config ESP_HTTP_CLIENT_ENABLE_HTTPS
        bool "启用 HTTPS"
        default y
        help
            此选项将通过链接 esp-tls 库并初始化 SSL 传输来启用 HTTPS 协议

    config ESP_HTTP_CLIENT_ENABLE_BASIC_AUTH
        bool "启用 HTTP 基本认证"
        default n
        help
            此选项将启用 HTTP 基本认证。默认情况下它是禁用的，因为基本认证使用未加密的编码，
            所以在不使用 TLS 时会引入安全漏洞

    config ESP_HTTP_CLIENT_ENABLE_DIGEST_AUTH
        bool "启用 HTTP 摘要认证"
        default n
        help
            此选项将启用 HTTP 摘要认证。默认情况下它是启用的，但不建议使用此配置，
            因为密码可以从交换中推导出来，所以在不使用 TLS 时会引入安全漏洞

    config ESP_HTTP_CLIENT_ENABLE_CUSTOM_TRANSPORT
        bool "启用自定义传输"
        default n
        help
            此选项将启用注入自定义 tcp_transport 句柄，因此 HTTP 操作将在用户定义的
            传输抽象之上执行（如果已配置）

endmenu
```

## components/esp_http_server/Kconfig
```kconfig
menu "HTTP 服务器"

    config HTTPD_MAX_REQ_HDR_LEN
        int "最大 HTTP 请求头长度"
        default 512
        help
            这设置了服务器要处理的 HTTP 请求包中头部部分的最大支持大小

    config HTTPD_MAX_URI_LEN
        int "最大 HTTP URI 长度"
        default 512
        help
            这设置了服务器要处理的 HTTP 请求 URI 的最大支持大小

    config HTTPD_ERR_RESP_NO_DELAY
        bool "发送 HTTP 错误响应时使用 TCP_NODELAY 套接字选项"
        default y
        help
            使用 TCP_NODEALY 套接字选项确保 HTTP 错误响应在底层套接字关闭之前到达客户端。请注意，关闭此选项可能会导致多个测试失败

    config HTTPD_PURGE_BUF_LEN
        int "清除数据的临时缓冲区长度"
        default 32
        help
            这设置了用于接收和丢弃 HTTP 客户端在请求中发送的、但未被服务器 HTTP 请求处理程序处理的任何剩余数据的临时缓冲区的大小。

            如果剩余数据大于可用缓冲区大小，缓冲区将在多次迭代中填充。缓冲区应该小到足以放在栈上，但又要大到足以避免过多的迭代。

    config HTTPD_LOG_PURGE_DATA
        bool "在调试级别记录清除的内容数据"
        default n
        help
            启用此选项将在调试级别记录丢弃的二进制 HTTP 请求数据。
            对于大型内容数据，这可能不太理想，因为它会使日志变得混乱。

    config HTTPD_WS_SUPPORT
        bool "WebSocket 服务器支持"
        default n
        help
            这设置 WebSocket 服务器支持。

    config HTTPD_QUEUE_WORK_BLOCKING
        bool "httpd_queue_work 作为阻塞 API"
        help
            这使 httpd_queue_work() API 等待，直到 UDP 控制套接字上有可用的消息空间。
            它内部使用计数设置为 `LWIP_UDP_RECVMBOX_SIZE` 的计数信号量来实现这一点。
            此配置将略微改变 API 行为，以阻塞直到消息被传递到控制套接字。

endmenu
```

## components/esp_https_ota/Kconfig
```kconfig
menu "ESP HTTPS OTA"

    config ESP_HTTPS_OTA_DECRYPT_CB
        bool "提供解密回调"
        default n
        help
            暴露一个额外的回调，通过该回调可以在固件数据被OTA更新组件处理之前进行解密。
            这有助于集成外部加密相关格式，并从固件镜像中移除此类封装层。

    config ESP_HTTPS_OTA_ALLOW_HTTP
        bool "允许HTTP用于OTA（警告：仅用于测试目的，请阅读帮助）"
        default n
        help
            强烈建议保持HTTPS（以及服务器证书验证）启用。
            启用此选项可能带来以下潜在风险：
            - 与服务器之间的非加密通信通道
            - 接受来自具有虚假身份的服务器的固件升级镜像

endmenu
```

## components/esp_https_server/Kconfig
```kconfig
menu "ESP HTTPS 服务器"

    config ESP_HTTPS_SERVER_ENABLE
        bool "启用 ESP_HTTPS_SERVER 组件"
        depends on (ESP_TLS_USING_MBEDTLS && MBEDTLS_TLS_SERVER)
        help
            启用 ESP HTTPS 服务器组件

endmenu
```
