## components/esp_pm/Kconfig
```kconfig
menu "电源管理"
    config PM_ENABLE
        bool "支持电源管理"
        # SMP FreeRTOS currently does not support power management IDF-4997
        depends on (!FREERTOS_SMP && SOC_PM_SUPPORTED) || __DOXYGEN__
        default n
        help
            如果启用，应用程序将编译支持电源管理。
            此选项会增加运行时开销（增加中断延迟，
            进入空闲状态的时间更长），并且还会降低
            RTOS 滴答和用于计时的定时器的精确度。
            如果应用程序使用电源管理 API，请启用此选项。

    config PM_DFS_INIT_AUTO
        bool "在启动时启用动态频率缩放（DFS）"
        depends on PM_ENABLE
        default n
        help
            如果启用，启动代码将配置动态频率缩放。
            最大 CPU 频率设置为 DEFAULT_CPU_FREQ_MHZ 设置，
            最小频率设置为 XTAL 频率。
            如果禁用，DFS 将不会激活，直到应用程序
            使用 esp_pm_configure 函数进行配置。

    config PM_PROFILING
        bool "为 PM 锁启用分析计数器"
        depends on PM_ENABLE
        default n
        help
            如果启用，esp_pm_* 函数将跟踪每个电源管理锁
            持有的时间量，esp_pm_dump_locks 函数将打印此信息。
            此功能可用于分析哪些锁阻止芯片进入低功耗状态，
            并查看芯片在每种省电模式下花费的时间。
            此功能会产生一些运行时开销，因此通常应在生产版本中禁用。

    config PM_TRACE
        bool "使用 GPIO 启用 PM 调试跟踪"
        depends on PM_ENABLE
        default n
        help
            如果启用，一些 GPIO 将用于发出诸如 RTOS 滴答、
            频率切换、进入/退出空闲状态等事件的信号。
            请参阅 pm_trace.c 文件以获取 GPIO 列表。
            此功能旨在用于分析/调试电源管理实现的行为，
            应在应用程序中保持禁用状态。

    config PM_SLP_IRAM_OPT
        bool "将轻度睡眠相关代码放入内部 RAM"
        depends on SOC_LIGHT_SLEEP_SUPPORTED
        help
            如果启用，约 2.1KB 的轻度睡眠相关源代码将放入 IRAM，
            芯片在 160MHz CPU 频率下每次睡眠时间将延长 310us。
            当需要更低功耗且 IRAM 中有足够空间放置源代码时，
            可以使用此功能。

    config PM_RTOS_IDLE_OPT
        bool "将 RTOS 空闲相关代码放入内部 RAM"
        depends on FREERTOS_USE_TICKLESS_IDLE
        help
            如果启用，约 180 字节的 RTOS_IDLE 相关源代码将放入 IRAM，
            芯片在 160MHz CPU 频率下每次睡眠时间将延长 20us。
            当需要更低功耗且 IRAM 中有足够空间放置源代码时，
            可以使用此功能。

    config PM_SLP_DISABLE_GPIO
        bool "芯片睡眠时禁用所有 GPIO"
        depends on FREERTOS_USE_TICKLESS_IDLE
        help
            此功能旨在在自动睡眠时禁用所有 GPIO 引脚以获得更低的功耗模式。
            如果启用，芯片将在自动睡眠时禁用所有 GPIO 引脚，以减少约 200~300 uA 的电流。
            如果您希望在芯片睡眠时正常使用某些引脚作为芯片唤醒，
            可以调用 'gpio_sleep_sel_dis' 在这些引脚上禁用此功能。
            您也可以保持此功能开启，并调用 'gpio_sleep_set_direction' 和 'gpio_sleep_set_pull_mode'
            以在睡眠时使用不同的 GPIO 配置。
            警告：如果您想在 ESP32 上启用此选项，您应该首先启用 `GPIO_ESP32_SUPPORT_SWITCH_SLP_PULL`，
            否则您将无法切换上拉/下拉模式。

    config PM_SLP_DEFAULT_PARAMS_OPT
        bool
        default n

    config PM_CHECK_SLEEP_RETENTION_FRAME
        bool
        depends on (PM_POWER_DOWN_CPU_IN_LIGHT_SLEEP || \
            (SOC_CPU_IN_TOP_DOMAIN && PM_POWER_DOWN_PERIPHERAL_IN_LIGHT_SLEEP))
        default y if IDF_CI_BUILD
        default n
        help
            此选项对用户不可见，仅用于 CI 测试，
            在应用程序中启用它将增加睡眠和唤醒时间开销

    config PM_LIGHTSLEEP_RTC_OSC_CAL_INTERVAL
        int "每 N 次轻度睡眠校准 RTC_FAST/SLOW 时钟"
        default 1
        depends on PM_ENABLE
        range 1 128
        help
            此选项的值决定了启用电源管理时睡眠期间 RTC_FAST/SLOW 时钟的校准间隔。
            当配置为 N 时，RTC_FAST/SLOW 时钟将每 N 次轻度睡眠校准一次。
            减小此值将增加芯片处于活动状态的时间，从而增加芯片的平均功耗。
            增加此值可以降低平均功耗，但当外部环境发生剧烈变化且芯片 RTC_FAST/SLOW
            振荡器频率漂移时，可能会导致系统不稳定。

    config PM_POWER_DOWN_CPU_IN_LIGHT_SLEEP
        bool "在轻度睡眠中关闭 CPU 电源"
        depends on SOC_PM_SUPPORT_CPU_PD
        select PM_RESTORE_CACHE_TAGMEM_AFTER_LIGHT_SLEEP if ESP32S3_DATA_CACHE_16KB
        default y
        help
            如果启用，CPU 将在轻度睡眠中关闭电源，
            ESP 芯片支持在轻度睡眠前后保存和恢复 CPU 的运行上下文，
            该功能为应用程序提供无缝的 CPU 断电轻度睡眠，无需用户察觉。
            但这将占用一些内部内存。
            在 esp32c3 芯片上，启用此选项将消耗 1.68 KB 的内部 RAM，
            并将减少睡眠电流消耗约 100 uA。
            在 esp32s3 芯片上，启用此选项将消耗 8.58 KB 的内部 RAM，
            并将减少睡眠电流消耗约 650 uA。

    config PM_RESTORE_CACHE_TAGMEM_AFTER_LIGHT_SLEEP
        bool "在 CPU 轻度睡眠断电后恢复 I/D-cache 标记内存"
        depends on IDF_TARGET_ESP32S3 && PM_POWER_DOWN_CPU_IN_LIGHT_SLEEP
        default y
        help
            缓存标记内存和 CPU 都属于 CPU 电源域。
            ESP 芯片支持在睡眠前后保存和恢复缓存标记内存，
            此功能支持在 CPU 从断电轻度睡眠唤醒时，
            仍然可以缓存睡眠前已缓存的外部内存访问。
            此选项控制轻度睡眠中缓存标记内存的恢复方法。
            如果启用此选项，I/D-cache 标记内存将在睡眠前备份到内部 RAM，
            并在唤醒时恢复。
            根据缓存配置，如果启用此选项，
            它将消耗最多 9 KB 的内部 RAM。
            如果禁用此选项，所有缓存数据在睡眠后将不会保留，
            DCache 将在睡眠前回写并在睡眠后使所有缓存数据无效，
            唤醒后对外部内存（Flash/PSRAM）的所有访问将导致缓存未命中，
            由于增加的内存访问延迟，导致性能下降。

    config PM_POWER_DOWN_PERIPHERAL_IN_LIGHT_SLEEP
        bool "在轻度睡眠中关闭数字外设电源（实验性）"
        depends on SOC_PM_SUPPORT_TOP_PD && SOC_PAU_SUPPORTED
        select PM_POWER_DOWN_CPU_IN_LIGHT_SLEEP if !SOC_CPU_IN_TOP_DOMAIN
        default n #TODO: enable by default if periph init/deinit management supported (WIFI-5252)
        help
            如果启用，数字外设将在轻度睡眠中关闭电源，这将减少睡眠
            电流消耗约 100 uA。芯片将在睡眠/唤醒时保存/恢复寄存器上下文
            以保持系统运行。启用此选项将增加静态 RAM 和堆使用量，
            实际成本取决于您已初始化的外设。为了保存/恢复
            FreeRTOS 运行所需的必要硬件上下文，在睡眠时至少需要 4.55 KB 的可用堆。
            否则，睡眠将不会关闭外设电源。

            注1：请谨慎使用此选项，当前 IDF 不支持所有外设的保留。
            当数字外设断电并完成一次睡眠和唤醒时，
            未保存运行上下文的外设相当于执行了一次复位。
            !!! 在启用此选项之前，请确认您的应用程序中使用的外设及其睡眠保留支持状态，
            外设睡眠保留驱动程序支持状态在 power_management.rst 中进行跟踪

            注2：当此选项与 FREERTOS_USE_TICKLESS_IDLE 同时启用时，由于 UART 将
            断电，UART FIFO 将在睡眠前刷新以避免数据丢失，但这有
            可能阻塞睡眠过程并导致错过唤醒时间，这将导致从睡眠返回时
            freertos 的滴答不能正确补偿，并可能导致系统崩溃。
            为避免这种情况，您可以在 menuconfig 中增加 FREERTOS_IDLE_TIME_BEFORE_SLEEP 阈值。

    config PM_UPDATE_CCOMPARE_HLI_WORKAROUND
        bool
        default y if PM_ENABLE && BTDM_CTRL_HLI

    config PM_LIGHT_SLEEP_CALLBACKS
        bool "启用注册 pm 轻度睡眠回调"
        depends on FREERTOS_USE_TICKLESS_IDLE
        default n
        help
            如果启用，它允许用户注册进入和退出回调，这些回调在
            进入自动轻度睡眠之前和之后调用。

            注意：这些回调是从 IDLE 任务上下文执行的，因此您不能在回调中
            有任何阻塞调用。

            注意：启用这些回调可能会根据回调中花费的时间改变睡眠持续时间计算，
            因此强烈建议尽可能保持它们简短。

endmenu # "Power Management"
```

## components/esp_psram/Kconfig.spiram.common
```kconfig
# Common (non-chip-specific) SPIRAM options
#
# sourced into the "SPIRAM config" submenu for a specific chip.

config SPIRAM_BOOT_INIT
    bool "在启动期间初始化 SPI RAM"
    default "y"
    help
        如果启用此选项，SPI RAM 将在初始启动期间被启用。除非您有特殊要求，否则您会希望保持此选项启用，
        以便在启动过程中分配的内存也可以放置在 SPI RAM 中。

config SPIRAM_IGNORE_NOTFOUND
    bool "未找到 PSRAM 时忽略"
    default "n"
    depends on SPIRAM_BOOT_INIT && !SPIRAM_ALLOW_BSS_SEG_EXTERNAL_MEMORY && !SPIRAM_ALLOW_NOINIT_SEG_EXTERNAL_MEMORY
    help
        通常，如果在编译时启用了 psram 初始化但在运行时未找到，这将被视为错误并导致 CPU 崩溃。
        如果启用此选项，启动将完成，但不会有可用的 PSRAM。如果 PSRAM 初始化失败，以下配置可能会受到影响，
        可能需要手动更正。SPIRAM_TRY_ALLOCATE_WIFI_LWIP 将影响一些 LWIP 和 WiFi 缓冲区的默认值和范围值。
        启用 SPIRAM_TRY_ALLOCATE_WIFI_LWIP、ESP_WIFI_AMSDU_TX_ENABLED、ESP_WIFI_CACHE_TX_BUFFER_NUM 
        并使用静态 WiFi Tx 缓冲区可能会导致潜在的内存耗尽问题。
        建议禁用 SPIRAM_TRY_ALLOCATE_WIFI_LWIP。
        建议禁用 ESP_WIFI_AMSDU_TX_ENABLED。
        建议禁用 ESP_WIFI_CACHE_TX_BUFFER_NUM，
        需要清除 config->feature_caps 的 CONFIG_FEATURE_CACHE_TX_BUF_BIT。
        建议将 ESP_WIFI_TX_BUFFER 从静态更改为动态。还建议将一些缓冲区数量调整为不使用 PSRAM 时的值。
        例如，ESP_WIFI_STATIC_TX_BUFFER_NUM、ESP_WIFI_DYNAMIC_TX_BUFFER_NUM。

choice SPIRAM_USE
    prompt "SPI RAM 访问方法"
    default SPIRAM_USE_MALLOC
    help
        SPI RAM 可以通过多种方法访问：将其作为 CPU 内存映射中的未管理内存区域使用，
        将其集成到堆中作为需要 heap_caps_malloc 分配的"特殊"内存，
        或者完全集成使 malloc() 也能返回 SPI RAM 指针。

    config SPIRAM_USE_MEMMAP
        bool "将 RAM 集成到内存映射中"
    config SPIRAM_USE_CAPS_ALLOC
        bool "使 RAM 可通过 heap_caps_malloc(..., MALLOC_CAP_SPIRAM) 分配"
    config SPIRAM_USE_MALLOC
        bool "使 RAM 也可通过 malloc() 分配"
        select FREERTOS_SUPPORT_STATIC_ALLOCATION
endchoice

config SPIRAM_MEMTEST
    bool "在 SPI RAM 初始化时运行内存测试"
    default "y"
    depends on SPIRAM_BOOT_INIT
    help
        在初始化时运行一个基本的内存测试。当内存测试失败时中止。禁用此选项可以略微加快启动速度。

config SPIRAM_MALLOC_ALWAYSINTERNAL
    int "始终放入内部内存的最大 malloc() 大小（字节）"
    depends on SPIRAM_USE_MALLOC
    default 16384
    range 0 131072
    help
        如果 malloc() 能够分配 SPI 连接的 RAM，其分配策略将倾向于在内部内存中分配小于此大小的块，
        而大于此大小的分配将从外部 RAM 中进行。如果从首选区域分配失败，将尝试从非首选区域分配，
        因此当内部或外部内存已满时，malloc() 不会突然失败。

config SPIRAM_TRY_ALLOCATE_WIFI_LWIP
    bool "尝试首先在 SPIRAM 中分配 WiFi 和 LWIP 的内存。如果失败，则分配内部内存"
    depends on SPIRAM_USE_CAPS_ALLOC || SPIRAM_USE_MALLOC
    default "n"
    help
        尝试首先在 SPIRAM 中分配 WiFi 和 LWIP 的内存。如果失败，则尝试分配内部内存。

config SPIRAM_MALLOC_RESERVE_INTERNAL
    int "为特别需要在 DMA 或内部内存中的数据保留这么多字节"
    depends on SPIRAM_USE_MALLOC
    default 32768
    range 0 262144
    help
        由于外部/内部 RAM 分配策略并不总是完美的，有时可能会发生内部内存完全填满的情况。
        这会导致特别在内部内存中进行的分配失败，例如新任务的堆栈或用于服务 DMA 或在 SPI 缓存关闭时
        也可用的内存。此选项为这类请求保留一个专用池；当调用普通 malloc() 时，不会分配此池中的内存。

        将此设置为 0 以禁用此功能。

        请注意，由于 FreeRTOS 堆栈被强制使用内部内存，它们也将使用此内存池；
        在调整此值时请务必考虑这一点。

        还要注意，DMA 保留池可能不是一个连续的内存区域，这取决于配置的大小和应用程序的静态内存使用情况。

config SPIRAM_ALLOW_BSS_SEG_EXTERNAL_MEMORY
    bool "允许 .bss 段放置在外部内存中"
    default n
    depends on SPIRAM
    select ESP_ALLOW_BSS_SEG_EXTERNAL_MEMORY
    help
        如果启用，带有 EXT_RAM_BSS_ATTR 属性的变量将被放置在 SPIRAM 中，而不是内部 DRAM 中。
        `lwip`、`net80211`、`pp`、`bt` 库的 BSS 段将自动放置在 SPIRAM 中。
        其他对象文件和库的 BSS 段也可以通过链接器片段方案 `extram_bss` 放置在 SPIRAM 中。

        请注意，使用 EXT_RAM_BSS_ATTR 放置在 SPIRAM 中的变量将被初始化为零。

config SPIRAM_ALLOW_NOINIT_SEG_EXTERNAL_MEMORY
    bool "允许 .noinit 段放置在外部内存中"
    default n
    depends on SPIRAM
    help
        如果启用，noinit 变量可以使用 EXT_RAM_NOINIT_ATTR 放置在 PSRAM 中。

        请注意，放入此段的值在启动时不会被初始化，并且在软件重启后应保持其值。
```

## components/esp_ringbuf/Kconfig
```kconfig
menu "ESP 环形缓冲区"


    config RINGBUF_PLACE_FUNCTIONS_INTO_FLASH
        bool "将非 ISR 环形缓冲区函数放入闪存"
        default n
        help
            将非 ISR 环形缓冲区函数（如 xRingbufferCreate/xRingbufferSend）放入闪存。
            这可以释放 IRAM，但当缓存被禁用时，这些函数将无法被调用。


    config RINGBUF_PLACE_ISR_FUNCTIONS_INTO_FLASH
        bool "将 ISR 环形缓冲区函数放入闪存"
        depends on RINGBUF_PLACE_FUNCTIONS_INTO_FLASH
        default n
        help
            将 ISR 环形缓冲区函数（如 xRingbufferSendFromISR/xRingbufferReceiveFromISR）放入闪存。
            这可以释放 IRAM，但当缓存被禁用或从 IRAM 中断上下文调用时，这些函数将无法被调用。

            此选项与配置为从 IRAM 上下文运行 ISR 的 ESP-IDF 驱动程序不兼容，例如 CONFIG_UART_ISR_IN_IRAM。


endmenu
```

## components/esp_rom/Kconfig.projbuild
```kconfig
orsource "./$IDF_TARGET//Kconfig.soc_caps.in"

menu "引导 ROM 行为"
    visible if !IDF_TARGET_ESP32  # no options ere currently supported on ESP32

    choice BOOT_ROM_LOG_SCHEME
        prompt "永久更改引导 ROM 输出"
        default BOOT_ROM_LOG_ALWAYS_ON
        depends on !IDF_TARGET_ESP32
        help
            控制引导 ROM 日志行为。
            ROM 日志行为只能更改一次，
            特定的 eFuse 位将在应用程序引导阶段被烧录。

        config BOOT_ROM_LOG_ALWAYS_ON
            bool "始终记录日志"
            help
                始终打印 ROM 日志，这是默认行为。
        config BOOT_ROM_LOG_ALWAYS_OFF
            bool "永久禁用日志记录"
            help
                不打印 ROM 日志。
        config BOOT_ROM_LOG_ON_GPIO_HIGH
            bool "在 GPIO 高电平时记录日志"
            help
                在启动期间 GPIO 电平为高时打印 ROM 日志。
                GPIO 编号取决于芯片，
                例如，在 ESP32-S2 上，控制 GPIO 是 GPIO46。
        config BOOT_ROM_LOG_ON_GPIO_LOW
            bool "在 GPIO 低电平时记录日志"
            help
                在启动期间 GPIO 电平为低时打印 ROM 日志。
                GPIO 编号取决于芯片，
                例如，在 ESP32-S2 上，控制 GPIO 是 GPIO46。
    endchoice

endmenu  # Boot ROM Behavior
```
