## components/esptool_py/Kconfig.projbuild
```kconfig
menu "串口烧录器配置"
    depends on !APP_BUILD_TYPE_PURE_RAM_APP

    config ESPTOOLPY_NO_STUB
        bool "禁用下载存根"
        default "y" if IDF_ENV_FPGA || IDF_ENV_BRINGUP
        default "n"

        help
            烧录工具默认首先发送一个预编译的下载存根。该存根允许进行压缩下载等功能。
            通常您不需要禁用此功能。

    config ESPTOOLPY_OCT_FLASH
        depends on IDF_TARGET_ESP32S3
        bool "启用八线闪存"
        default n

    config ESPTOOLPY_FLASH_MODE_AUTO_DETECT
        depends on IDF_TARGET_ESP32S3
        bool "自动选择闪存模式（请阅读帮助）"
        default y
        help
            此配置选项有助于决定闪存是四线还是八线，但请注意一些限制：

            1. 如果闪存芯片是八线的，即使在 `ESPTOOLPY_FLASHMODE` 中选择了 "QIO"、"QOUT"、"DIO"、"DOUT" 
               选项之一，我们的代码也会自动将模式更改为 "OPI"，采样模式将为 STR。
            2. 如果闪存芯片是四线的，即使在 `ESPTOOLPY_FLASHMODE` 中选择了 "OPI"，我们的代码也会
               自动将模式更改为 "DIO"。
            3. 此选项主要是为了改善开发人员的开箱即用体验。它不保证功能完整。一些代码仍然依赖于
               `ESPTOOLPY_OCT_FLASH`。当您确定使用的是八线闪存时，请不要依赖此选项。
               在这种情况下，请启用 `ESPTOOLPY_OCT_FLASH` 选项，然后您可以在 `ESPTOOLPY_FLASH_SAMPLE_MODE`
               中选择 `DTR` 采样模式。否则，只有 `STR` 模式可用。
            4. 启用此功能会减少可用的内部 RAM 大小（约 900 字节）。
               如果您的 IRAM 空间不足，并且您了解您的闪存类型，
               请禁用此选项并选择相应的闪存类型选项。

    choice ESPTOOLPY_FLASHMODE
        prompt "闪存 SPI 模式"
        default ESPTOOLPY_FLASHMODE_DIO
        default ESPTOOLPY_FLASHMODE_OPI if ESPTOOLPY_OCT_FLASH
        help
            闪存芯片被烧录的模式，以及二进制文件运行的默认模式。

        config ESPTOOLPY_FLASHMODE_QIO
            depends on !ESPTOOLPY_OCT_FLASH
            bool "QIO"
        config ESPTOOLPY_FLASHMODE_QOUT
            depends on !ESPTOOLPY_OCT_FLASH
            bool "QOUT"
        config ESPTOOLPY_FLASHMODE_DIO
            depends on !ESPTOOLPY_OCT_FLASH
            bool "DIO"
        config ESPTOOLPY_FLASHMODE_DOUT
            depends on !ESPTOOLPY_OCT_FLASH
            bool "DOUT"
        config ESPTOOLPY_FLASHMODE_OPI
            depends on ESPTOOLPY_OCT_FLASH
            bool "OPI"
    endchoice

    choice ESPTOOLPY_FLASH_SAMPLE_MODE
        prompt "闪存采样模式"
        default ESPTOOLPY_FLASH_SAMPLE_MODE_DTR if ESPTOOLPY_OCT_FLASH
        default ESPTOOLPY_FLASH_SAMPLE_MODE_STR if !ESPTOOLPY_OCT_FLASH

        config ESPTOOLPY_FLASH_SAMPLE_MODE_STR
            bool "STR 模式"
        config ESPTOOLPY_FLASH_SAMPLE_MODE_DTR
            depends on ESPTOOLPY_OCT_FLASH
            bool "DTR 模式"
    endchoice

    # Note: we use esptool.py to flash bootloader in
    # dio mode for QIO/QOUT, bootloader then upgrades
    # itself to quad mode during initialisation
    config ESPTOOLPY_FLASHMODE
        string
        default "dio" if ESPTOOLPY_FLASHMODE_QIO
        default "dio" if ESPTOOLPY_FLASHMODE_QOUT
        default "dio" if ESPTOOLPY_FLASHMODE_DIO
        default "dout" if ESPTOOLPY_FLASHMODE_DOUT
        # The 1st and 2nd bootloader doesn't support opi mode,
        # using fastrd instead. For now the ESPTOOL doesn't support
        # fasted (see ESPTOOL-274), using dout instead. In ROM the flash mode
        # information get from efuse, so don't care this dout choice.
        default "dout" if ESPTOOLPY_FLASHMODE_OPI

    choice ESPTOOLPY_FLASHFREQ
        prompt "闪存 SPI 速度"
        # TODO: [ESP32C5] IDF-8649 switch back to 80M
        # TODO: [ESP32C61] IDF-9256
        default ESPTOOLPY_FLASHFREQ_40M if IDF_TARGET_ESP32 || IDF_TARGET_ESP32C5 || IDF_TARGET_ESP32C61
        default ESPTOOLPY_FLASHFREQ_80M if ESPTOOLPY_FLASHFREQ_80M_DEFAULT
        default ESPTOOLPY_FLASHFREQ_60M if IDF_TARGET_ESP32C2
        config ESPTOOLPY_FLASHFREQ_120M
            bool "120 MHz（请先阅读文档）"
            depends on SOC_MEMSPI_SRC_FREQ_120M && \
                (SPI_FLASH_HPM_ON || ESPTOOLPY_OCT_FLASH) && \
                (ESPTOOLPY_FLASH_SAMPLE_MODE_STR || IDF_EXPERIMENTAL_FEATURES)
            help
                - QSPI 闪存的可选功能。请先阅读文档并启用 `CONFIG_SPI_FLASH_HPM_ENA`！
                - 闪存 120 MHz SDR 模式是稳定的。
                - 闪存 120 MHz DDR 模式是一个实验性功能，它在温度稳定时工作。

                    风险：
                        如果您的芯片在某个温度下开机，然后温度升高或降低约 20 摄氏度（取决于芯片），
                        程序将随机崩溃。

        config ESPTOOLPY_FLASHFREQ_80M
            bool "80 MHz"
            depends on SOC_MEMSPI_SRC_FREQ_80M_SUPPORTED
        config ESPTOOLPY_FLASHFREQ_64M
            bool "64 MHz"
            depends on SOC_MEMSPI_SRC_FREQ_64M_SUPPORTED
        config ESPTOOLPY_FLASHFREQ_60M
            bool "60 MHz"
            depends on SOC_MEMSPI_SRC_FREQ_60M_SUPPORTED
        config ESPTOOLPY_FLASHFREQ_48M
            bool "48 MHz"
            depends on SOC_MEMSPI_SRC_FREQ_48M_SUPPORTED
        config ESPTOOLPY_FLASHFREQ_40M
            bool "40 MHz"
            depends on SOC_MEMSPI_SRC_FREQ_40M_SUPPORTED
        config ESPTOOLPY_FLASHFREQ_32M
            bool "32 MHz"
            depends on SOC_MEMSPI_SRC_FREQ_32M_SUPPORTED
        config ESPTOOLPY_FLASHFREQ_30M
            bool "30 MHz"
            depends on SOC_MEMSPI_SRC_FREQ_30M_SUPPORTED
        config ESPTOOLPY_FLASHFREQ_26M
            bool "26 MHz"
            depends on SOC_MEMSPI_SRC_FREQ_26M_SUPPORTED
        config ESPTOOLPY_FLASHFREQ_24M
            bool "24 MHz"
            depends on SOC_MEMSPI_SRC_FREQ_24M_SUPPORTED
        config ESPTOOLPY_FLASHFREQ_20M
            bool "20 MHz"
            depends on SOC_MEMSPI_SRC_FREQ_20M_SUPPORTED
        config ESPTOOLPY_FLASHFREQ_16M
            bool "16 MHz"
            depends on SOC_MEMSPI_SRC_FREQ_16M_SUPPORTED
        config ESPTOOLPY_FLASHFREQ_15M
            bool "15 MHz"
            depends on SOC_MEMSPI_SRC_FREQ_15M_SUPPORTED
    endchoice

    config ESPTOOLPY_FLASHFREQ_80M_DEFAULT
        bool
        default y if IDF_TARGET_ESP32S2 || IDF_TARGET_ESP32S3 || IDF_TARGET_ESP32C3 || IDF_TARGET_ESP32C6
        help
            这是一个不可见的项目，用于定义默认使用 80MHz 闪存 SPI 速度的目标。

    config ESPTOOLPY_FLASHFREQ
        string
        # On some of the ESP chips, max boot frequency would be equal to (or even lower than) 80m.
        # We currently define this to `80m`.
        default '80m' if ESPTOOLPY_FLASHFREQ_120M
        default '80m' if ESPTOOLPY_FLASHFREQ_80M
        default '60m' if ESPTOOLPY_FLASHFREQ_60M
        default '48m' if ESPTOOLPY_FLASHFREQ_64M # For 0xf in esptool
        default '48m' if ESPTOOLPY_FLASHFREQ_48M
        default '24m' if ESPTOOLPY_FLASHFREQ_32M # For 0x0 in esptool
        default '30m' if ESPTOOLPY_FLASHFREQ_30M
        default '24m' if ESPTOOLPY_FLASHFREQ_24M
        default '40m' if ESPTOOLPY_FLASHFREQ_40M
        default '26m' if ESPTOOLPY_FLASHFREQ_26M
        default '20m' if ESPTOOLPY_FLASHFREQ_20M
        default '12m' if ESPTOOLPY_FLASHFREQ_16M # For 0x2 in esptool
        default '20m' # if no clock can match in bin headers, go with minimal.


    choice ESPTOOLPY_FLASHSIZE
        prompt "闪存大小"
        default ESPTOOLPY_FLASHSIZE_2MB
        help
            SPI 闪存大小，以兆字节为单位

        config ESPTOOLPY_FLASHSIZE_1MB
            bool "1 MB"
        config ESPTOOLPY_FLASHSIZE_2MB
            bool "2 MB"
        config ESPTOOLPY_FLASHSIZE_4MB
            bool "4 MB"
        config ESPTOOLPY_FLASHSIZE_8MB
            bool "8 MB"
        config ESPTOOLPY_FLASHSIZE_16MB
            bool "16 MB"
        config ESPTOOLPY_FLASHSIZE_32MB
            bool "32 MB"
        config ESPTOOLPY_FLASHSIZE_64MB
            bool "64 MB"
        config ESPTOOLPY_FLASHSIZE_128MB
            bool "128 MB"
    endchoice

    config ESPTOOLPY_FLASHSIZE
        string
        default "1MB" if ESPTOOLPY_FLASHSIZE_1MB
        default "2MB" if ESPTOOLPY_FLASHSIZE_2MB
        default "4MB" if ESPTOOLPY_FLASHSIZE_4MB
        default "8MB" if ESPTOOLPY_FLASHSIZE_8MB
        default "16MB" if ESPTOOLPY_FLASHSIZE_16MB
        default "32MB" if ESPTOOLPY_FLASHSIZE_32MB
        default "64MB" if ESPTOOLPY_FLASHSIZE_64MB
        default "128MB" if ESPTOOLPY_FLASHSIZE_128MB

    config ESPTOOLPY_HEADER_FLASHSIZE_UPDATE
        bool "烧录引导加载程序时检测闪存大小"
        default n
        help
            如果设置此选项，在烧录项目时将自动检测目标芯片的闪存大小，
            并在烧录前更新引导加载程序镜像。

            启用此选项会关闭通过 SHA256 摘要保护镜像免受损坏的功能。
            在烧录前更新引导加载程序镜像会使摘要无效。

    choice ESPTOOLPY_BEFORE
        prompt "烧录前"
        default ESPTOOLPY_BEFORE_RESET
        help
            配置 esptool.py 是否应在烧录前重置 ESP32。

            自动重置取决于 RTS 和 DTR 信号是否从串口连接到 ESP32。
            大多数 USB 开发板内部都有这种连接。

        config ESPTOOLPY_BEFORE_RESET
            bool "重置到引导加载程序"
        config ESPTOOLPY_BEFORE_NORESET
            bool "不重置"
    endchoice

    config ESPTOOLPY_BEFORE
        string
        default "default_reset" if ESPTOOLPY_BEFORE_RESET
        default "no_reset" if ESPTOOLPY_BEFORE_NORESET

    choice ESPTOOLPY_AFTER
        prompt "烧录后"
        default ESPTOOLPY_AFTER_RESET
        help
            配置 esptool.py 是否应在烧录后重置 ESP32。

            自动重置取决于 RTS 和 DTR 信号是否从串口连接到 ESP32。
            大多数 USB 开发板内部都有这种连接。

        config ESPTOOLPY_AFTER_RESET
            bool "烧录后重置"
        config ESPTOOLPY_AFTER_NORESET
            bool "保持在引导加载程序中"
    endchoice

    config ESPTOOLPY_AFTER
        string
        default "hard_reset" if ESPTOOLPY_AFTER_RESET
        default "no_reset" if ESPTOOLPY_AFTER_NORESET

    config ESPTOOLPY_MONITOR_BAUD
        int
        default ESP_CONSOLE_UART_BAUDRATE if ESP_CONSOLE_UART
        default 115200 if !ESP_CONSOLE_UART
endmenu
```
