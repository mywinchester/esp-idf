## components/esp_wifi/Kconfig
```kconfig
menu "Wi-Fi"
    # TODO: Disable WIFI support on ESP32-H2 (WIFI-5796)
    # visible if SOC_WIFI_SUPPORTED

    config ESP_WIFI_ENABLED
        bool
        default y if SOC_WIFI_SUPPORTED

    config ESP_HOST_WIFI_ENABLED
        bool "启用主机 WiFi"
        depends on SOC_WIRELESS_HOST_SUPPORTED
        default n
        help
            选择此选项以启用主机 WiFi 功能。

    config ESP_WIFI_CONTROLLER_TARGET
        depends on ESP_HOST_WIFI_ENABLED
        string
        default "esp32"

    config ESP_WIFI_TARGET_ESP32
        depends on ESP_HOST_WIFI_ENABLED
        bool
        default y if ESP_WIFI_CONTROLLER_TARGET="esp32"

    if (ESP_WIFI_ENABLED || ESP_HOST_WIFI_ENABLED)

        config ESP_WIFI_STATIC_RX_BUFFER_NUM
            int "WiFi 静态 RX 缓冲区的最大数量"
            range 2 25 if !SOC_WIFI_HE_SUPPORT
            range 2 128 if SOC_WIFI_HE_SUPPORT
            default 10 if !SPIRAM_TRY_ALLOCATE_WIFI_LWIP
            default 16 if SPIRAM_TRY_ALLOCATE_WIFI_LWIP
            help
                设置 WiFi 静态 RX 缓冲区的数量。每个缓冲区大约占用 1.6KB 的 RAM。
                静态 RX 缓冲区在调用 esp_wifi_init 时分配，直到调用 esp_wifi_deinit 时才会释放。

                WiFi 硬件使用这些缓冲区接收所有 802.11 帧。
                更高的数量可能允许更高的吞吐量，但会增加内存使用。如果启用了 ESP_WIFI_AMPDU_RX_ENABLED，
                建议将此值设置为等于或大于 ESP_WIFI_RX_BA_WIN，以实现更好的吞吐量和与站点和 AP 的兼容性。

        config ESP_WIFI_DYNAMIC_RX_BUFFER_NUM
            int "WiFi 动态 RX 缓冲区的最大数量"
            range 0 128 if !LWIP_WND_SCALE
            range 0 1024 if LWIP_WND_SCALE
            default 32
            help
                设置 WiFi 动态 RX 缓冲区的数量，0 表示将分配无限数量的 RX 缓冲区
                （前提是有足够的可用 RAM）。每个动态 RX 缓冲区的大小取决于接收到的数据帧的大小。

                对于每个接收到的数据帧，WiFi 驱动程序会将其复制到 RX 缓冲区，然后将其传递给
                高层 TCP/IP 协议栈。在高层成功接收数据帧后，动态 RX 缓冲区会被释放。

                对于某些应用程序，WiFi 数据帧的接收速度可能快于应用程序处理的速度。
                在这些情况下，如果 RX 缓冲区数量无限（0），我们可能会耗尽内存。

                如果设置了动态 RX 缓冲区限制，它应该至少是静态 RX 缓冲区的数量。

        choice ESP_WIFI_TX_BUFFER
            prompt "WiFi TX 缓冲区类型"
            default ESP_WIFI_DYNAMIC_TX_BUFFER
            help
                选择 WiFi TX 缓冲区的类型：

                如果选择"静态"，WiFi TX 缓冲区在 WiFi 初始化时分配，在 WiFi 取消初始化时释放。
                每个静态 TX 缓冲区的大小固定为约 1.6KB。

                如果选择"动态"，每个 WiFi TX 缓冲区在 TCP/IP 协议栈向 WiFi 驱动程序传递数据帧时
                根据需要分配。在 WiFi 驱动程序发送数据帧后，缓冲区会被释放。每个动态 TX 缓冲区
                的大小取决于 TCP/IP 层发送的每个数据帧的长度。

                如果启用了 PSRAM，应选择"静态"以保证足够的 WiFi TX 缓冲区。
                如果禁用了 PSRAM，应选择"动态"以提高 RAM 的利用率。

            config ESP_WIFI_STATIC_TX_BUFFER
                bool "静态"
            config ESP_WIFI_DYNAMIC_TX_BUFFER
                bool "动态"
                depends on !SPIRAM_USE_MALLOC
        endchoice

        config ESP_WIFI_TX_BUFFER_TYPE
            int
            default 0 if ESP_WIFI_STATIC_TX_BUFFER
            default 1 if ESP_WIFI_DYNAMIC_TX_BUFFER

        config ESP_WIFI_STATIC_TX_BUFFER_NUM
            int "WiFi 静态 TX 缓冲区的最大数量"
            depends on ESP_WIFI_STATIC_TX_BUFFER
            range 1 64
            default 16
            help
                设置 WiFi 静态 TX 缓冲区的数量。每个缓冲区大约占用 1.6KB 的 RAM。
                静态 RX 缓冲区在调用 esp_wifi_init() 时分配，直到调用 esp_wifi_deinit() 时才会释放。

                对于从高层 TCP/IP 协议栈传输的每个数据帧，WiFi 驱动程序会在 TX 缓冲区中
                创建一个副本。对于某些应用程序，特别是 UDP 应用程序，上层可能会比 WiFi 层
                传输得更快。在这些情况下，我们可能会用完 TX 缓冲区。

        config ESP_WIFI_CACHE_TX_BUFFER_NUM
            int "WiFi 缓存 TX 缓冲区的最大数量"
            depends on SPIRAM
            range 16 128
            default 32
            help
                设置 WiFi 缓存 TX 缓冲区的数量。

                对于来自上层（如 LWIP 等）的每个 TX 数据包，WiFi 驱动程序需要分配一个静态 TX
                缓冲区并复制上层数据包。如果 WiFi 驱动程序无法分配静态 TX 缓冲区，它会将上层
                数据包缓存到专用缓冲区队列中，此选项用于配置缓存 TX 队列的大小。

        config ESP_WIFI_DYNAMIC_TX_BUFFER_NUM
            int "WiFi 动态 TX 缓冲区的最大数量"
            depends on ESP_WIFI_DYNAMIC_TX_BUFFER
            range 1 128
            default 32
            help
                设置 WiFi 动态 TX 缓冲区的数量。每个动态 TX 缓冲区的大小不固定，
                取决于每个传输数据帧的大小。

                对于从高层 TCP/IP 协议栈传输的每个帧，WiFi 驱动程序会在 TX 缓冲区中
                创建一个副本。对于某些应用程序，特别是 UDP 应用程序，上层可能会比 WiFi 层
                传输得更快。在这些情况下，我们可能会用完 TX 缓冲区。

        choice ESP_WIFI_MGMT_RX_BUFFER
            prompt "WiFi RX MGMT 缓冲区类型"
            default ESP_WIFI_STATIC_RX_MGMT_BUFFER
            help
                选择 WiFi RX MGMT 缓冲区的类型：

                如果选择"静态"，WiFi RX MGMT 缓冲区在 WiFi 初始化时分配，在 WiFi 取消初始化时释放。
                每个静态 RX MGMT 缓冲区的大小固定为约 500 字节。

                如果选择"动态"，每个 WiFi RX MGMT 缓冲区在接收到 MGMT 数据帧时根据需要分配。
                在 WiFi 驱动程序处理完 MGMT 数据帧后，MGMT 缓冲区会被释放。


            config ESP_WIFI_STATIC_RX_MGMT_BUFFER
                bool "静态"
            config ESP_WIFI_DYNAMIC_RX_MGMT_BUFFER
                bool "动态"
        endchoice

        config ESP_WIFI_DYNAMIC_RX_MGMT_BUF
            int
            default 0 if ESP_WIFI_STATIC_RX_MGMT_BUFFER
            default 1 if ESP_WIFI_DYNAMIC_RX_MGMT_BUFFER

        config ESP_WIFI_RX_MGMT_BUF_NUM_DEF
            int "WiFi RX MGMT 缓冲区的最大数量"
            range 1 10
            default 5
            help
                设置 WiFi RX_MGMT 缓冲区的数量。

                对于管理缓冲区，动态和静态管理缓冲区的数量是相同的。
                为了防止内存碎片，应首先将管理缓冲区类型设置为静态。

        config ESP_WIFI_CSI_ENABLED
            bool "WiFi CSI（信道状态信息）"
            depends on SOC_WIFI_CSI_SUPPORT
            default n
            help
                选择此选项以启用 CSI（信道状态信息）功能。CSI 大约需要
                CONFIG_ESP_WIFI_STATIC_RX_BUFFER_NUM KB 的 RAM。如果不使用 CSI，
                最好禁用此功能以节省内存。

        config ESP_WIFI_AMPDU_TX_ENABLED
            bool "WiFi AMPDU TX"
            default y
            help
                选择此选项以启用 AMPDU TX 功能


        config ESP_WIFI_TX_BA_WIN
            int "WiFi AMPDU TX BA 窗口大小"
            depends on ESP_WIFI_AMPDU_TX_ENABLED
            range 2 32 if !SOC_WIFI_HE_SUPPORT
            range 2 64 if SOC_WIFI_HE_SUPPORT
            default 6
            help
                设置 WiFi Block Ack TX 窗口的大小。通常，更大的值意味着更高的吞吐量，
                但会占用更多内存。大多数情况下，我们不应该更改默认值，除非有特殊原因，
                例如使用 iperf 等测试最大 UDP TX 吞吐量。对于屏蔽箱中的 iperf 测试，
                推荐值为 9~12。

        config ESP_WIFI_AMPDU_RX_ENABLED
            bool "WiFi AMPDU RX"
            default y
            help
                选择此选项以启用 AMPDU RX 功能

        config ESP_WIFI_RX_BA_WIN
            int "WiFi AMPDU RX BA 窗口大小"
            depends on ESP_WIFI_AMPDU_RX_ENABLED
            range 2 32 if !SOC_WIFI_HE_SUPPORT
            range 2 64 if SOC_WIFI_HE_SUPPORT
            default 6 if !SPIRAM_TRY_ALLOCATE_WIFI_LWIP
            default 16 if SPIRAM_TRY_ALLOCATE_WIFI_LWIP
            help
                设置 WiFi Block Ack RX 窗口的大小。通常，更大的值意味着更高的吞吐量和更好的
                兼容性，但会占用更多内存。大多数情况下，我们不应该更改默认值，除非有特殊原因，
                例如使用 iperf 等测试最大 UDP RX 吞吐量。对于屏蔽箱中的 iperf 测试，
                推荐值为 9~12。如果使用 PSRAM 并且优先在 PSRAM 中分配 WiFi 内存，
                默认值和最小值应为 16，以实现更好的吞吐量和与站点和 AP 的兼容性。

        config ESP_WIFI_AMSDU_TX_ENABLED
            bool "WiFi AMSDU TX"
            depends on SPIRAM
            default n
            help
                选择此选项以启用 AMSDU TX 功能

        config ESP_WIFI_NVS_ENABLED
            bool "WiFi NVS flash"
            default y
            help
                选择此选项以启用 WiFi NVS flash

        choice ESP_WIFI_TASK_CORE_ID
            depends on !FREERTOS_UNICORE
            prompt "WiFi 任务核心 ID"
            default ESP_WIFI_TASK_PINNED_TO_CORE_0
            help
                将 WiFi 任务固定到核心 0 或核心 1。

            config ESP_WIFI_TASK_PINNED_TO_CORE_0
                bool "核心 0"
            config ESP_WIFI_TASK_PINNED_TO_CORE_1
                bool "核心 1"
        endchoice

        config ESP_WIFI_SOFTAP_BEACON_MAX_LEN
            int "WiFi SoftAP 信标的最大长度"
            range 752 1256
            default 752
            help
                ESP-MESH 利用信标帧来检测和解决根节点冲突（参见文档）。然而，
                默认的信标帧长度一次只能容纳五个根节点标识符结构，这意味着
                一次最多可以检测到五个节点的根节点冲突。在发生超过五个根节点
                冲突的情况下，冲突解决过程将检测五个根节点，解决冲突，然后
                重新检测更多根节点。这个过程将重复进行，直到所有根节点冲突
                都得到解决。但是，这个过程通常会花费很长时间。

                为了解决这种情况，可以增加信标帧长度，以便同时检测更多的根节点。
                每增加一个根节点需要 36 字节，应该在默认信标帧长度 752 字节的
                基础上增加。例如，如果你想同时检测 10 个根节点，你需要将信标
                帧长度设置为 932（752+36*5）。

                设置更长的信标长度也有助于调试，因为可以更快地识别冲突的根节点。

        config ESP_WIFI_MGMT_SBUF_NUM
            int "WiFi 管理短缓冲区数量"
            range 6 32
            default 32
            help
                设置 WiFi 管理短缓冲区的数量。

        config ESP_WIFI_IRAM_OPT
            bool "WiFi IRAM 速度优化"
            default n if (BT_ENABLED && SPIRAM && IDF_TARGET_ESP32)
            default y
            help
                选择此选项将频繁调用的 Wi-Fi 库函数放置在 IRAM 中。
                当禁用此选项时，将节省超过 10KB 的 IRAM 内存，
                但 Wi-Fi 吞吐量将降低。

        config ESP_WIFI_EXTRA_IRAM_OPT
            bool "WiFi 额外 IRAM 速度优化"
            default y if SOC_WIFI_HE_SUPPORT
            default n
            help
                选择此选项将额外的频繁调用的 Wi-Fi 库函数放置在 IRAM 中。
                当禁用此选项时，将节省超过 5KB 的 IRAM 内存，
                但 Wi-Fi 吞吐量将降低。

        config ESP_WIFI_RX_IRAM_OPT
            bool "WiFi RX IRAM 速度优化"
            default n if (BT_ENABLED && SPIRAM && IDF_TARGET_ESP32)
            default y
            help
                选择此选项将频繁调用的 Wi-Fi 库 RX 函数放置在 IRAM 中。
                当禁用此选项时，将节省超过 17KB 的 IRAM 内存，
                但 Wi-Fi 性能将降低。

        config ESP_WIFI_ENABLE_WPA3_SAE
            bool "启用 WPA3-个人"
            default y
            select ESP_WIFI_MBEDTLS_CRYPTO
            help
                选择此选项允许设备与符合条件的 AP 建立 WPA3-个人连接。
                PMF（受保护管理帧）是 WPA3 连接的先决条件功能，在尝试连接之前
                需要显式配置。请参阅 Wi-Fi 驱动程序 API 指南了解详细信息。

        config ESP_WIFI_ENABLE_SAE_PK
            bool "启用 SAE-PK"
            default y
            depends on ESP_WIFI_ENABLE_WPA3_SAE
            help
                选择此选项以启用 SAE-PK

        config ESP_WIFI_SOFTAP_SAE_SUPPORT
            bool "启用 WPA3 个人(SAE) SoftAP"
            default y
            depends on ESP_WIFI_ENABLE_WPA3_SAE
            depends on ESP_WIFI_SOFTAP_SUPPORT
            help
                选择此选项以在软 AP 模式下启用 SAE 支持。

        config ESP_WIFI_ENABLE_WPA3_OWE_STA
            bool "启用 OWE STA"
            default y
            select ESP_WIFI_MBEDTLS_CRYPTO
            help
                选择此选项允许设备与符合条件的 AP 建立 OWE 连接。
                PMF（受保护管理帧）是 WPA3 连接的先决条件功能，在尝试连接之前
                需要显式配置。请参阅 Wi-Fi 驱动程序 API 指南了解详细信息。

        config ESP_WIFI_SLP_IRAM_OPT
            bool "WiFi SLP IRAM 速度优化"
            select PM_SLP_DEFAULT_PARAMS_OPT
            select PERIPH_CTRL_FUNC_IN_IRAM
            default y if SOC_WIFI_HE_SUPPORT
            help
                选择此选项将调用的 Wi-Fi 库 TBTT 处理和接收信标函数放置在 IRAM 中。
                一些函数可以通过 ESP_WIFI_IRAM_OPT 和 ESP_WIFI_RX_IRAM_OPT 或此选项放置在 IRAM 中。
                如果已启用 ESP_WIFI_IRAM_OPT，此选项将占用额外的 7.3KB IRAM 内存。
                如果已启用 ESP_WIFI_RX_IRAM_OPT，此选项将占用额外的 1.3KB IRAM 内存。
                如果两者都未启用，此选项将占用额外的 7.4KB IRAM 内存。
                如果启用此选项，Wi-Fi 省电模式的平均电流将降低。

        config ESP_WIFI_SLP_DEFAULT_MIN_ACTIVE_TIME
            int "最小活动时间"
            range 8 60
            default 50
            help
                仅适用于 WIFI_PS_MIN_MODEM 或 WIFI_PS_MAX_MODEM 模式下的站点。当站点进入活动状态时，
                它将至少工作 ESP_WIFI_SLP_DEFAULT_MIN_ACTIVE_TIME。如果在此期间接收或发送数据包，
                时间将被刷新。如果时间到了，但站点仍有数据包要接收或发送，时间也会被刷新。单位：毫秒。

        config ESP_WIFI_SLP_DEFAULT_MAX_ACTIVE_TIME
            int "最大保持活动时间"
            range 10 60
            default 10
            help
                仅适用于 WIFI_PS_MIN_MODEM 或 WIFI_PS_MAX_MODEM 模式下的站点。如果在
                ESP_WIFI_SLP_DEFAULT_MAX_ACTIVE_TIME 内没有发送数据包，将发送一个空数据包
                以维持与 AP 的连接。单位：秒。

        config ESP_WIFI_SLP_DEFAULT_WAIT_BROADCAST_DATA_TIME
            int "最小等待广播数据时间"
            range 10 30
            default 15
            help
                仅适用于 WIFI_PS_MIN_MODEM 或 WIFI_PS_MAX_MODEM 模式下的站点。当站点通过信标知道 AP 将发送广播包时，
                它将在进入睡眠过程之前等待 ESP_WIFI_SLP_DEFAULT_WAIT_BROADCAST_DATA_TIME。如果接收到带有更多数据位的
                广播包，时间将被刷新。单位：毫秒。

        config ESP_WIFI_FTM_ENABLE
            bool "WiFi FTM"
            default n
            depends on SOC_WIFI_FTM_SUPPORT
            help
                启用精确定时测量功能，用于计算 WiFi 往返时间（RTT）。

        config ESP_WIFI_FTM_INITIATOR_SUPPORT
            bool "FTM 发起者支持"
            default y
            depends on ESP_WIFI_FTM_ENABLE

        config ESP_WIFI_FTM_RESPONDER_SUPPORT
            bool "FTM 响应者支持"
            default y
            depends on ESP_WIFI_FTM_ENABLE

        config ESP_WIFI_STA_DISCONNECTED_PM_ENABLE
            bool "断开连接时的站点电源管理"
            default y
            help
                选择此选项以在站点断开连接时启用电源管理。
                当射频模块不再使用时，芯片将进入调制解调器睡眠模式。

        config ESP_WIFI_GCMP_SUPPORT
            bool "WiFi GCMP 支持（GCMP128 和 GCMP256）"
            default n
            depends on SOC_WIFI_GCMP_SUPPORT
            help
                选择此选项以启用 GCMP 支持。GCMP 支持是 WiFi Suite-B 支持的必要条件。

        config ESP_WIFI_GMAC_SUPPORT
            bool "WiFi GMAC 支持（GMAC128 和 GMAC256）"
            default y
            help
                选择此选项以启用 GMAC 支持。GMAC 支持是 WiFi 192 位认证的必要条件。

        config ESP_WIFI_SOFTAP_SUPPORT
            bool "WiFi SoftAP 支持"
            default y
            help
                WiFi 模块可以在不包含 SoftAP 的情况下编译以节省代码大小。

        config ESP_WIFI_ENHANCED_LIGHT_SLEEP
            bool "WiFi 调制解调器自动接收信标"
            default n
            depends on ESP_PHY_MAC_BB_PD && SOC_PM_SUPPORT_BEACON_WAKEUP
            help
                WiFi 调制解调器在浅睡眠期间自动接收信标帧。

        config ESP_WIFI_SLP_BEACON_LOST_OPT
            bool "信标丢失时的 WiFi 睡眠优化"
            help
                当发生信标丢失时启用 WiFi 睡眠优化，并在 WiFi 模块检测到信标丢失时立即进入睡眠模式。

        config ESP_WIFI_SLP_BEACON_LOST_TIMEOUT
            int "信标丢失超时"
            range 5 100
            default 10
            depends on ESP_WIFI_SLP_BEACON_LOST_OPT
            help
                发生信标丢失时关闭射频物理层的超时时间，单位：1024 微秒。

        config ESP_WIFI_SLP_BEACON_LOST_THRESHOLD
            int "允许的最大连续丢失信标数"
            range 0 8
            default 3
            depends on ESP_WIFI_SLP_BEACON_LOST_OPT
            help
                允许的最大连续丢失信标数，当连续丢失的信标数大于给定阈值时，WiFi 保持接收状态。

        config ESP_WIFI_SLP_PHY_ON_DELTA_EARLY_TIME
            int "射频物理层开启的提前时间"
            range 0 100
            default 2
            depends on ESP_WIFI_SLP_BEACON_LOST_OPT && SOC_WIFI_SUPPORT_VARIABLE_BEACON_WINDOW
            help
                射频物理层开启的提前时间，当信标丢失时，下一次射频物理层开启将比配置项指定的时间提前，单位：32 微秒。

        config ESP_WIFI_SLP_PHY_OFF_DELTA_TIMEOUT_TIME
            int "射频物理层关闭的延迟时间"
            range 0 8
            default 2
            depends on ESP_WIFI_SLP_BEACON_LOST_OPT && SOC_WIFI_SUPPORT_VARIABLE_BEACON_WINDOW
            help
                射频物理层关闭的延迟时间，当信标丢失时，下一次射频物理层关闭将延迟配置项指定的时间，单位：1024 微秒。

        config ESP_WIFI_ESPNOW_MAX_ENCRYPT_NUM
            int "ESPNOW 最大加密对等点数量"
            range 0 4 if IDF_TARGET_ESP32C2
            range 0 17 if (!IDF_TARGET_ESP32C2)
            default 2 if IDF_TARGET_ESP32C2
            default 7 if (!IDF_TARGET_ESP32C2)
            help
                ESPNOW 支持的最大加密对等点数量。
                加密的硬件密钥数量是固定的。ESPNOW 和 SoftAP 共享相同的硬件密钥。因此，此配置将影响 SoftAP 的最大连接数。
                最大 ESPNOW 加密对等点数量 + SoftAP 的最大连接数 = 最大硬件密钥数量。
                当使用 ESP mesh 时，此值应设置为最大 6。

        config ESP_WIFI_NAN_ENABLE
            bool "WiFi Aware"
            default n
            depends on SOC_WIFI_NAN_SUPPORT
            help
                启用 WiFi Aware（NAN）功能。

        config ESP_WIFI_MBEDTLS_CRYPTO
            bool "使用 MbedTLS 加密 API"
            default y
            select MBEDTLS_AES_C
            select MBEDTLS_ECP_C
            select MBEDTLS_ECDH_C
            select MBEDTLS_ECDSA_C
            select MBEDTLS_CMAC_C
            select MBEDTLS_ECP_DP_SECP256R1_ENABLED
            help
                选择此选项以启用使用 MbedTLS 加密 API。
                认证器内部的加密支持有限，可能不足以支持所有新的安全功能，包括 WPA3。

                建议始终保持此选项启用。此外，请注意 MbedTLS 可以利用硬件加速（如果可用），
                从而显著加快加密操作。

        if ESP_WIFI_MBEDTLS_CRYPTO
            config ESP_WIFI_MBEDTLS_TLS_CLIENT
                bool "使用 MbedTLS TLS 客户端进行 WiFi 企业连接"
                depends on ESP_WIFI_ENTERPRISE_SUPPORT
                default y
                select MBEDTLS_TLS_ENABLED
                help
                    选择此选项以使用 MbedTLS TLS 客户端进行 WPA2 企业连接。
                    请注意，从 MbedTLS-3.0 开始，MbedTLS 不再支持 SSL-3.0、TLS-v1.0 和 TLS-v1.1 版本。
                    如果您的服务器使用这些版本之一，建议更新您的服务器。
                    如果需要与旧版 TLS 兼容，请禁用此选项。

            config ESP_WIFI_EAP_TLS1_3
                bool "为 WiFi 企业连接启用 EAP-TLS v1.3 支持"
                default n
                select MBEDTLS_SSL_PROTO_TLS1_3
                depends on ESP_WIFI_MBEDTLS_TLS_CLIENT && IDF_EXPERIMENTAL_FEATURES
                help
                    选择此选项以支持 EAP 与 TLS v1.3。
                    此配置仍然支持与 EAP-TLS v1.2 的兼容性。
                    请注意，启用此配置将导致每个使用 TLS 的应用程序都使用 TLS1.3（如果服务器支持）。
                    TLS1.3 在 mbedtls 中仍在开发中，可能存在互操作性问题。如果您希望仅为 WiFi 连接启用 TLS1.3，
                    请修改您的应用程序以将最大版本设置为 TLS1.2。

        endif

        config ESP_WIFI_WAPI_PSK
            bool "启用 WAPI PSK 支持"
            depends on SOC_WIFI_WAPI_SUPPORT
            default n
            help
                选择此选项以启用 WAPI-PSK，
                这是中国无线局域网国家标准加密（GB 15629.11-2003）。

        config ESP_WIFI_SUITE_B_192
            bool "启用 192 位密钥的 NSA suite B 支持"
            default n
            depends on SOC_WIFI_GCMP_SUPPORT
            select ESP_WIFI_GCMP_SUPPORT
            select ESP_WIFI_GMAC_SUPPORT
            help
                选择此选项以启用 192 位 NSA suite-B。
                这对于支持 WPA3 192 位安全是必要的。

        config ESP_WIFI_11KV_SUPPORT
            bool "启用 802.11k、802.11v API 支持"
            default n
            help
                选择此选项以启用 802.11k 802.11v API（RRM 和 BTM 支持）。
                目前仅支持对网络辅助漫游有帮助的 API。
                在 sta 配置中启用 BTM 和 RRM 的同时启用此选项，
                以使设备为网络辅助漫游做好准备。
                BTM：BSS 转换管理使 AP 能够请求站点转换到特定的 AP，
                或向站点指示一组首选的 AP。
                RRM：无线电测量使 STA 能够了解无线电环境，
                它使 STA 能够观察和收集有关无线电链路性能和无线电环境的数据。
                当前实现添加了信标报告、链路测量、邻居报告。

        config ESP_WIFI_SCAN_CACHE
            bool "在缓存中保留扫描结果"
            depends on ESP_WIFI_11KV_SUPPORT
            default n
            help
                在缓存中保留扫描结果，如果未启用，这些结果将立即被刷新。

        config ESP_WIFI_MBO_SUPPORT
            bool "启用多频段操作认证支持"
            default n
            select ESP_WIFI_11KV_SUPPORT
            select ESP_WIFI_SCAN_CACHE
            help
                选择此选项以启用 WiFi 多频段操作认证支持。

        config ESP_WIFI_ENABLE_ROAMING_APP
            bool "高级 Wi-Fi 漫游支持（实验性）"
            depends on IDF_EXPERIMENTAL_FEATURES
            default n
            select ESP_WIFI_SCAN_CACHE
            help
                启用 Espressif 的漫游应用程序以实现高效的 Wi-Fi 漫游。
                这包括可配置的定期环境扫描、维护最佳 AP 缓存、处理低 RSSI 事件等。

                风险警告
                请注意，此功能仍处于实验阶段，启用它可能会导致不可预测的扫描、连接和漫游尝试。
                我们仍在调整和优化此功能，以确保可靠和稳定的使用。

        menu "配置漫游应用程序"
            depends on ESP_WIFI_ENABLE_ROAMING_APP
            rsource "wifi_apps/roaming_app/src/Kconfig.roaming"
        endmenu

        config ESP_WIFI_DPP_SUPPORT
            bool "启用 DPP 支持"
            default n
            select ESP_WIFI_MBEDTLS_CRYPTO
            help
                选择此选项以启用 WiFi Easy Connect 支持。

        config ESP_WIFI_11R_SUPPORT
            bool "启用 802.11R（快速过渡）支持"
            default n
            help
                选择此选项以启用 WiFi 快速过渡支持。

        config ESP_WIFI_WPS_SOFTAP_REGISTRAR
            bool "在 SoftAP 模式下添加 WPS 注册器支持"
            depends on ESP_WIFI_SOFTAP_SUPPORT
            default n
            help
                选择此选项以在软 AP 模式下启用 WPS 注册器支持。

        config ESP_WIFI_ENABLE_WIFI_TX_STATS
            bool "启用 Wi-Fi 传输统计"
            depends on SOC_WIFI_HE_SUPPORT
            default n
            help
                启用 Wi-Fi 传输统计。总共支持 4 个访问类别。每个访问类别将使用 346 字节内存。

        config ESP_WIFI_ENABLE_WIFI_RX_STATS
            bool "启用 Wi-Fi 接收统计"
            depends on SOC_WIFI_HE_SUPPORT
            default n
            help
                启用 Wi-Fi 接收统计。总共支持 2 个访问类别。每个访问类别将使用 190 字节内存。

        config ESP_WIFI_ENABLE_WIFI_RX_MU_STATS
            bool "启用 Wi-Fi DL MU-MIMO 和 DL OFDMA 接收统计"
            depends on ESP_WIFI_ENABLE_WIFI_RX_STATS
            default n
            help
                启用 Wi-Fi DL MU-MIMO 和 DL OFDMA 接收统计。将使用 10932 字节内存。

        config ESP_WIFI_TX_HETB_QUEUE_NUM
            int "用于 STA HE TB PPDU 传输的 WiFi TX HE TB 队列数量"
            depends on SOC_WIFI_HE_SUPPORT
            range 1 4
            default 3
            help
                设置 STA 在 HE TB PPDU 携带的 A-MPDU 中可以聚合的最大队列数量。

        config ESP_WIFI_ENABLE_DUMP_HESIGB
            bool "启用 Wi-Fi 转储 DL HE MU PPDU 中包含的 HE-SIGB"
            depends on SOC_WIFI_HE_SUPPORT_5G
            default "n"
            help
                启用 Wi-Fi 转储 DL HE MU PPDU 中包含的 HE-SIGB。

        config ESP_WIFI_ENABLE_DUMP_MU_CFO
            bool "启用 Wi-Fi 转储 MU CFO"
            depends on SOC_WIFI_HE_SUPPORT_5G
            default "n"
            help
                启用 Wi-Fi 转储 MU CFO。

        config ESP_WIFI_ENABLE_DUMP_CTRL_NDPA
            bool "启用 Wi-Fi 转储 NDPA 帧"
            depends on SOC_WIFI_HE_SUPPORT_5G
            default "n"
            help
                启用 Wi-Fi 转储 NDPA 帧。

        config ESP_WIFI_ENABLE_DUMP_CTRL_BFRP
            bool "启用 Wi-Fi 转储 BFRP 帧"
            depends on SOC_WIFI_HE_SUPPORT_5G
            default "n"
            help
                启用 Wi-Fi 转储 BFRP 帧。

        menu "WPS 配置选项"
            config ESP_WIFI_WPS_STRICT
                bool "严格验证所有 WPS 属性"
                default n
                help
                    选择此选项以启用严格验证每个 WPS 属性。
                    禁用此选项将添加与各种 AP 的解决方法。
                    启用此选项可能会导致与某些 AP 的互操作性问题。

            config ESP_WIFI_WPS_PASSPHRASE
                bool "在 WPS 配置中获取 WPA2 密码"
                default n
                help
                    选择此选项以在 WPS 配置期间获取密码。
                    此选项模拟虚拟显示功能以获取密码模式下的配置。
                    不建议使用，因为 WPS 凭据不应与其他设备共享，
                    以可读格式提供会增加风险，而且密码需要使用 pbkdf2 转换为 psk。

        endmenu # "WPS Configuration Options"


        config ESP_WIFI_DEBUG_PRINT
            bool "打印 WPA Supplicant 的调试消息"
            default n
            help
                选择此选项以打印来自 WPA supplicant 的日志信息，
                这包括握手信息和密钥十六进制转储，具体取决于项目日志级别。

                启用此选项可能会增加构建大小约 60kb，
                具体取决于项目日志级别。

        config ESP_WIFI_TESTING_OPTIONS
            bool "添加 DPP 测试代码"
            default n
            help
                选择此选项以启用 DPP 的单元测试。

        config ESP_WIFI_ENTERPRISE_SUPPORT
            bool "启用企业选项"
            default y
            help
                选择此选项以启用/禁用企业连接支持。

                禁用此选项将减小二进制文件大小。
                禁用此选项将禁用使用任何 esp_wifi_sta_wpa2_ent_*（因为 API 将变得毫无意义）

                请注意，在没有加密硬件加速的低功耗芯片上使用较大的证书时，
                建议调整任务看门狗定时器（TWDT）（如果已启用）。有关精确的时间要求信息，
                您可以在 https://github.com/espressif/mbedtls/wiki/Performance-Numbers 查看性能数据。

        config ESP_WIFI_ENT_FREE_DYNAMIC_BUFFER
            bool "在 WiFi 企业连接期间释放动态缓冲区"
            depends on ESP_WIFI_ENTERPRISE_SUPPORT
            default y if IDF_TARGET_ESP32C2
            default n if !IDF_TARGET_ESP32C2
            help
                选择此配置以在 WiFi 企业连接期间释放动态缓冲区。
                这将使芯片能够在 WiFi 企业连接期间减少堆内存消耗。

    endif # wifi enabled

endmenu # Wi-Fi
```
