## components/newlib/Kconfig
```kconfig
menu "Newlib"

    choice NEWLIB_STDOUT_LINE_ENDING
        prompt "UART输出的行结束符"
        default NEWLIB_STDOUT_LINE_ENDING_CRLF
        help
            此选项允许配置当stdout上出现换行符（'\n'，LF）时发送到UART的所需行结束符。
            有三种可能的选项：

            CRLF：每当遇到LF时，在其前面加上CR

            LF：不进行修改，按原样发送stdout

            CR：将每次出现的LF替换为CR

            此选项不影响UART驱动程序（drivers/uart.h）的行为。

        config NEWLIB_STDOUT_LINE_ENDING_CRLF
            bool "CRLF"
        config NEWLIB_STDOUT_LINE_ENDING_LF
            bool "LF"
        config NEWLIB_STDOUT_LINE_ENDING_CR
            bool "CR"
    endchoice

    choice NEWLIB_STDIN_LINE_ENDING
        prompt "UART输入的行结束符"
        default NEWLIB_STDIN_LINE_ENDING_CR
        help
            此选项允许配置在UART上产生stdin换行符（'\n'，LF）的输入序列。
            有三种可能的选项：

            CRLF：CRLF被转换为LF

            LF：不进行修改，输入按原样发送到stdin

            CR：将每次出现的CR替换为LF

            此选项不影响UART驱动程序（drivers/uart.h）的行为。

        config NEWLIB_STDIN_LINE_ENDING_CRLF
            bool "CRLF"
        config NEWLIB_STDIN_LINE_ENDING_LF
            bool "LF"
        config NEWLIB_STDIN_LINE_ENDING_CR
            bool "CR"
    endchoice

    config NEWLIB_NANO_FORMAT
        bool "为printf/scanf系列函数启用'nano'格式化选项"
        default y if IDF_TARGET_ESP32C2
        help
            在大多数芯片中，ROM包含newlib C库的部分内容，包括printf/scanf系列函数。
            这些函数已经使用所谓的"nano"格式化选项进行编译。此选项不支持64位整数格式和C99特性，
            如位置参数。

            有关"nano"格式化选项的更多详细信息，请参阅newlib自述文件，
            搜索'--enable-newlib-nano-formatted-io'：
            https://sourceware.org/git/?p=newlib-cygwin.git;a=blob_plain;f=newlib/README;hb=HEAD

            如果启用此选项，并且ROM包含来自newlib-nano的函数，构建系统将使用ROM中可用的函数，
            从而减小应用程序二进制文件的大小。ROM中可用的函数运行速度比从flash运行的函数更快。
            当禁用flash指令缓存时，ROM中可用的函数也可以运行。

            某些芯片（例如ESP32-C6）在ROM中包含printf/scanf的完整格式化版本，而不是nano版本，
            在这种情况下，使用newlib nano实际上可能会增加二进制文件的大小。可以从ROM功能中
            看到哪些函数存在于ROM中：ESP_ROM_HAS_NEWLIB_NANO_FORMAT和ESP_ROM_HAS_NEWLIB_NORMAL_FORMAT。

            如果您需要64位整数格式支持或C99特性，请保持此选项禁用。

    choice NEWLIB_TIME_SYSCALL
        prompt "用于gettimeofday函数的定时器"
        default NEWLIB_TIME_SYSCALL_USE_RTC_HRT
        help
            此设置定义了在C库中实现'gettimeofday'和'time'函数所使用的硬件定时器。

            - 如果同时使用高分辨率（除ESP32外的所有目标使用systimer）和RTC定时器，
              则在深度睡眠中时间保持将继续。时间将以1微秒的分辨率报告。
              这是默认选项，也是推荐选项。
            - 如果仅使用高分辨率定时器（systimer），gettimeofday将提供微秒分辨率的时间。
              进入深度睡眠模式时，时间将不会保留。
            - 如果仅使用RTC定时器，时间保持将在深度睡眠中继续，但时间将以6.(6)微秒的
              分辨率测量。此外，gettimeofday函数本身可能需要更长时间运行。
            - 如果不使用任何定时器，gettimeofday和time函数将返回-1并将errno设置为ENOSYS；
              它们被定义为弱符号，因此可以被覆盖。
              如果您想自定义gettimeofday()和其他时间函数，请选择此选项，
              并参考'time.c'源文件以获取这些函数的确切原型。

            - 当使用RTC进行计时时，两个RTC_STORE寄存器用于在深度睡眠模式下保持时间。

        config NEWLIB_TIME_SYSCALL_USE_RTC_HRT
            bool "RTC和高分辨率定时器"
            select ESP_TIME_FUNCS_USE_RTC_TIMER
            select ESP_TIME_FUNCS_USE_ESP_TIMER
        config NEWLIB_TIME_SYSCALL_USE_RTC
            bool "RTC"
            select ESP_TIME_FUNCS_USE_RTC_TIMER
        config NEWLIB_TIME_SYSCALL_USE_HRT
            bool "高分辨率定时器"
            select ESP_TIME_FUNCS_USE_ESP_TIMER
        config NEWLIB_TIME_SYSCALL_USE_NONE
            bool "无"
            select ESP_TIME_FUNCS_USE_NONE
    endchoice

endmenu # Newlib

config STDATOMIC_S32C1I_SPIRAM_WORKAROUND
    bool
    default SPIRAM && (IDF_TARGET_ESP32 || IDF_TARGET_ESP32S3) && !IDF_TOOLCHAIN_CLANG # TODO IDF-9032
```

## components/nvs_flash/Kconfig
```kconfig
menu "非易失性存储 (NVS)"

    config NVS_ENCRYPTION
        bool "启用 NVS 加密"
        depends on SECURE_FLASH_ENC_ENABLED || SOC_HMAC_SUPPORTED
        default y if SECURE_FLASH_ENC_ENABLED
        help
            此选项为 NVS 启用加密。启用后，XTS-AES 将用于加密完整的 NVS 数据，
            除了页面头部。它需要将 XTS 加密密钥存储在加密分区中（此处必须启用
            闪存加密）或从烧录在 eFuse 中的 HMAC 密钥派生。

    config NVS_COMPATIBLE_PRE_V4_3_ENCRYPTION_FLAG
        bool "NVS 分区加密标志与 ESP-IDF v4.3 之前版本兼容"
        depends on SECURE_FLASH_ENC_ENABLED
        help
            启用此选项将忽略 NVS 分区的"加密"标志。NVS 加密方案与硬件闪存加密
            不同，因此不建议为 NVS 分区设置"加密"标志。在 v4.3 之前的 IDF 版本
            中没有检查这一点。因此，如果您有任何设备在分区表中保持此标志启用，
            那么启用此配置将允许具有与 v4.3 之前的 IDF 相同的行为。

    config NVS_ASSERT_ERROR_CHECK
        bool "使用断言进行错误检查"
        default n
        help
            此选项在断言（y）或返回代码（n）之间切换错误检查类型。

    config NVS_LEGACY_DUP_KEYS_COMPATIBILITY
        bool "启用旧版 nvs_set 函数行为，当相同键被重用于不同数据类型时"
        default n
        help
            启用此选项将使 nvs_set() 系列函数切换到旧模式：当使用相同的键但
            不同的数据类型重复调用时，NVS 中的现有值保持活动状态，新值仅被
            存储，实际上无法通过对给定键的相应 nvs_get() 调用访问。仅当您的
            应用程序依赖于此类 NVS API 行为时才使用此选项。
endmenu
```

## components/nvs_sec_provider/Kconfig
```kconfig
menu "NVS 安全提供程序"
    visible if NVS_ENCRYPTION

    choice NVS_SEC_KEY_PROTECTION_SCHEME
        prompt "NVS 加密：密钥保护方案"
        depends on NVS_ENCRYPTION
        default NVS_SEC_KEY_PROTECT_USING_FLASH_ENC
        help
            此选项定义默认的 NVS 加密密钥保护方案；
            该方案将用于默认的 NVS 分区。
            用户可以使用相应的方案注册 API 来为默认分区以及其他 NVS 分区注册其他方案。

        config NVS_SEC_KEY_PROTECT_USING_FLASH_ENC
            bool "使用闪存加密"
            depends on SECURE_FLASH_ENC_ENABLED
            help
                使用闪存加密保护 NVS 加密密钥
                需要一个单独的 'nvs_keys' 分区（该分区将通过闪存加密进行加密）
                用于存储 NVS 加密密钥

        config NVS_SEC_KEY_PROTECT_USING_HMAC
            bool "使用 HMAC 外设"
            depends on SOC_HMAC_SUPPORTED
            help
                使用 HMAC 外设派生和保护 NVS 加密密钥
                需要指定的 eFuse 块（NVS_SEC_HMAC_EFUSE_KEY_ID 或 v2 API 参数）
                为空或预先写入具有 ESP_EFUSE_KEY_PURPOSE_HMAC_UP 用途的密钥

    endchoice

    config NVS_SEC_HMAC_EFUSE_KEY_ID
        int "存储 HMAC 密钥的 eFuse 密钥 ID"
        depends on NVS_SEC_KEY_PROTECT_USING_HMAC
        range 0 6
        default 6
        help
            存储用于派生 NVS 加密密钥的 HMAC 密钥的 eFuse 块密钥 ID

            注意：HMAC 方案（CONFIG_NVS_SEC_KEY_PROTECT_USING_HMAC）所需的 eFuse 块密钥 ID
            在使用 nvs_flash_init() 初始化默认 NVS 分区时通过此配置设置。eFuse 块密钥 ID
            也可以在运行时通过向 NVS 安全方案注册 API 传递适当的值来设置。

endmenu
```

## components/partition_table/Kconfig.projbuild
```kconfig
menu "分区表"

    choice PARTITION_TABLE_TYPE
        prompt "分区表"
        default PARTITION_TABLE_SINGLE_APP
        help
            要刷写到 ESP32 的分区表。分区表决定了应用程序、数据和其他资源预期存放的位置。

            预定义的分区表 CSV 描述可以在 components/partition_table 目录中找到。这些主要用于示例和开发用途，
            预期在生产使用中，您将复制其中一个 CSV 文件并为您的应用程序创建自定义分区 CSV。

        config PARTITION_TABLE_SINGLE_APP
            bool "单一工厂应用程序，无 OTA"
            help
                这是默认的分区表，设计用于适合 2MB 或更大的闪存，带有单个 1MB 的应用程序分区。

                IDF 目录中对应的 CSV 文件是 components/partition_table/partitions_singleapp.csv

                这个分区表不适用于需要 OTA（空中更新）功能的应用程序。

        config PARTITION_TABLE_SINGLE_APP_LARGE
            bool "单一工厂应用程序（大型），无 OTA"
            help
                这是默认分区表的一个变体，将 1MB 的应用程序分区大小扩展到 1.5MB 以适应更多代码。

                IDF 目录中对应的 CSV 文件是 components/partition_table/partitions_singleapp_large.csv

                这个分区表不适用于需要 OTA（空中更新）功能的应用程序。

        config PARTITION_TABLE_TWO_OTA
            bool "工厂应用程序，两个 OTA 定义"
            help
                这是一个基本的支持 OTA 的分区表，包含一个工厂应用程序分区和两个 OTA 应用程序分区。
                所有分区都是 1MB，因此这个分区表需要 4MB 或更大的闪存大小。

                IDF 目录中对应的 CSV 文件是 components/partition_table/partitions_two_ota.csv

        config PARTITION_TABLE_CUSTOM
            bool "自定义分区表 CSV"
            help
                指定用于您项目的分区表 CSV 的路径。

                有关更多信息，请参阅 ESP-IDF 程序员指南中的分区表部分。

        config PARTITION_TABLE_SINGLE_APP_ENCRYPTED_NVS
            bool "单一工厂应用程序，无 OTA，加密的 NVS"
            depends on !ESP32_COREDUMP_ENABLE_TO_FLASH && NVS_SEC_KEY_PROTECT_USING_FLASH_ENC

            help
                这是默认"单一工厂应用程序，无 OTA"分区表的一个变体，
                在使用闪存加密时支持加密的 NVS。有关更多信息，请参阅 ESP-IDF 程序员指南中的闪存加密部分。

                IDF 目录中对应的 CSV 文件是 components/partition_table/partitions_singleapp_encr_nvs.csv

        config PARTITION_TABLE_SINGLE_APP_LARGE_ENC_NVS
            bool "单一工厂应用程序（大型），无 OTA，加密的 NVS"
            depends on !ESP32_COREDUMP_ENABLE_TO_FLASH && NVS_SEC_KEY_PROTECT_USING_FLASH_ENC
            help
                这是"单一工厂应用程序（大型），无 OTA"分区表的一个变体，
                在使用闪存加密时支持加密的 NVS。有关更多信息，请参阅 ESP-IDF 程序员指南中的闪存加密部分。

                IDF 目录中对应的 CSV 文件是 components/partition_table/partitions_singleapp_large_encr_nvs.csv

        config PARTITION_TABLE_TWO_OTA_ENCRYPTED_NVS
            bool "工厂应用程序，两个 OTA 定义，加密的 NVS"
            depends on !ESP_COREDUMP_ENABLE_TO_FLASH && NVS_SEC_KEY_PROTECT_USING_FLASH_ENC
            help
                这是"工厂应用程序，两个 OTA 定义"分区表的一个变体，
                在使用闪存加密时支持加密的 NVS。有关更多信息，请参阅 ESP-IDF 程序员指南中的闪存加密部分。

                IDF 目录中对应的 CSV 文件是 components/partition_table/partitions_two_ota_encr_nvs.csv
    endchoice

    config PARTITION_TABLE_CUSTOM_FILENAME
        string "自定义分区 CSV 文件" if PARTITION_TABLE_CUSTOM
        default "partitions.csv"
        help
            自定义分区 CSV 文件的名称。
            默认情况下，此路径相对于项目根目录进行评估。
            但是，如果提供了 CSV 文件的绝对路径，则会配置绝对路径。

    config PARTITION_TABLE_FILENAME
        string
        default "partitions_singleapp.csv" if PARTITION_TABLE_SINGLE_APP && !ESP_COREDUMP_ENABLE_TO_FLASH
        default "partitions_singleapp_coredump.csv" if PARTITION_TABLE_SINGLE_APP && ESP_COREDUMP_ENABLE_TO_FLASH
        default "partitions_singleapp_encr_nvs.csv" if PARTITION_TABLE_SINGLE_APP_ENCRYPTED_NVS
        default "partitions_singleapp_large.csv" if PARTITION_TABLE_SINGLE_APP_LARGE && !ESP_COREDUMP_ENABLE_TO_FLASH
        default "partitions_singleapp_large_coredump.csv" if PARTITION_TABLE_SINGLE_APP_LARGE && ESP_COREDUMP_ENABLE_TO_FLASH # NOERROR
        default "partitions_singleapp_large_encr_nvs.csv" if PARTITION_TABLE_SINGLE_APP_LARGE_ENC_NVS
        default "partitions_two_ota.csv" if PARTITION_TABLE_TWO_OTA && !ESP_COREDUMP_ENABLE_TO_FLASH
        default "partitions_two_ota_coredump.csv" if PARTITION_TABLE_TWO_OTA && ESP_COREDUMP_ENABLE_TO_FLASH
        default "partitions_two_ota_encr_nvs.csv" if PARTITION_TABLE_TWO_OTA_ENCRYPTED_NVS
        default PARTITION_TABLE_CUSTOM_FILENAME if PARTITION_TABLE_CUSTOM

    config PARTITION_TABLE_OFFSET
        hex "分区表偏移量"
        default 0x8000
        help
            分区表的地址（默认为 0x8000）。
            允许您移动分区表，为引导加载程序提供更多空间。
            请注意，引导加载程序和应用程序都需要使用相同的 PARTITION_TABLE_OFFSET 值进行编译。

            此数字应该是 0x1000 的倍数。

            注意，如果将此值设置为更高的值，可能需要更改分区表 CSV 文件中的分区偏移量。
            要使每个分区偏移量适应配置的分区表偏移量，请在 CSV 文件中将所有分区偏移量留空。

    config PARTITION_TABLE_MD5
        bool "为分区表生成 MD5 校验和"
        default y
        depends on !APP_COMPATIBLE_PRE_V3_1_BOOTLOADERS && !IDF_TARGET_LINUX
        help
            为分区表生成 MD5 校验和，以保护表的完整性。对于无法识别分区表中 MD5 校验和的
            旧版引导加载程序，应关闭生成。

endmenu
```

## components/ulp/Kconfig
```kconfig
menu "超低功耗 (ULP) 协处理器"
    depends on (SOC_ULP_SUPPORTED || SOC_RISCV_COPROC_SUPPORTED || SOC_LP_CORE_SUPPORTED)

    config ULP_COPROC_ENABLED
        bool "启用超低功耗 (ULP) 协处理器"
        default "n"
        help
            如果您计划使用 ULP 协处理器，请启用此功能。
            一旦启用此选项，菜单中将出现更多 ULP 协处理器配置选项。

    choice ULP_COPROC_TYPE
        prompt "ULP 协处理器类型"
        depends on ULP_COPROC_ENABLED
        default ULP_COPROC_TYPE_RISCV if (IDF_TARGET_ESP32S2 || IDF_TARGET_ESP32S3)
        help
            选择 ULP 协处理器类型：ULP FSM（有限状态机）或 ULP RISC-V。

        config ULP_COPROC_TYPE_FSM
            bool "ULP FSM（有限状态机）"
            depends on SOC_ULP_FSM_SUPPORTED
        config ULP_COPROC_TYPE_RISCV
            bool "ULP RISC-V"
            depends on SOC_RISCV_COPROC_SUPPORTED
        config ULP_COPROC_TYPE_LP_CORE
            bool "LP 核心 RISC-V"
            depends on SOC_LP_CORE_SUPPORTED
    endchoice

    config ULP_COPROC_RESERVE_MEM
        int
        prompt "为协处理器保留的 RTC 慢速内存"
        depends on ULP_COPROC_ENABLED
        default 512 if IDF_TARGET_ESP32
        default 4096 if !IDF_TARGET_ESP32
        range 32 8176 if IDF_TARGET_ESP32 || IDF_TARGET_ESP32S2 || IDF_TARGET_ESP32S3
        range 32 16352 if IDF_TARGET_ESP32C5 || IDF_TARGET_ESP32C6
        range 32 31088 if IDF_TARGET_ESP32P4 # Some memory are reserved for ROM/RTC reserved
        help
            为 ULP 协处理器固件和数据保留的内存字节数。
            数据保留在 RTC 慢速内存的开始处。


    menu "ULP RISC-V 设置"
        depends on ULP_COPROC_TYPE_RISCV

        config ULP_RISCV_INTERRUPT_ENABLE
            bool
            prompt "启用 ULP RISC-V 中断"
            default "n"
            help
                打开此设置以启用 ULP RISC-V 核心的中断。

        config ULP_RISCV_UART_BAUDRATE
            int
            prompt "位带 ULP RISC-V UART 驱动程序使用的波特率"
            default 9600
            help
                位带 UART 驱动程序的精度有限，不建议将值增加到 19200 以上。

        config ULP_RISCV_I2C_RW_TIMEOUT
            int
            prompt "设置 ULP RISC-V I2C 事务超时（以刻度为单位）。"
            default 500
            range -1 4294967295
            help
                设置 ULP RISC-V I2C 读/写超时。将此值设置为 -1，
                如果 ULP RISC-V I2C 读取和写入 API 应永远等待。
                请注意，ULP 协处理器的刻度率将与主核心的操作系统
                刻度率不同，因此可能会有不同的超时值，具体取决于
                在哪个核心上调用 API。
    endmenu

    config ULP_SHARED_MEM
        depends on ULP_COPROC_TYPE_LP_CORE
        hex
        default 0x10
        help
            在 ulp_lp_core_memory_shared.c 中定义的共享内存的大小。
            大小应与那里定义的结构体的大小保持同步。

    config ULP_ROM_PRINT_ENABLE
        depends on ULP_COPROC_TYPE_LP_CORE && ESP_ROM_HAS_LP_ROM
        bool
        prompt "启用来自 LP ROM 的打印实用程序"
        default "y"
        help
            设置此选项以启用来自 LP ROM 的 printf 功能。此选项
            可以通过不链接来自 RAM 代码的 printf 功能来帮助减少 LP 核心二进制大小。
            注意：为了使 LP ROM 打印正常工作，请确保 LP 核心从 LP ROM 启动。

    menu "ULP 调试选项"
        config ULP_PANIC_OUTPUT_ENABLE
            depends on ULP_COPROC_TYPE_LP_CORE && SOC_ULP_LP_UART_SUPPORTED
            bool
            prompt "启用通过 LP UART 输出的紧急处理程序"
            default "y" if IDF_TARGET_ESP32P4
            help
                设置此选项以启用紧急处理程序功能。如果启用此选项，
                则 LP 核心将通过 LP UART 输出紧急转储，类似于主核心的操作。
                输出取决于 LP UART 已经初始化和配置。
                禁用此选项将通过不链接紧急处理程序功能来减少 LP 核心二进制大小。

        config ULP_HP_UART_CONSOLE_PRINT
            depends on ULP_COPROC_TYPE_LP_CORE
            bool
            prompt "将 lp_core_printf 路由到控制台 HP-UART"
            help
                设置此选项以将 lp_core_printf 路由到控制台 HP-UART。
                这允许您轻松查看来自 LP 核心的打印输出，而无需
                连接到 LP-UART。此选项有以下限制：

                1. HP 核心和 LP 核心访问 HP-UART 之间没有互斥，
                这意味着如果两个核心都在大量记录，输出字符串可能会混在一起。
                2. HP-UART 只能在 HP 核心运行时工作，这意味着如果
                HP 核心处于深度睡眠状态，LP 核心将无法打印到控制台 HP-UART。

                由于这些限制，建议仅将此选项用于简单调试。
                对于更严肃的用例，您应该使用 LP-UART。
    endmenu

endmenu  # Ultra Low Power (ULP) Co-processor
```
