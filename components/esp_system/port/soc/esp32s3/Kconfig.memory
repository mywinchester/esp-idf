## components/esp_system/port/soc/esp32s3/Kconfig.memory
```kconfig
menu "内存"

    config ESP32S3_RTCDATA_IN_FAST_MEM
        bool "将 RTC_DATA_ATTR 和 RTC_RODATA_ATTR 变量放入 RTC 快速内存段"
        default n
        help
            此选项允许将 .rtc_data 和 .rtc_rodata 段放入 RTC 快速内存段，
            以释放慢速内存区域供 ULP 程序使用。

    config ESP32S3_USE_FIXED_STATIC_RAM_SIZE
        bool "使用固定的静态 RAM 大小"
        default n
        help
            如果禁用此选项，堆的 DRAM 部分将在 .bss 段之后立即开始，
            位于 dram0_0 区域内。因此，添加或删除一些静态变量
            将改变可用的堆大小。

            如果启用此选项，堆的 DRAM 部分将在 dram0_0 区域之后立即开始，
            其长度由 ESP32S3_FIXED_STATIC_RAM_SIZE 设置。

    config ESP32S3_FIXED_STATIC_RAM_SIZE
        hex "固定静态 RAM 大小"
        default 0x10000
        range 0 0x54700 # Equal to I_D_SRAM_SIZE in linkerscript
        depends on ESP32S3_USE_FIXED_STATIC_RAM_SIZE
        help
            专用于静态变量（.data 和 .bss 段）的 RAM 大小。
            此值小于芯片的总内存，因为并非所有内存都可用于此目的。
            例如，部分内存被软件引导加载程序使用，只有在应用程序启动后
            才能作为堆内存使用。

endmenu # Memory
```

## components/esp_timer/Kconfig
```kconfig
menu "ESP 定时器（高分辨率定时器）"

    config ESP_TIMER_PROFILING
        bool "启用 esp_timer 分析功能"
        default n
        help
            如果启用，esp_timer_dump 将会输出信息，如定时器启动的次数、
            定时器触发的次数以及回调运行所需的总时间。
            此选项对定时器性能和用于定时器存储的内存量有一定影响，
            应仅用于调试/测试目的。

    config ESP_TIME_FUNCS_USE_RTC_TIMER  # [refactor-todo] remove when timekeeping and persistence are separate
        bool

    config ESP_TIME_FUNCS_USE_ESP_TIMER  # [refactor-todo] remove when timekeeping and persistence are separate
        bool

    config ESP_TIME_FUNCS_USE_NONE  # [refactor-todo] remove when timekeeping and persistence are separate
        bool

    config ESP_TIMER_TASK_STACK_SIZE
        int "高分辨率定时器任务栈大小"
        default 3584
        range 2048 65536
        help
            配置 "timer_task" 任务的栈大小。此任务用于
            调度使用 ets_timer 和 esp_timer API 创建的定时器回调。
            如果您在定时器任务中看到栈溢出错误，请增加此值。

            请注意，这与 FreeRTOS 定时器任务不同。要配置
            FreeRTOS 定时器任务大小，请参见 "FreeRTOS" 中的
            "FreeRTOS 定时器任务栈大小" 选项。

    config ESP_TIMER_INTERRUPT_LEVEL
        int "中断级别"
        default 1
        range 1 3 if IDF_TARGET_ESP32
        range 1 1 if !IDF_TARGET_ESP32
        help
            这设置了 esp_timer ISR 的中断优先级。
            较高的值通过最小化定时器处理延迟来减少中断延迟。

    config ESP_TIMER_SHOW_EXPERIMENTAL
        bool "显示 esp_timer 的实验性功能"
        help
            这会显示 esp_timer 的一些隐藏功能。
            请注意，它们可能会破坏其他功能，请谨慎使用。

    config ESP_TIMER_TASK_AFFINITY
        hex
        default 0x0 if ESP_TIMER_TASK_AFFINITY_CPU0
        default 0x1 if ESP_TIMER_TASK_AFFINITY_CPU1
        default FREERTOS_NO_AFFINITY if ESP_TIMER_TASK_AFFINITY_NO_AFFINITY

    choice ESP_TIMER_TASK_AFFINITY
        prompt "esp_timer 任务核心亲和性"
        default ESP_TIMER_TASK_AFFINITY_CPU0
        help
            默认设置：定时器任务在 CPU0 上，定时器 ISR 在 CPU0 上。
            其他设置在某些情况下可能有帮助，但请注意它们可能会
            破坏其他功能，请谨慎使用。
            - "CPU0"：（默认）esp_timer 任务由 CPU0 处理。
            - "CPU1"：esp_timer 任务由 CPU1 处理。
            - "无亲和性"：esp_timer 任务可以由任何 CPU 处理。

        config ESP_TIMER_TASK_AFFINITY_CPU0
            bool "CPU0"
        config ESP_TIMER_TASK_AFFINITY_CPU1
            bool "CPU1"
            depends on !FREERTOS_UNICORE && ESP_TIMER_SHOW_EXPERIMENTAL
        config ESP_TIMER_TASK_AFFINITY_NO_AFFINITY
            bool "无亲和性"
            depends on !FREERTOS_UNICORE && ESP_TIMER_SHOW_EXPERIMENTAL
    endchoice

    choice ESP_TIMER_ISR_AFFINITY
        prompt "定时器中断核心亲和性"
        default ESP_TIMER_ISR_AFFINITY_CPU0
        help
            默认设置：定时器任务在 CPU0 上，定时器 ISR 在 CPU0 上。
            其他设置在某些情况下可能有帮助，但请注意它们可能会
            破坏其他功能，请谨慎使用。
            - "CPU0"：（默认）定时器中断由 CPU0 处理。
            - "CPU1"：定时器中断由 CPU1 处理。
            - "无亲和性"：定时器中断可以由任何 CPU 处理。它有助于
            减少延迟，但缺点是会导致定时器 ISR 在每个核心上运行。
            在 N 核系统上，它会将定时器 ISR 的 CPU 时间使用增加 N 倍。

        config ESP_TIMER_ISR_AFFINITY_CPU0
            bool "CPU0"
        config ESP_TIMER_ISR_AFFINITY_CPU1
            bool "CPU1"
            depends on !FREERTOS_UNICORE && ESP_TIMER_SHOW_EXPERIMENTAL
        config ESP_TIMER_ISR_AFFINITY_NO_AFFINITY
            bool "无亲和性"
            depends on !FREERTOS_UNICORE && ESP_TIMER_SHOW_EXPERIMENTAL
    endchoice

    config ESP_TIMER_SUPPORTS_ISR_DISPATCH_METHOD
        bool "支持 ISR 调度方法"
        default n
        help
            允许使用 ESP_TIMER_ISR 调度方法（ESP_TIMER_TASK 调度方法也可用）。
            - ESP_TIMER_TASK - 定时器回调从高优先级 esp_timer 任务中调度。
            - ESP_TIMER_ISR - 定时器回调直接从定时器中断处理程序中调度。
            在某些情况下，当回调非常简单或需要更低延迟时，可以使用 ISR 调度。

    config ESP_TIMER_IMPL_TG0_LAC
        bool
        default y
        depends on IDF_TARGET_ESP32

    config ESP_TIMER_IMPL_SYSTIMER
        bool
        default y
        depends on !IDF_TARGET_ESP32

endmenu # esp_timer
```
