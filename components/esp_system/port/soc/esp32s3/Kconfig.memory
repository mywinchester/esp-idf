## components/mbedtls/Kconfig
```kconfig
menu "mbedTLS"

    choice MBEDTLS_MEM_ALLOC_MODE
        prompt "内存分配策略"
        default MBEDTLS_INTERNAL_MEM_ALLOC
        help
            mbedTLS 的分配策略，本质上提供了从以下位置分配所有必需的动态分配的能力：

            - 仅内部 DRAM 内存
            - 仅外部 SPIRAM 内存
            - 基于 ESP-IDF 中默认 malloc() 行为的内部或外部内存
            - 自定义分配模式，通过使用 mbedtls_platform_set_calloc_free() 函数覆盖 calloc()/free()
            - 在适用的情况下使用内部 IRAM 内存，否则使用内部 DRAM

            从安全角度来看，这里推荐的模式始终是内部（*）。但如果应用程序要求不允许足够的
            空闲内部内存，则可以选择替代模式。

            (*) 在 ESP32-S2/ESP32-S3 的情况下，如果启用了硬件闪存加密功能，硬件允许加密
            外部 SPIRAM 内容。在这种情况下，从安全角度来看，使用外部 SPIRAM 分配策略也是
            安全的选择。

        config MBEDTLS_INTERNAL_MEM_ALLOC
            bool "内部内存"

        config MBEDTLS_EXTERNAL_MEM_ALLOC
            bool "外部 SPIRAM"
            depends on SPIRAM_USE_CAPS_ALLOC || SPIRAM_USE_MALLOC

        config MBEDTLS_DEFAULT_MEM_ALLOC
            bool "默认分配模式"

        config MBEDTLS_CUSTOM_MEM_ALLOC
            bool "自定义分配模式"

        config MBEDTLS_IRAM_8BIT_MEM_ALLOC
            bool "内部 IRAM"
            depends on ESP32_IRAM_AS_8BIT_ACCESSIBLE_MEMORY
            help
                允许使用 IRAM 内存区域作为 8 位可访问区域。

                TLS 输入和输出缓冲区将被分配在 IRAM 部分，这是 32 位对齐的内存。
                每个未对齐的（8 位或 16 位）访问都会导致异常，并且每次未对齐的
                读/写都会产生一定的时钟周期惩罚。

    endchoice #MBEDTLS_MEM_ALLOC_MODE

    config MBEDTLS_SSL_MAX_CONTENT_LEN
        int "TLS 最大消息内容长度"
        default 16384
        range 512 16384
        depends on !MBEDTLS_ASYMMETRIC_CONTENT_LEN
        help
            mbedTLS 支持的最大 TLS 消息长度（以字节为单位）。

            16384 是默认值，此值是完全符合 TLS 标准所必需的。

            但是，您可以设置一个较低的值以节省 RAM。如果连接的另一端支持
            最大片段长度协商扩展（max_fragment_length，参见 RFC6066）或
            您确定它永远不会发送长度超过特定字节数的消息，那么这是安全的。

            如果该值设置得太低，症状是 TLS 握手失败或返回值
            MBEDTLS_ERR_SSL_INVALID_RECORD（-0x7200）。

    config MBEDTLS_ASYMMETRIC_CONTENT_LEN
        bool "非对称输入/输出片段长度"
        default y
        help
            如果启用，此选项允许以非对称方式自定义 TLS 输入/输出片段长度。
            请注意，使用默认值启用此选项可为每个 TLS 连接节省 12KB 的动态内存。

    config MBEDTLS_SSL_IN_CONTENT_LEN
        int "TLS 最大传入片段长度"
        default 16384
        range 512 16384
        depends on MBEDTLS_ASYMMETRIC_CONTENT_LEN
        help
            这定义了最大传入片段长度，覆盖默认的最大内容长度
            （MBEDTLS_SSL_MAX_CONTENT_LEN）。

    config MBEDTLS_SSL_OUT_CONTENT_LEN
        int "TLS 最大传出片段长度"
        default 4096
        range 512 16384
        depends on MBEDTLS_ASYMMETRIC_CONTENT_LEN
        help
            这定义了最大传出片段长度，覆盖默认的最大内容长度
            （MBEDTLS_SSL_MAX_CONTENT_LEN）。

    config MBEDTLS_DYNAMIC_BUFFER
        bool "使用动态 TX/RX 缓冲区"
        default n
        select MBEDTLS_ASYMMETRIC_CONTENT_LEN
        # Dynamic buffer feature is not supported with DTLS
        depends on !IDF_TARGET_LINUX && !MBEDTLS_SSL_PROTO_DTLS && !MBEDTLS_SSL_VARIABLE_BUFFER_LENGTH
        help
            使用动态 TX/RX 缓冲区。启用此选项后，mbedTLS 将在需要发送数据时
            分配 TX 缓冲区，并在所有数据发送完毕后释放它，在需要接收数据时
            分配 RX 缓冲区，并在所有数据被使用或被上层读取后释放它。

            默认情况下，当 SSL 初始化时，mbedTLS 还会以
            "MBEDTLS_SSL_OUT_CONTENT_LEN" 或 "MBEDTLS_SSL_IN_CONTENT_LEN"
            的默认值分配 TX 和 RX 缓冲区，因此为了节省更多堆内存，用户可以
            将这些选项设置为适当的值。

    config MBEDTLS_DYNAMIC_FREE_CONFIG_DATA
        bool "使用后释放私钥和 DHM 数据"
        default n
        depends on MBEDTLS_DYNAMIC_BUFFER
        help
            在握手过程中使用后释放私钥和 DHM 数据。

            该选项将减少握手时的堆内存使用，但也会导致问题：

            因为所有证书、私钥和 DHM 数据都被释放了，所以用户应该再次
            将证书和私钥注册到 ssl 配置对象中。

    config MBEDTLS_DYNAMIC_FREE_CA_CERT
        bool "使用后释放 SSL CA 证书"
        default y
        depends on MBEDTLS_DYNAMIC_FREE_CONFIG_DATA
        help
            在握手过程中使用后释放 CA 证书。
            此选项将减少 TLS 握手的堆内存占用，但可能会导致问题：
            如果相应的 ssl 对象需要再次执行 TLS 握手，
            则应再次将 CA 证书注册到 ssl 对象。

    config MBEDTLS_DEBUG
        bool "启用 mbedTLS 调试"
        default n
        help
            在编译时启用 mbedTLS 调试功能。

            如果启用此选项，您可以在运行时包含 "mbedtls/esp_debug.h"
            并调用 mbedtls_esp_enable_debug_log() 以通过 ESP 日志
            机制启用 mbedTLS 调试输出。

    choice MBEDTLS_DEBUG_LEVEL
        bool "设置 mbedTLS 调试级别"
        depends on MBEDTLS_DEBUG
        default MBEDTLS_DEBUG_LEVEL_VERBOSE
        help
            设置 mbedTLS 调试级别

        config MBEDTLS_DEBUG_LEVEL_WARN
            bool "警告"
        config MBEDTLS_DEBUG_LEVEL_INFO
            bool "信息"
        config MBEDTLS_DEBUG_LEVEL_DEBUG
            bool "调试"
        config MBEDTLS_DEBUG_LEVEL_VERBOSE
            bool "详细"
    endchoice

    config MBEDTLS_DEBUG_LEVEL
        int
        default 1 if MBEDTLS_DEBUG_LEVEL_WARN
        default 2 if MBEDTLS_DEBUG_LEVEL_INFO
        default 3 if MBEDTLS_DEBUG_LEVEL_DEBUG
        default 4 if MBEDTLS_DEBUG_LEVEL_VERBOSE

    menu "mbedTLS v3.x 相关"
        # NOTE: MBEDTLS_DYNAMIC_BUFFER feature is not supported with TLS 1.3 yet. Ref: IDF-4762
        config MBEDTLS_SSL_PROTO_TLS1_3
            bool "支持 TLS 1.3 协议"
            depends on MBEDTLS_TLS_ENABLED && MBEDTLS_SSL_KEEP_PEER_CERTIFICATE && !MBEDTLS_DYNAMIC_BUFFER
            select MBEDTLS_HKDF_C
            default n

        menu "TLS 1.3 相关配置"
            depends on MBEDTLS_SSL_PROTO_TLS1_3

            config MBEDTLS_SSL_TLS1_3_COMPATIBILITY_MODE
                bool "TLS 1.3 中间件兼容模式"
                default y

            config MBEDTLS_SSL_TLS1_3_KEXM_PSK
                bool "TLS 1.3 PSK 密钥交换模式"
                default y

            config MBEDTLS_SSL_TLS1_3_KEXM_EPHEMERAL
                bool "TLS 1.3 临时密钥交换模式"
                default y

            config MBEDTLS_SSL_TLS1_3_KEXM_PSK_EPHEMERAL
                bool "TLS 1.3 PSK 临时密钥交换模式"
                default y

        endmenu

        config MBEDTLS_SSL_VARIABLE_BUFFER_LENGTH
            bool "可变 SSL 缓冲区长度"
            default n
            help
                这使得 SSL 缓冲区可以根据每个方向协商的最大片段长度自动调整大小。

        config MBEDTLS_ECDH_LEGACY_CONTEXT
            bool "使用向后兼容的 ECDH 上下文（实验性）"
            default n
            depends on MBEDTLS_ECDH_C && MBEDTLS_ECP_RESTARTABLE
            help
                使用旧版 ECDH 上下文格式。
                仅当您启用 MBEDTLS_ECP_RESTARTABLE 或想直接访问 ECDH 上下文字段时，
                才定义此选项。

        config MBEDTLS_X509_TRUSTED_CERT_CALLBACK
            bool "启用受信任证书回调"
            default n
            help
                使用户能够通过回调而不是链表来配置受信任证书集。

                有关所需 API 和更多详细信息，请参阅 mbedTLS 文档。

        config MBEDTLS_SSL_CONTEXT_SERIALIZATION
            bool "启用 TLS 上下文结构的序列化"
            default n
            depends on MBEDTLS_GCM_C || MBEDTLS_CCM_C || MBEDTLS_CHACHAPOLY_C
            help
                启用 TLS 上下文结构的序列化
                这是处理单个、可能长期存在的连接的本地优化。

                有关所需 API 和更多详细信息，请参阅 mbedTLS 文档。
                禁用此选项将节省一些代码大小。

        config MBEDTLS_SSL_KEEP_PEER_CERTIFICATE
            bool "握手完成后保留对等证书"
            default y
            help
                在握手完成后保留对等方的证书。
                禁用此选项将节省约 4kB 的堆内存和一些代码大小。

                有关所需 API 和更多详细信息，请参阅 mbedTLS 文档。

        config MBEDTLS_PKCS7_C
            bool "启用 PKCS #7"
            default y
            depends on MBEDTLS_X509_CRL_PARSE_C
            help
                启用 PKCS #7 核心以使用 PKCS #7 格式的签名。

        config MBEDTLS_SSL_CID_PADDING_GRANULARITY
            int "记录明文填充"
            default 16
            range 0 32
            depends on MBEDTLS_SSL_PROTO_TLS1_3 || MBEDTLS_SSL_DTLS_CONNECTION_ID
            help
                控制 TLS 1.3 中和在 DTLS 1.2 中使用连接 ID 扩展时的记录明文填充。

                填充将始终选择使得填充后的明文长度是此选项值的倍数。

                注意：
                    值为 1 意味着不会对传出记录使用填充。
                    在缺乏除法指令的系统上，应优先选择 2 的幂。

        menu "基于 DTLS 的配置"
            depends on MBEDTLS_SSL_PROTO_DTLS

            config MBEDTLS_SSL_DTLS_CONNECTION_ID
                bool "支持 DTLS 连接 ID 扩展"
                default n
                help
                    启用对 DTLS 连接 ID 扩展的支持，该扩展允许在底层传输发生变化时
                    识别 DTLS 连接。

            config MBEDTLS_SSL_CID_IN_LEN_MAX
                int "用于传入 DTLS 消息的 CID 的最大长度"
                default 32
                range 0 32
                depends on MBEDTLS_SSL_DTLS_CONNECTION_ID
                help
                    用于传入 DTLS 消息的 CID 的最大长度

            config MBEDTLS_SSL_CID_OUT_LEN_MAX
                int "用于传出 DTLS 消息的 CID 的最大长度"
                default 32
                range 0 32
                depends on MBEDTLS_SSL_DTLS_CONNECTION_ID
                help
                    用于传出 DTLS 消息的 CID 的最大长度

            config MBEDTLS_SSL_DTLS_SRTP
                bool "启用对 DTLS-SRTP 协商的支持 (RFC 5764)"
                default n
                help
                    启用通过 use_srtp 扩展对 DTLS-SRTP (RFC 5764) 协商的支持。

                    有关所需 API 和更多详细信息，请参阅 mbedTLS 文档。
                    禁用此选项将节省一些代码大小。

        endmenu

    endmenu

    menu "证书包"

        config MBEDTLS_CERTIFICATE_BUNDLE
            bool "启用受信任的根证书包"
            default y
            help
                启用对大量默认根证书的支持

                启用此选项后，用户可以将默认和客户特定的根证书以压缩格式存储，
                而不是存储完整证书。对于根证书，将存储公钥和主题名称。

        choice MBEDTLS_DEFAULT_CERTIFICATE_BUNDLE
            bool "默认证书包选项"
            depends on MBEDTLS_CERTIFICATE_BUNDLE
            default MBEDTLS_CERTIFICATE_BUNDLE_DEFAULT_FULL

            config MBEDTLS_CERTIFICATE_BUNDLE_DEFAULT_FULL
                bool "使用完整的默认证书包"
            config MBEDTLS_CERTIFICATE_BUNDLE_DEFAULT_CMN
                bool "仅使用默认包中最常见的证书"
                help
                    仅使用默认包中最常见的证书，将大小减少 50%，
                    同时仍然保持约 99% 的覆盖率。
            config MBEDTLS_CERTIFICATE_BUNDLE_DEFAULT_NONE
                bool "不使用默认证书包"
        endchoice

        config MBEDTLS_CUSTOM_CERTIFICATE_BUNDLE
            depends on MBEDTLS_CERTIFICATE_BUNDLE
            default n
            bool "将自定义证书添加到默认包"
        config MBEDTLS_CUSTOM_CERTIFICATE_BUNDLE_PATH
            depends on MBEDTLS_CUSTOM_CERTIFICATE_BUNDLE
            string "自定义证书包路径"
            help
                自定义证书目录或文件的名称。此路径相对于项目根目录进行评估。

        config MBEDTLS_CERTIFICATE_BUNDLE_DEPRECATED_LIST
            bool "添加已弃用的根证书"
            depends on MBEDTLS_CERTIFICATE_BUNDLE && !MBEDTLS_CERTIFICATE_BUNDLE_DEFAULT_NONE
            help
                在包中包含已弃用的根证书列表。
                当证书从 Mozilla 的 NSS 根证书存储中删除时，此列表会更新。
                如果您希望确保部署在产品中的证书不会因包更新而受到影响，
                可以启用此配置。反过来，启用此配置会将过期的、撤销的证书
                保留在包中，可能会带来安全风险。

                - 已弃用的证书列表可能会根据与上游包的同步而增长
                - 已弃用的证书将在 ESP-IDF（下一个）主要版本中被删除

        config MBEDTLS_CERTIFICATE_BUNDLE_MAX_CERTS
            int "证书包中允许的最大证书数量"
            default 200
            depends on MBEDTLS_CERTIFICATE_BUNDLE

    endmenu

    config MBEDTLS_ECP_RESTARTABLE
        bool "启用 mbedTLS ecp 可重启"
        select MBEDTLS_ECDH_LEGACY_CONTEXT
        depends on MBEDTLS_ECP_C
        default n
        help
            启用可以提前返回并恢复的"非阻塞"ECC 操作。

    config MBEDTLS_CMAC_C
        bool "为分组密码启用 CMAC 模式"
        default n
        depends on MBEDTLS_AES_C || MBEDTLS_DES_C
        help
            为分组密码启用 CMAC（基于密码的消息认证码）模式。

    config MBEDTLS_HARDWARE_AES
        bool "启用硬件 AES 加速"
        default y
        depends on !SPIRAM_CACHE_WORKAROUND_STRATEGY_DUPLDST && SOC_AES_SUPPORTED
        help
            启用硬件加速的 AES 加密和解密。

            请注意，如果 ESP32 CPU 运行在 240MHz，硬件 AES 相比软件 AES 
            不会提供任何速度提升。

    config MBEDTLS_AES_USE_INTERRUPT
        bool "对长时间 AES 操作使用中断"
        depends on !IDF_TARGET_ESP32 && MBEDTLS_HARDWARE_AES
        default y
        help
            使用中断来协调长时间的 AES 操作。

            这允许在 AES 操作挂起时 CPU 上运行其他代码。
            否则 CPU 会忙等待。

    config MBEDTLS_AES_INTERRUPT_LEVEL
        int "AES 硬件中断级别"
        default 0
        depends on MBEDTLS_AES_USE_INTERRUPT
        range 0 3
        help
            此配置有助于设置 AES 外设的中断优先级级别。
            值 0（默认）表示对中断优先级级别没有偏好，
            可以选择 1 到 3 之间的任何级别（基于可用性）。
            注意：较高的值表示较高的中断优先级。

    config MBEDTLS_HARDWARE_GCM
        bool "启用部分硬件加速的 GCM"
        depends on SOC_AES_SUPPORT_GCM && MBEDTLS_HARDWARE_AES
        default y
        help
            启用部分硬件加速的 GCM。GHASH 计算仍在软件中完成。

            如果禁用 MBEDTLS_HARDWARE_GCM 并启用 MBEDTLS_HARDWARE_AES，
            则 mbedTLS 仍将使用硬件加速的 AES 块操作，但一次只处理一个块。

    config MBEDTLS_GCM_SUPPORT_NON_AES_CIPHER
        bool "在 GCM 操作中启用对非 AES 密码的支持"
        depends on MBEDTLS_HARDWARE_AES
        default y
        help
            启用此配置以支持在 GCM 操作中对非 AES 密码的软件定义回退，
            因为我们仅支持 AES 密码的硬件加速。
            GCM 操作中使用的一些非 AES 密码包括 DES、ARIA、CAMELLIA、
            CHACHA20、BLOWFISH。

            如果禁用此配置，在启用 MBEDTLS_HARDWARE_AES 的情况下执行
            非 AES 密码 GCM 操作将导致对给定输入值计算 AES-GCM 操作，
            从而可能导致证书验证失败，最终导致 SSL 握手失败。

            默认启用此配置会导致二进制大小增加约 2.5KB。
            如果您确定您的用例（例如，TLS 握手中的客户端和服务器配置）
            不涉及使用非 AES 密码的 GCM 操作，则可以安全地禁用此配置，
            从而减少二进制大小。

    config MBEDTLS_HARDWARE_MPI
        bool "启用硬件 MPI（大数）加速"
        default y
        depends on !SPIRAM_CACHE_WORKAROUND_STRATEGY_DUPLDST && SOC_MPI_SUPPORTED
        help
            启用硬件加速的多精度整数运算。

            硬件加速的乘法、模乘和模幂运算，
            最多支持 SOC_RSA_MAX_BIT_LEN 位结果。

            这些操作由 RSA 使用。

    config MBEDTLS_LARGE_KEY_SOFTWARE_MPI
        bool "对较大的 MPI 值回退到软件实现"
        depends on MBEDTLS_HARDWARE_MPI
        default y if SOC_RSA_MAX_BIT_LEN <= 3072 # HW max 3072 bits
        default n
        help
            对于大于 SOC_RSA_MAX_BIT_LEN 的 RSA 密钥长度回退到软件实现。
            如果不激活此选项，则 ESP 将无法处理大于 SOC_RSA_MAX_BIT_LEN 的密钥。

    config MBEDTLS_MPI_USE_INTERRUPT
        bool "对 MPI 指数模运算使用中断"
        depends on !IDF_TARGET_ESP32 && MBEDTLS_HARDWARE_MPI
        default y
        help
            使用中断来协调长时间的 MPI 操作。

            这允许在 MPI 操作挂起时 CPU 上运行其他代码。
            否则 CPU 会忙等待。

    config MBEDTLS_MPI_INTERRUPT_LEVEL
        int "MPI 硬件中断级别"
        default 0
        depends on MBEDTLS_MPI_USE_INTERRUPT
        range 0 3
        help
            此配置有助于设置 MPI 外设的中断优先级级别。
            值 0（默认）表示对中断优先级级别没有偏好，
            可以选择 1 到 3 之间的任何级别（基于可用性）。
            注意：较高的值表示较高的中断优先级。

    config MBEDTLS_HARDWARE_SHA
        bool "启用硬件 SHA 加速"
        default y
        depends on !SPIRAM_CACHE_WORKAROUND_STRATEGY_DUPLDST && SOC_SHA_SUPPORTED
        help
            在 mbedTLS 中启用硬件加速的 SHA1、SHA256、SHA384 和 SHA512。

            由于硬件限制，在 ESP32 上，只有在一次计算一个 SHA 摘要时，
            硬件加速才能得到保证。如果同时计算多个 SHA 摘要，
            其中一个将完全在硬件中计算，其余的将（至少部分）在软件中计算。
            这种情况会自动发生。

            在某些情况下，SHA 硬件加速比软件快，但在其他情况下较慢。
            您应该进行基准测试以找到最适合您的设置。

    config MBEDTLS_HARDWARE_ECC
        bool "启用硬件 ECC 加速"
        default y
        depends on SOC_ECC_SUPPORTED
        help
            在 mbedTLS 中为 SECP192R1 和 SECP256R1 曲线上的点启用硬件加速的 ECC 点乘法和点验证

    config MBEDTLS_ECC_OTHER_CURVES_SOFT_FALLBACK
        bool "对硬件不支持的曲线回退到软件实现"
        depends on MBEDTLS_HARDWARE_ECC
        default y
        help
            对硬件不支持的曲线回退到 ECC 点乘法和点验证的软件实现。

    config MBEDTLS_ROM_MD5
        bool "使用 ROM 中的 MD5 实现"
        default y
        help
            在 mbedTLS 中使用 ROM MD5。

    config MBEDTLS_HARDWARE_ECDSA_SIGN
        bool "启用使用片上 ECDSA 外设进行 ECDSA 签名"
        default n
        depends on SOC_ECDSA_SUPPORTED
        help
            在 mbedTLS 中启用硬件加速的 ECDSA 外设，
            以在 SECP192R1 和 SECP256R1 曲线上签名数据。

            注意，对于签名，私钥必须烧录在 efuse 密钥块中，
            并将密钥用途设置为 ECDSA_KEY。
            如果没有烧录密钥，将报告错误

            密钥应以小端格式烧录。espefuse.py 实用程序内部处理这一点，
            但使用 esp_efuse API 烧录时需要注意

    config MBEDTLS_HARDWARE_ECDSA_VERIFY
        bool "启用使用片上 ECDSA 外设进行 ECDSA 签名验证"
        default y
        depends on SOC_ECDSA_SUPPORTED
        help
            在 mbedTLS 中启用硬件加速的 ECDSA 外设，
            以在 SECP192R1 和 SECP256R1 曲线上验证签名。

    config MBEDTLS_ATCA_HW_ECDSA_SIGN
        bool "使用 ATECC608A 时启用硬件 ECDSA 签名加速"
        default n
        help
            此选项仅在使用 ATECC608A 加密认证芯片时启用 ECDSA 签名函数的硬件加速。

    config MBEDTLS_ATCA_HW_ECDSA_VERIFY
        bool "使用 ATECC608A 时启用硬件 ECDSA 验证加速"
        default n
        help
            此选项仅在使用 ATECC608A 加密认证芯片时启用 ECDSA 签名函数的硬件加速。

    config MBEDTLS_ATCA_HW_ECDSA_VERIFY
        bool "使用 ATECC608A 时启用硬件 ECDSA 验证加速"
        default n
        help
            此选项仅在使用 ATECC608A 加密认证芯片时启用 ECDSA 签名函数的硬件加速。

    config MBEDTLS_HAVE_TIME
        bool "启用 mbedtls 时间支持"
        depends on !ESP_TIME_FUNCS_USE_NONE
        default y
        help
            启用 mbedTLS 使用 time.h 函数（time() 和 gmtime()）。

            此选项不要求系统时间正确，但启用了需要相对计时的功能 - 例如 TLS 会话票据或会话缓存条目的定期过期。

            禁用此选项将节省一些固件大小，特别是如果固件的其余部分不调用任何标准计时功能。

    config MBEDTLS_PLATFORM_TIME_ALT
        bool "启用 mbedtls 时间支持：平台特定"
        depends on MBEDTLS_HAVE_TIME
        default n
        help
            启用此配置将为用户提供一个函数 "mbedtls_platform_set_time()"，
            允许设置替代的时间函数指针。

    config MBEDTLS_HAVE_TIME_DATE
        bool "启用 mbedtls 证书过期检查"
        depends on MBEDTLS_HAVE_TIME
        default n
        help
            在 mbedTLS 中启用 X.509 证书过期检查。

            如果禁用此选项（默认），则 X.509 证书的 "有效期自" 和 "有效期至" 时间戳字段将被忽略。

            如果启用此选项，这些字段将与当前系统日期和时间进行比较。时间是使用标准 time() 和 gmtime() 函数获取的。
            如果证书对当前系统时间无效，验证将失败，错误代码为 MBEDTLS_X509_BADCERT_FUTURE 或 MBEDTLS_X509_BADCERT_EXPIRED。

            启用此选项需要在固件中添加功能，以在使用 TLS 之前将系统时钟设置为有效的时间戳。
            推荐的方法是通过 ESP-IDF 的 SNTP 功能，但可以使用任何方法。

            在设备只信任少量证书的情况下，请仔细考虑启用此选项的利弊。可能会有意想不到的后果，
            例如，如果设备离线时所有受信任的证书都过期，而需要 TLS 连接来更新。
            或者如果 SNTP 服务器出现问题，导致系统时间在重置后长时间无效。

    config MBEDTLS_ECDSA_DETERMINISTIC
        bool "启用确定性 ECDSA"
        default y
        help
            标准 ECDSA 在签名时缺乏熵可能导致长期签名密钥被泄露，因此被认为是"脆弱的"。

    config MBEDTLS_SHA512_C
        bool "启用 SHA-384 和 SHA-512 加密哈希算法"
        default y
        help
            启用 MBEDTLS_SHA512_C 添加对 SHA-384 和 SHA-512 的支持。

    choice MBEDTLS_TLS_MODE
        bool "TLS 协议角色"
        default MBEDTLS_TLS_SERVER_AND_CLIENT
        help
            mbedTLS 可以编译为支持 TLS 服务器、TLS 客户端或同时支持服务器和客户端。

            减少支持的 TLS 角色数量可以节省代码大小。

        config MBEDTLS_TLS_SERVER_AND_CLIENT
            bool "服务器和客户端"
            select MBEDTLS_TLS_SERVER
            select MBEDTLS_TLS_CLIENT
        config MBEDTLS_TLS_SERVER_ONLY
            bool "仅服务器"
            select MBEDTLS_TLS_SERVER
        config MBEDTLS_TLS_CLIENT_ONLY
            bool "仅客户端"
            select MBEDTLS_TLS_CLIENT
        config MBEDTLS_TLS_DISABLED
            bool "无"

    endchoice

    config MBEDTLS_TLS_SERVER
        bool
        select MBEDTLS_TLS_ENABLED
    config MBEDTLS_TLS_CLIENT
        bool
        select MBEDTLS_TLS_ENABLED
    config MBEDTLS_TLS_ENABLED
        bool

    menu "TLS 密钥交换方法"
        depends on MBEDTLS_TLS_ENABLED

        config MBEDTLS_PSK_MODES
            bool "启用预共享密钥密码套件"
            default n
            help
                启用以显示不同类型的预共享密钥 TLS 认证方法的配置。

                如果不使用，禁用这些选项将节省代码大小。

        config MBEDTLS_KEY_EXCHANGE_PSK
            bool "启用基于 PSK 的密码套件模式"
            depends on MBEDTLS_PSK_MODES
            default n
            help
                启用以支持对称密钥 PSK（预共享密钥）TLS 密钥交换模式。

        config MBEDTLS_KEY_EXCHANGE_DHE_PSK
            bool "启用基于 DHE-PSK 的密码套件模式"
            depends on MBEDTLS_PSK_MODES && MBEDTLS_DHM_C
            default y
            help
                启用以支持 Diffie-Hellman PSK（预共享密钥）TLS 认证模式。

        config MBEDTLS_KEY_EXCHANGE_ECDHE_PSK
            bool "启用基于 ECDHE-PSK 的密码套件模式"
            depends on MBEDTLS_PSK_MODES && MBEDTLS_ECDH_C
            default y
            help
                启用以支持椭圆曲线 Diffie-Hellman PSK（预共享密钥）TLS 认证模式。

        config MBEDTLS_KEY_EXCHANGE_RSA_PSK
            bool "启用基于 RSA-PSK 的密码套件模式"
            depends on MBEDTLS_PSK_MODES
            default y
            help
                启用以支持 RSA PSK（预共享密钥）TLS 认证模式。

        config MBEDTLS_KEY_EXCHANGE_RSA
            bool "启用仅基于 RSA 的密码套件模式"
            default y
            help
                启用以支持前缀为 TLS-RSA-WITH- 的密码套件。

        config MBEDTLS_KEY_EXCHANGE_DHE_RSA
            bool "启用基于 DHE-RSA 的密码套件模式"
            default y
            depends on MBEDTLS_DHM_C
            help
                启用以支持前缀为 TLS-DHE-RSA-WITH- 的密码套件。

        config MBEDTLS_KEY_EXCHANGE_ELLIPTIC_CURVE
            bool "支持基于椭圆曲线的密码套件"
            depends on MBEDTLS_ECP_C
            default y
            help
                启用以显示基于椭圆曲线的密码套件模式选项。

                禁用所有椭圆曲线密码套件可以节省代码大小，并且可以略微加快 TLS 握手速度，
                前提是服务器支持仅 RSA 的密码套件模式。

        config MBEDTLS_KEY_EXCHANGE_ECDHE_RSA
            bool "启用基于 ECDHE-RSA 的密码套件模式"
            depends on MBEDTLS_KEY_EXCHANGE_ELLIPTIC_CURVE && MBEDTLS_ECDH_C
            default y
            help
                启用以支持前缀为 TLS-ECDHE-RSA-WITH- 的密码套件。

        config MBEDTLS_KEY_EXCHANGE_ECDHE_ECDSA
            bool "启用基于 ECDHE-ECDSA 的密码套件模式"
            depends on MBEDTLS_KEY_EXCHANGE_ELLIPTIC_CURVE && MBEDTLS_ECDH_C && MBEDTLS_ECDSA_C
            default y
            help
                启用以支持前缀为 TLS-ECDHE-RSA-WITH- 的密码套件。

        config MBEDTLS_KEY_EXCHANGE_ECDH_ECDSA
            bool "启用基于 ECDH-ECDSA 的密码套件模式"
            depends on MBEDTLS_KEY_EXCHANGE_ELLIPTIC_CURVE && MBEDTLS_ECDH_C && MBEDTLS_ECDSA_C
            default y
            help
                启用以支持前缀为 TLS-ECDHE-RSA-WITH- 的密码套件。

        config MBEDTLS_KEY_EXCHANGE_ECDH_RSA
            bool "启用基于 ECDH-RSA 的密码套件模式"
            depends on MBEDTLS_KEY_EXCHANGE_ELLIPTIC_CURVE && MBEDTLS_ECDH_C
            default y
            help
                启用以支持前缀为 TLS-ECDHE-RSA-WITH- 的密码套件。

        config MBEDTLS_KEY_EXCHANGE_ECJPAKE
            bool "启用基于 ECJPAKE 的密码套件模式"
            depends on MBEDTLS_ECJPAKE_C && MBEDTLS_ECP_DP_SECP256R1_ENABLED
            default n
            help
                启用以支持前缀为 TLS-ECJPAKE-WITH- 的密码套件。

    endmenu # TLS key exchange modes

    config MBEDTLS_SSL_RENEGOTIATION
        bool "支持 TLS 重新协商"
        depends on MBEDTLS_TLS_ENABLED
        default y
        help
            重新协商的两个主要用途是（1）刷新长期连接的密钥和（2）初始握手后的客户端认证。
            如果不需要重新协商，禁用它将节省代码大小并减少滥用/漏洞的可能性。

    config MBEDTLS_SSL_PROTO_TLS1_2
        bool "支持 TLS 1.2 协议"
        depends on MBEDTLS_TLS_ENABLED
        default y

    config MBEDTLS_SSL_PROTO_GMTSSL1_1
        bool "支持 GM/T SSL 1.1 协议"
        depends on MBEDTLS_TLS_ENABLED
        default n
        help
            为 GM/T SSL 1.1 支持提供条件

    config MBEDTLS_SSL_PROTO_DTLS
        bool "支持 DTLS 协议（所有版本）"
        default n
        depends on MBEDTLS_SSL_PROTO_TLS1_2
        help
            DTLS 1.2 需要启用 TLS 1.2

    config MBEDTLS_SSL_ALPN
        bool "支持 ALPN（应用层协议协商）"
        depends on MBEDTLS_TLS_ENABLED
        default y
        help
            如果不需要，禁用此选项将节省一些代码大小。

    config MBEDTLS_CLIENT_SSL_SESSION_TICKETS
        bool "TLS：客户端支持 RFC 5077 SSL 会话票据"
        default y
        depends on MBEDTLS_TLS_ENABLED
        help
            客户端支持 RFC 5077 会话票据。有关更多详细信息，请参阅 mbedTLS 文档。
            禁用此选项将节省一些代码大小。

    config MBEDTLS_SERVER_SSL_SESSION_TICKETS
        bool "TLS：服务器支持 RFC 5077 SSL 会话票据"
        default y
        depends on MBEDTLS_TLS_ENABLED && (MBEDTLS_GCM_C || MBEDTLS_CCM_C || MBEDTLS_CHACHAPOLY_C)
        help
            服务器支持 RFC 5077 会话票据。有关更多详细信息，请参阅 mbedTLS 文档。
            禁用此选项将节省一些代码大小。

    menu "对称加密算法"

        config MBEDTLS_AES_C
            bool "AES 分组密码"
            default y

        config MBEDTLS_CAMELLIA_C
            bool "Camellia 分组密码"
            default n

        config MBEDTLS_DES_C
            bool "DES 分组密码（传统，不安全）"
            default n
            help
                启用 DES 分组密码以支持基于 3DES 的 TLS 密码套件。

                3DES 容易受到 Sweet32 攻击，只有在绝对必要的情况下才应启用。

        config MBEDTLS_BLOWFISH_C
            bool "Blowfish 分组密码（请阅读帮助）"
            default n
            help
                    启用 Blowfish 分组密码（不用于 TLS 会话）。

                    Blowfish 密码不用于 mbedTLS TLS 会话，但可用于其他目的。
                    在启用之前，请了解 Blowfish 的限制（包括 Sweet32）。

        config MBEDTLS_XTEA_C
            bool "XTEA 分组密码"
            default n
            help
                    启用 XTEA 分组密码。


        config MBEDTLS_CCM_C
            bool "CCM（带 CBC-MAC 的计数器）分组密码模式"
            default y
            depends on MBEDTLS_AES_C || MBEDTLS_CAMELLIA_C
            help
                    为 AES 和/或 Camellia 密码启用带 CBC-MAC 的计数器（CCM）模式。

                    禁用此选项可节省一些代码大小。

        config MBEDTLS_GCM_C
            bool "GCM（伽罗瓦/计数器）分组密码模式"
            default y
            depends on MBEDTLS_AES_C || MBEDTLS_CAMELLIA_C
            help
                    为 AES 和/或 Camellia 密码启用伽罗瓦/计数器模式。

                    此选项通常比 CCM 更快。

        config MBEDTLS_NIST_KW_C
            bool "NIST 密钥包装（KW）和 KW 填充（KWP）"
            default n
            depends on MBEDTLS_AES_C
            help
                    启用 NIST 密钥包装和密钥包装填充。

    endmenu # Symmetric Ciphers

    config MBEDTLS_RIPEMD160_C
        bool "启用 RIPEMD-160 哈希算法"
        default n
        help
            启用 RIPEMD-160 哈希算法。

    menu "证书"

        config MBEDTLS_PEM_PARSE_C
            bool "读取和解析 PEM 格式的证书"
            default y
            help
                启用 PEM 格式证书的解码/解析。

                如果您的证书都是更简单的 DER 格式，禁用此选项将节省一些代码大小。

        config MBEDTLS_PEM_WRITE_C
            bool "写入 PEM 格式的证书"
            default y
            help
                启用 PEM 格式证书的写入。

                如果只以 DER 格式写入证书数据，禁用此选项将节省一些代码大小。

        config MBEDTLS_X509_CRL_PARSE_C
            bool "X.509 CRL 解析"
            default y
            help
                支持解析 X.509 证书吊销列表。

        config MBEDTLS_X509_CSR_PARSE_C
            bool "X.509 CSR 解析"
            default y
            help
                支持解析 X.509 证书签名请求

    endmenu # Certificates

    menuconfig MBEDTLS_ECP_C
        bool  "椭圆曲线密码"
        default y

    config MBEDTLS_DHM_C
        bool "Diffie-Hellman-Merkle 密钥交换（DHM）"
        default n
        help
            启用 DHM。需要使用 DHE-xxx TLS 密码套件。

            请注意，Diffie-Hellman 密钥交换的安全性取决于
            使用适当的素数进行交换。请参阅 `mbedtls/dhm.h` 文件中
            关于此问题的详细警告文本。

    config MBEDTLS_ECDH_C
        bool "椭圆曲线 Diffie-Hellman（ECDH）"
        depends on MBEDTLS_ECP_C
        default y
        help
            启用 ECDH。需要使用 ECDHE-xxx TLS 密码套件。

    config MBEDTLS_ECDSA_C
        bool "椭圆曲线 DSA"
        depends on MBEDTLS_ECDH_C
        default y
        help
            启用 ECDSA。需要使用 ECDSA-xxx TLS 密码套件。

    config MBEDTLS_ECJPAKE_C
        bool "椭圆曲线 J-PAKE"
        depends on MBEDTLS_ECP_C
        default n
        help
            启用 ECJPAKE。需要使用 ECJPAKE-xxx TLS 密码套件。

    config MBEDTLS_ECP_DP_SECP192R1_ENABLED
        bool "启用 SECP192R1 曲线"
        depends on MBEDTLS_ECP_C
        default y if !(MBEDTLS_ATCA_HW_ECDSA_SIGN || MBEDTLS_ATCA_HW_ECDSA_VERIFY)
        help
            启用对 SECP192R1 椭圆曲线的支持。

    config MBEDTLS_ECP_DP_SECP224R1_ENABLED
        bool "启用 SECP224R1 曲线"
        depends on MBEDTLS_ECP_C
        default y if !(MBEDTLS_ATCA_HW_ECDSA_SIGN || MBEDTLS_ATCA_HW_ECDSA_VERIFY)
        help
            启用对 SECP224R1 椭圆曲线的支持。

    config MBEDTLS_ECP_DP_SECP256R1_ENABLED
        bool "启用 SECP256R1 曲线"
        depends on MBEDTLS_ECP_C
        default y
        help
            启用对 SECP256R1 椭圆曲线的支持。

    config MBEDTLS_ECP_DP_SECP384R1_ENABLED
        bool "启用 SECP384R1 曲线"
        depends on MBEDTLS_ECP_C
        default y if !(MBEDTLS_ATCA_HW_ECDSA_SIGN || MBEDTLS_ATCA_HW_ECDSA_VERIFY)
        help
            启用对 SECP384R1 椭圆曲线的支持。

    config MBEDTLS_ECP_DP_SECP521R1_ENABLED
        bool "启用 SECP521R1 曲线"
        depends on MBEDTLS_ECP_C
        default y if !(MBEDTLS_ATCA_HW_ECDSA_SIGN || MBEDTLS_ATCA_HW_ECDSA_VERIFY)
        help
            启用对 SECP521R1 椭圆曲线的支持。

    config MBEDTLS_ECP_DP_SECP192K1_ENABLED
        bool "启用 SECP192K1 曲线"
        depends on MBEDTLS_ECP_C
        default y if !(MBEDTLS_ATCA_HW_ECDSA_SIGN || MBEDTLS_ATCA_HW_ECDSA_VERIFY)
        help
            启用对 SECP192K1 椭圆曲线的支持。

    config MBEDTLS_ECP_DP_SECP224K1_ENABLED
        bool "启用 SECP224K1 曲线"
        depends on MBEDTLS_ECP_C
        default y if !(MBEDTLS_ATCA_HW_ECDSA_SIGN || MBEDTLS_ATCA_HW_ECDSA_VERIFY)
        help
            启用对 SECP224K1 椭圆曲线的支持。

    config MBEDTLS_ECP_DP_SECP256K1_ENABLED
        bool "启用 SECP256K1 曲线"
        depends on MBEDTLS_ECP_C
        default y if !(MBEDTLS_ATCA_HW_ECDSA_SIGN || MBEDTLS_ATCA_HW_ECDSA_VERIFY)
        help
            启用对 SECP256K1 椭圆曲线的支持。

    config MBEDTLS_ECP_DP_BP256R1_ENABLED
        bool "启用 BP256R1 曲线"
        depends on MBEDTLS_ECP_C
        default y if !(MBEDTLS_ATCA_HW_ECDSA_SIGN || MBEDTLS_ATCA_HW_ECDSA_VERIFY)
        help
            支持 DP 椭圆曲线。

    config MBEDTLS_ECP_DP_BP384R1_ENABLED
        bool "启用 BP384R1 曲线"
        depends on MBEDTLS_ECP_C
        default y if !(MBEDTLS_ATCA_HW_ECDSA_SIGN || MBEDTLS_ATCA_HW_ECDSA_VERIFY)
        help
            支持 DP 椭圆曲线。

    config MBEDTLS_ECP_DP_BP512R1_ENABLED
        bool "启用 BP512R1 曲线"
        depends on MBEDTLS_ECP_C
        default y if !(MBEDTLS_ATCA_HW_ECDSA_SIGN || MBEDTLS_ATCA_HW_ECDSA_VERIFY)
        help
            支持 DP 椭圆曲线。

    config MBEDTLS_ECP_DP_CURVE25519_ENABLED
        bool "启用 CURVE25519 曲线"
        depends on MBEDTLS_ECP_C
        default y if !(MBEDTLS_ATCA_HW_ECDSA_SIGN || MBEDTLS_ATCA_HW_ECDSA_VERIFY)
        help
            启用对 CURVE25519 椭圆曲线的支持。

    config MBEDTLS_ECP_NIST_OPTIM
        bool "NIST 'modulo p' 优化"
        depends on MBEDTLS_ECP_C
        default y
        help
            NIST 'modulo p' 优化可提高椭圆曲线操作性能。

            禁用此选项可节省一些代码大小。

    config MBEDTLS_ECP_FIXED_POINT_OPTIM
        bool "启用固定点乘法优化"
        depends on MBEDTLS_ECP_C
        default y
        help
            此配置选项启用优化以加速（约3~4倍）使用闪存中预计算表的ECP固定点乘法。
            禁用此配置选项可以在应用程序二进制文件中节省闪存占用（如果选择所有椭圆曲线，约29KB）。

            # end of Elliptic Curve options

    config MBEDTLS_POLY1305_C
        bool "Poly1305 MAC算法"
        default n
        help
            启用对Poly1305 MAC算法的支持。

    config MBEDTLS_CHACHA20_C
        bool "Chacha20流密码"
        default n
        help
            启用对Chacha20流密码的支持。

    config MBEDTLS_CHACHAPOLY_C
        bool "ChaCha20-Poly1305 AEAD算法"
        default n
        depends on MBEDTLS_CHACHA20_C && MBEDTLS_POLY1305_C
        help
            启用对ChaCha20-Poly1305 AEAD算法的支持。

    config MBEDTLS_HKDF_C
        bool "HKDF算法（RFC 5869）"
        default n
        help
            启用对基于哈希消息认证码（HMAC）的密钥派生函数（HKDF）的支持。

    config MBEDTLS_THREADING_C
        bool "启用线程抽象层"
        default n
        help
            如果您打算在线程之间使用上下文，您需要启用此层以防止竞态条件。

    config MBEDTLS_THREADING_ALT
        bool "启用线程替代实现"
        depends on MBEDTLS_THREADING_C
        default y
        help
            启用线程替代以允许您自己的替代线程实现。

    config MBEDTLS_THREADING_PTHREAD
        bool "启用pthread线程实现"
        depends on MBEDTLS_THREADING_C
        default n
        help
            为线程层启用pthread包装器层。

    config MBEDTLS_ERROR_STRINGS
        bool "启用错误代码到错误字符串的转换"
        default y
        help
            启用mbedtls_strerror()以将错误代码转换为错误字符串。
            禁用此配置可以节省一些代码/只读数据大小，因为错误字符串转换实现将被替换为空存根。

    config MBEDTLS_USE_CRYPTO_ROM_IMPL
        bool "使用ROM中的加密算法实现"
        depends on ESP_ROM_HAS_MBEDTLS_CRYPTO_LIB && IDF_EXPERIMENTAL_FEATURES
        default "n"
        select MBEDTLS_SHA512_C
        select MBEDTLS_AES_C
        select MBEDTLS_CCM_C
        select MBEDTLS_ROM_MD5
        select MBEDTLS_HARDWARE_SHA
        help
            启用此标志以使用ROM中的mbedtls加密算法而不是ESP-IDF中的算法。

            此配置选项可以在应用程序二进制文件中节省闪存占用。
            请注意，ROM中的mbedtls加密算法库版本为v2.16.12。
            我们已经对ROM中的mbedtls修订版（v2.16.12）进行了安全分析，
            并确保受影响的符号已被修补（移除）。如果在未来的mbedtls修订版中
            出现也影响ROM版本（v2.16.12）的安全问题，我们将修补相关符号。
            这将增加闪存占用，因此必须注意在闪存布局中为应用程序二进制文件保留一些空间。

endmenu  # mbedTLS
```
