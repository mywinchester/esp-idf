## components/freertos/Kconfig
```kconfig
menu "FreeRTOS"

    menu "内核"
        # Upstream FreeRTOS configurations go here


        config FREERTOS_SMP
            bool "运行Amazon SMP FreeRTOS内核（功能开发中）"
            depends on !IDF_TARGET_ESP32P4 #TODO: IDF-8113: Enable P4 support on AMZ SMP
            default  "n"
            help
                Amazon发布了FreeRTOS内核的SMP版本，可以通过以下链接找到：
                https://github.com/FreeRTOS/FreeRTOS-Kernel/tree/smp

                IDF已经添加了这个SMP内核的实验性移植，位于
                components/freertos/FreeRTOS-Kernel-SMP。启用此选项将导致IDF使用Amazon SMP
                内核。请注意，此功能正在积极开发中，用户使用时需自担风险。

                禁用此选项将使用IDF FreeRTOS内核，该内核位于：
                components/freertos/FreeRTOS-Kernel。两个内核版本都支持SMP，但在
                实现和功能上有所不同。

        config FREERTOS_UNICORE
            # Todo: Replace with CONFIG_NUMBER_OF_CORES (IDF-9156)
            bool "仅在第一个核心上运行FreeRTOS"
            default "y" if IDF_TARGET_ESP32S2 || IDF_TARGET_LINUX
            select ESP_SYSTEM_SINGLE_CORE_MODE
            help
                FreeRTOS的这个版本通常控制CPU的所有核心。如果你只想
                在第一个核心上启动它，请选择此选项。当例如另一个进程需要完全控制
                第二个核心时，这是必需的。

        config FREERTOS_HZ
            # Todo: Rename to CONFIG_FREERTOS_TICK_RATE_HZ (IDF-4986)
            int "configTICK_RATE_HZ"
            range 1 1000
            default 100
            help
                设置FreeRTOS的tick中断频率，单位为Hz（有关更多
                详细信息，请参阅configTICK_RATE_HZ文档）。

        config FREERTOS_OPTIMIZED_SCHEDULER
            # Todo: Not available in SMP FREERTOS (IDF-3733)
            bool "configUSE_PORT_OPTIMISED_TASK_SELECTION"
            depends on FREERTOS_UNICORE && !FREERTOS_SMP
            default y
            help
                启用特定于端口的任务选择方法。此选项可以加速在调度时
                搜索就绪任务的速度（有关更多详细信息，请参阅configUSE_PORT_OPTIMISED_TASK_SELECTION文档）。

        choice FREERTOS_CHECK_STACKOVERFLOW
            prompt "configCHECK_FOR_STACK_OVERFLOW"
            default FREERTOS_CHECK_STACKOVERFLOW_CANARY
            help
                启用FreeRTOS检查栈溢出（有关更多详细信息，请参阅configCHECK_FOR_STACK_OVERFLOW文档）。

                注意：如果用户没有提供自己的``vApplicationStackOverflowHook()``函数，ESP-IDF
                将提供一个默认函数。

            config FREERTOS_CHECK_STACKOVERFLOW_NONE
                bool "不检查"
                help
                    不检查栈溢出（configCHECK_FOR_STACK_OVERFLOW = 0）

            config FREERTOS_CHECK_STACKOVERFLOW_PTRVAL
                bool "通过栈指针值检查（方法1）"
                help
                    通过检查栈指针是否在有效范围内，在每次上下文切换时检查栈溢出。
                    快速但无法检测上下文切换之间发生的栈溢出
                    (configCHECK_FOR_STACK_OVERFLOW = 1)

            config FREERTOS_CHECK_STACKOVERFLOW_CANARY
                bool "使用canary字节检查（方法2）"
                help
                    在栈区域的末尾放置一些魔术字节，并在每次上下文切换时检查这些
                    字节是否仍然完整。比仅检查指针更彻底，但也稍慢一些。
                    (configCHECK_FOR_STACK_OVERFLOW = 2)
        endchoice # FREERTOS_CHECK_STACKOVERFLOW

        config FREERTOS_THREAD_LOCAL_STORAGE_POINTERS
            int "configNUM_THREAD_LOCAL_STORAGE_POINTERS"
            range 1 256
            default 1
            help
                设置每个任务中线程本地存储指针的数量（有关更多详细信息，
                请参阅configNUM_THREAD_LOCAL_STORAGE_POINTERS文档）。

                注意：在ESP-IDF中，此值必须至少为1。索引0保留给pthreads API
                线程本地存储使用。其他索引可用于任何所需的目的。

        config FREERTOS_IDLE_TASK_STACKSIZE
            int "configMINIMAL_STACK_SIZE（空闲任务栈大小）"
            range 768 32768
            default 1536
            help
                设置空闲任务栈大小，单位为字节（有关更多详细信息，请参阅configMINIMAL_STACK_SIZE文档）。

                注意：

                - ESP-IDF以字节而不是字为单位指定栈大小。
                - 默认大小足以满足大多数用例。
                - 如果应用程序安装了使用大量栈内存的空闲或线程本地
                  存储清理钩子，可能需要增加栈大小。
                - 相反，如果不使用任何空闲功能，可以将栈大小减小到最小。

        config FREERTOS_USE_IDLE_HOOK
            bool "configUSE_IDLE_HOOK"
            default n
            help
                启用空闲任务应用程序钩子（有关更多详细信息，请参阅configUSE_IDLE_HOOK文档）。

                注意：

                - 应用程序必须提供钩子函数 ``void vApplicationIdleHook( void );``
                - ``vApplicationIdleHook()`` 从FreeRTOS空闲任务调用
                - FreeRTOS空闲钩子与ESP-IDF空闲钩子不同，但两者可以同时启用。

        config FREERTOS_USE_PASSIVE_IDLE_HOOK
            bool "使用FreeRTOS最小空闲钩子"
            depends on FREERTOS_SMP
            default n
            help
                启用最小空闲任务应用程序钩子（有关更多详细信息，请参阅configUSE_IDLE_HOOK文档）。

                注意：

                - 应用程序必须提供钩子函数 ``void vApplicationPassiveIdleHook( void );``
                - ``vApplicationPassiveIdleHook()`` 从FreeRTOS最小空闲任务调用

        config FREERTOS_USE_TICK_HOOK
            bool "configUSE_TICK_HOOK"
            default n
            help
                启用tick钩子（有关更多详细信息，请参阅configUSE_TICK_HOOK文档）。

                注意：

                - 应用程序必须提供钩子函数 ``void vApplicationTickHook( void );``
                - ``vApplicationTickHook()`` 从FreeRTOS的tick处理函数 ``xTaskIncrementTick()`` 调用
                - FreeRTOS tick钩子与ESP-IDF Tick中断钩子不同，但两者可以同时启用。

        config FREERTOS_MAX_TASK_NAME_LEN
            int "configMAX_TASK_NAME_LEN"
            range 1 256
            default 16
            help
                设置任务名称的最大字符数（有关更多详细信息，请参阅configMAX_TASK_NAME_LEN文档）。

                注意：对于大多数用途，默认的16个字符就足够了。

        config FREERTOS_ENABLE_BACKWARD_COMPATIBILITY
            bool "configENABLE_BACKWARD_COMPATIBILITY"
            default n
            depends on !IDF_TARGET_LINUX
            help
                启用与FreeRTOS v8.0.0之前的API的向后兼容性。（有关更多详细信息，
                请参阅configENABLE_BACKWARD_COMPATIBILITY文档）。

        config FREERTOS_TIMER_SERVICE_TASK_NAME
            string "configTIMER_SERVICE_TASK_NAME"
            default "Tmr Svc"
            help
                设置定时器任务的名称（有关更多详细信息，请参阅configTIMER_SERVICE_TASK_NAME文档）。

        choice FREERTOS_TIMER_SERVICE_TASK_CORE_AFFINITY
            prompt "configTIMER_SERVICE_TASK_CORE_AFFINITY"
            default FREERTOS_TIMER_TASK_NO_AFFINITY
            help
                设置定时器任务的核心亲和性
                （有关更多详细信息，请参阅configTIMER_SERVICE_TASK_CORE_AFFINITY文档）。

            config FREERTOS_TIMER_TASK_AFFINITY_CPU0
                bool "CPU0"
            config FREERTOS_TIMER_TASK_AFFINITY_CPU1
                bool "CPU1"
                depends on !FREERTOS_UNICORE
            config FREERTOS_TIMER_TASK_NO_AFFINITY
                bool "无亲和性"
        endchoice

        config FREERTOS_TIMER_SERVICE_TASK_CORE_AFFINITY
            hex
            default 0x0 if FREERTOS_TIMER_TASK_AFFINITY_CPU0
            default 0x1 if FREERTOS_TIMER_TASK_AFFINITY_CPU1
            default FREERTOS_NO_AFFINITY if FREERTOS_TIMER_TASK_NO_AFFINITY

        config FREERTOS_TIMER_TASK_PRIORITY
            int "configTIMER_TASK_PRIORITY"
            range 1 25
            default 1
            help
                设置定时器任务的优先级（有关更多详细信息，请参阅configTIMER_TASK_PRIORITY文档）。

        config FREERTOS_TIMER_TASK_STACK_DEPTH
            int "configTIMER_TASK_STACK_DEPTH"
            range 1536 32768
            default 2053 if IDF_TARGET_LINUX
            default 2048
            help
                设置定时器任务的栈大小（有关更多详细信息，请参阅configTIMER_TASK_STACK_DEPTH文档）。

        config FREERTOS_TIMER_QUEUE_LENGTH
            int "configTIMER_QUEUE_LENGTH"
            range 5 20
            default 10
            help
                设置定时器任务的命令队列长度（有关更多详细信息，请参阅configTIMER_QUEUE_LENGTH文档）。

        config FREERTOS_QUEUE_REGISTRY_SIZE
            int "configQUEUE_REGISTRY_SIZE"
            range 0 20
            default 0
            help
                设置队列注册表的大小（有关更多详细信息，请参阅configQUEUE_REGISTRY_SIZE文档）。

                注意：值为0将禁用队列注册表功能

        config FREERTOS_TASK_NOTIFICATION_ARRAY_ENTRIES
            int "configTASK_NOTIFICATION_ARRAY_ENTRIES"
            range 1 32
            default 1
            help
                设置每个任务的任务通知数组的大小。增加此值时，请记住这意味着系统上每个任务都需要额外的内存。
                然而，与诸如信号量等替代方案相比，任务通知通常更轻量级。

        config FREERTOS_USE_TRACE_FACILITY
            bool "configUSE_TRACE_FACILITY"
            default n
            help
                启用额外的结构成员和函数，以协助执行可视化和跟踪
                （有关更多详细信息，请参阅configUSE_TRACE_FACILITY文档）。

        config FREERTOS_USE_STATS_FORMATTING_FUNCTIONS
            bool "configUSE_STATS_FORMATTING_FUNCTIONS"
            depends on FREERTOS_USE_TRACE_FACILITY
            default n
            help
                将configUSE_TRACE_FACILITY和configUSE_STATS_FORMATTING_FUNCTIONS设置为1，以在构建中包含
                ``vTaskList()``和``vTaskGetRunTimeStats()``函数（有关更多详细信息，请参阅
                configUSE_STATS_FORMATTING_FUNCTIONS文档）。

        config FREERTOS_USE_LIST_DATA_INTEGRITY_CHECK_BYTES
            bool "configUSE_LIST_DATA_INTEGRITY_CHECK_BYTES"
            #TODO: Enable by default for debug builds (IDF-8517)
            default n
            help
                启用列表完整性检查器
                （有关更多详细信息，请参阅configUSE_LIST_DATA_INTEGRITY_CHECK_BYTES文档）。

        config FREERTOS_VTASKLIST_INCLUDE_COREID
            # Core affinity is supported in stats for Amazon FreeRTOS SMP by default
            bool "在vTaskList中启用xCoreID显示"
            depends on !FREERTOS_SMP && FREERTOS_USE_STATS_FORMATTING_FUNCTIONS
            default n
            help
                如果启用，当调用vTaskList时，将包含一个额外的列来显示任务固定的CoreID（0,1）或-1（如果未固定）。

        config FREERTOS_GENERATE_RUN_TIME_STATS
            bool "configGENERATE_RUN_TIME_STATS"
            default n
            select FREERTOS_USE_TRACE_FACILITY
            select FREERTOS_USE_STATS_FORMATTING_FUNCTIONS
            help
                启用每个任务的运行时统计信息收集（有关更多详细信息，请参阅configGENERATE_RUN_TIME_STATS文档）。

                注意：用于运行时统计的时钟可以在FREERTOS_RUN_TIME_STATS_CLK中配置。

        choice FREERTOS_RUN_TIME_COUNTER_TYPE
            prompt "configRUN_TIME_COUNTER_TYPE"
            depends on FREERTOS_GENERATE_RUN_TIME_STATS && !FREERTOS_SMP
            default FREERTOS_RUN_TIME_COUNTER_TYPE_U32
            help
                设置FreeRTOS运行时统计使用的数据类型。可以使用更大的数据类型来减少计数器溢出的频率。

            config FREERTOS_RUN_TIME_COUNTER_TYPE_U32
                bool "uint32_t"
                help
                    configRUN_TIME_COUNTER_TYPE设置为uint32_t

            config FREERTOS_RUN_TIME_COUNTER_TYPE_U64
                bool "uint64_t"
                help
                    configRUN_TIME_COUNTER_TYPE设置为uint64_t
        endchoice # FREERTOS_RUN_TIME_COUNTER_TYPE
        config FREERTOS_USE_TICKLESS_IDLE
            # Todo: Currently not supported in SMP FreeRTOS yet (IDF-4986)
            # Todo: Consider whether this option should still be exposed (IDF-4986)
            bool "配置使用无滴答空闲"
            depends on PM_ENABLE
            default n
            help
                如果启用了电源管理支持，FreeRTOS将能够在一定数量的滴答时间内没有任务需要运行时将系统置于轻度睡眠模式。
                这个数量可以使用FREERTOS_IDLE_TIME_BEFORE_SLEEP选项设置。这个功能也被称为"自动轻度睡眠"。

                注意，使用esp_timer API创建的定时器可能会阻止系统进入睡眠模式，即使没有任务需要运行。
                为了跳过不必要的唤醒，可以在初始化定时器时将"skip_unhandled_events"选项设置为true。

                如果禁用，自动轻度睡眠支持将被禁用。

        config FREERTOS_IDLE_TIME_BEFORE_SLEEP
            # Todo: Rename to CONFIG_FREERTOS_EXPECTED_IDLE_TIME_BEFORE_SLEEP (IDF-4986)
            int "进入睡眠前的空闲时间"
            depends on FREERTOS_USE_TICKLESS_IDLE
            default 3
            range 2 4294967295
            # Minimal value is 2 because of a check in FreeRTOS.h (search configEXPECTED_IDLE_TIME_BEFORE_SLEEP)
            help
                如果没有任务需要运行这个数量的滴答数，FreeRTOS将进入轻度睡眠模式。
                您可以在esp_pm组件中启用PM_PROFILING功能，并使用esp_pm_dump_locks
                转储睡眠状态。如果被拒绝的睡眠比例过高，请增加此值以提高调度效率。

        config FREERTOS_USE_APPLICATION_TASK_TAG
            bool "使用应用程序任务标签"
            default n
            help
                启用任务标记功能及其相关API（有关更多详细信息，请参阅configUSE_APPLICATION_TASK_TAG文档）。

    endmenu # Kernel
    menu "端口"
        # ESP-IDF FreeRTOS port configurations go here (and HW configurations related to FreeRTOS)

        config FREERTOS_TASK_FUNCTION_WRAPPER
            bool "包装任务函数"
            #TODO: Check if FreeRTOS Task Wrapper must depend on GDBStub (IDF-9505)
            depends on COMPILER_OPTIMIZATION_DEBUG || ESP_COREDUMP_ENABLE \
                || ESP_SYSTEM_PANIC_GDBSTUB || ESP_SYSTEM_GDBSTUB_RUNTIME
            default y
            help
                如果启用，所有FreeRTOS任务函数将被封装在一个包装函数中。如果任务函数错误地返回（即没有删除），
                调用流程将返回到包装函数。包装函数随后将记录一个错误并中止应用程序。此选项也是GDB回溯和C++异常
                在顶层任务函数中正确工作所必需的。

        config FREERTOS_WATCHPOINT_END_OF_STACK
            bool "启用堆栈溢出调试监视点"
            default n
            help
                FreeRTOS可以通过检查堆栈指针的值或检查金丝雀字节的完整性来检查堆栈是否溢出其边界。
                （有关更多信息，请参阅FREERTOS_CHECK_STACKOVERFLOW。）这些检查仅在上下文切换时发生，
                而导致堆栈溢出的情况可能在那时已经消失很久了。此选项将使用最后一个调试内存监视点，
                以便在任务堆栈的最后32个字节中的任何一个被覆盖时立即中断调试器（或引发panic）。
                副作用是使用gdb时，您实际上少了一个硬件监视点，因为最后一个监视点在任务切换发生时
                会被覆盖。

                另一个后果是由于监视点的对齐要求，可用的堆栈大小减少了多达60字节。这是因为监视点
                区域必须与其大小对齐，而IDF中堆栈监视点的大小为32字节。

                此检查仅在堆栈溢出写入堆栈末尾附近32字节内时触发，而不是进一步溢出，因此值得将此
                方法与其他堆栈溢出检查方法结合使用。

                当触发此监视点时，gdb将停止并显示SIGTRAP消息。当没有连接JTAG OCD时，esp-idf将在
                未处理的调试异常上引发panic。

        config FREERTOS_TLSP_DELETION_CALLBACKS
            bool "启用线程本地存储指针删除回调"
            depends on (FREERTOS_THREAD_LOCAL_STORAGE_POINTERS > 0)
            default y
            help
                ESP-IDF为用户提供了通过注册TLSP删除回调来释放TLSP内存的能力。当任务被删除时，
                FreeRTOS会自动调用这些回调。当启用此选项时，TCB中为TLSP保留的内存将翻倍，以便
                为存储删除回调腾出空间。如果用户不希望使用TLSP删除回调，则可以关闭此选项以节省
                TCB内存中的空间。

        config FREERTOS_TASK_PRE_DELETION_HOOK
            # This option is a replacement for FREERTOS_ENABLE_STATIC_TASK_CLEAN_UP (which is now deprecated). If the
            # deprecated option is defined, we hide this option to avoid multiple pre-deletion hooks from running.
            bool "启用任务预删除钩子"
            depends on !FREERTOS_ENABLE_STATIC_TASK_CLEAN_UP
            default n
            help
                启用此选项可使FreeRTOS在删除任务（即释放/释放动态/静态分配的任务内存）之前调用
                用户提供的钩子函数。如果用户想知道任务何时实际被删除（以防任务的删除被委托给
                IDLE任务），这很有用。

                如果启用此配置选项，用户必须在其应用程序中定义一个
                ``void vTaskPreDeletionHook( void * pxTCB )``钩子函数。

        config FREERTOS_ENABLE_STATIC_TASK_CLEAN_UP
            # This option is deprecated (replaced by FREERTOS_TASK_PRE_DELETION_HOOK) but still exists to maintain
            # compatibility. Todo: Remove by v6.0 (see IDF-8097).
            bool "启用静态任务清理钩子（已弃用）"
            default n
            help
                此选项已弃用。请使用FREERTOS_TASK_PRE_DELETION_HOOK代替。

                启用此选项可使FreeRTOS在删除任务时调用静态任务清理钩子。

                注意：用户需要提供一个``void vPortCleanUpTCB ( void *pxTCB )``回调

        config FREERTOS_CHECK_MUTEX_GIVEN_BY_OWNER
            # This feature is innately supported in FreeRTOS SMP, and hence not available as a config option when
            # FreeRTOS SMP is enabled.
            depends on !FREERTOS_SMP
            bool "检查互斥信号量是否由所有者任务释放"
            default y
            help
                如果启用，当互斥信号量被释放时，将断言释放信号量的任务是当前持有该互斥量的任务。

        config FREERTOS_ISR_STACKSIZE
            int "ISR 堆栈大小"
            range 2096 32768 if ESP_COREDUMP_DATA_FORMAT_ELF
            default 2096 if ESP_COREDUMP_DATA_FORMAT_ELF
            range 1536 32768
            default 1536
            help
                中断处理程序有自己的堆栈。可以在这里定义堆栈的大小。每个处理器都有自己的堆栈，
                因此占用的总大小将是这个值的两倍。

        config FREERTOS_INTERRUPT_BACKTRACE
            # Todo: Consider removing this. Not sure when users will ever want it to be disabled (IDF-4986)
            bool "启用从中断到任务上下文的回溯"
            default y
            help
                如果启用此选项，中断堆栈帧将被修改，以将被中断任务的代码指向为其返回地址。
                这有助于调试器（或panic处理程序）显示从中断到被中断任务的回溯。这也适用于
                嵌套中断：可以从高级中断堆栈回溯到低级中断。此选项会在中断调度代码中添加4条指令。

        config FREERTOS_FPU_IN_ISR
            bool "在1级ISR中使用浮点数"
            depends on IDF_TARGET_ESP32
            default n
            help
                启用后，允许在1级ISR中使用浮点类型。请注意，在更高级别的中断中仍然不允许使用浮点类型。

        config FREERTOS_TICK_SUPPORT_CORETIMER
            bool
            default y if IDF_TARGET_ESP32 || IDF_TARGET_ESP32S2

        config FREERTOS_TICK_SUPPORT_SYSTIMER
            bool
            default y if !FREERTOS_TICK_SUPPORT_CORETIMER
            # All targets except ESP32 and ESP32S2 can use Systimer for FreeRTOS SysTick
            # ESP32S2 also has SYSTIMER but it can not be used for the FreeRTOS SysTick because:
            # - It has only one counter, which already in use esp_timer.
            #   A counter for SysTick should be stall in debug mode but work esp_timer.
            # - It is not possible to allocate two handlers for esp_timer and SysTick.

        choice FREERTOS_CORETIMER
            prompt "滴答定时器源（仅限Xtensa）"
            default FREERTOS_CORETIMER_0 if FREERTOS_TICK_SUPPORT_CORETIMER
            default FREERTOS_CORETIMER_SYSTIMER_LVL1 if FREERTOS_TICK_SUPPORT_SYSTIMER
            help
                FreeRTOS需要一个带有相关中断的定时器作为主要的滴答源，用于增加计数器、
                运行定时器和进行抢占式多任务处理。有多个定时器可用于此目的，具有不同的中断优先级。

            config FREERTOS_CORETIMER_0
                bool "定时器 0（中断 6，级别 1）"
                depends on FREERTOS_TICK_SUPPORT_CORETIMER
                help
                    选择此项以使用定时器 0

            config FREERTOS_CORETIMER_1
                bool "定时器 1（中断 15，级别 3）"
                depends on FREERTOS_TICK_SUPPORT_CORETIMER
                help
                    选择此项以使用定时器 1

            config FREERTOS_CORETIMER_SYSTIMER_LVL1
                bool "SYSTIMER 0（级别 1）"
                depends on FREERTOS_TICK_SUPPORT_SYSTIMER
                help
                    选择此项以使用具有1级中断优先级的系统定时器。

            config FREERTOS_CORETIMER_SYSTIMER_LVL3
                bool "SYSTIMER 0（级别 3）"
                depends on FREERTOS_TICK_SUPPORT_SYSTIMER
                help
                    选择此项以使用具有3级中断优先级的系统定时器。

        endchoice # FREERTOS_CORETIMER

        config FREERTOS_SYSTICK_USES_SYSTIMER
            bool
            default y if FREERTOS_CORETIMER_SYSTIMER_LVL1 || FREERTOS_CORETIMER_SYSTIMER_LVL3
            select ESP_SLEEP_SYSTIMER_STALL_WORKAROUND if IDF_TARGET_ESP32C3

        config FREERTOS_SYSTICK_USES_CCOUNT
            bool
            default y if FREERTOS_CORETIMER_0 || FREERTOS_CORETIMER_1

        choice FREERTOS_RUN_TIME_STATS_CLK
            prompt "选择运行时统计的时钟源"
            depends on FREERTOS_GENERATE_RUN_TIME_STATS
            default FREERTOS_RUN_TIME_STATS_USING_ESP_TIMER
            help
                为FreeRTOS运行时统计选择时钟源。选项包括CPU0的CPU时钟或ESP定时器。
                两种时钟源都是32位的。CPU时钟可以以更高的频率运行，因此提供更精细的
                分辨率，但会更快溢出。请注意，运行时统计仅在时钟源溢出之前有效。

            config FREERTOS_RUN_TIME_STATS_USING_ESP_TIMER
                bool "使用ESP定时器进行运行时统计"
                help
                    ESP定时器将用作FreeRTOS运行时统计的时钟源。ESP定时器的运行频率为1MHz，
                    不受动态频率缩放的影响。因此，ESP定时器将在大约4290秒后溢出。

            config FREERTOS_RUN_TIME_STATS_USING_CPU_CLK
                # Todo: This should be disabled for multi-core due to different CCOUNTs (IDF-4986)
                bool "使用CPU时钟进行运行时统计"
                depends on FREERTOS_SYSTICK_USES_CCOUNT
                help
                    CPU时钟将用作生成运行时统计的时钟源。CPU时钟的频率取决于ESP_DEFAULT_CPU_FREQ_MHZ
                    和动态频率缩放（DFS）。因此，CPU时钟频率可能在80到240MHz之间波动。使用CPU时钟
                    生成的运行时统计表示分配给每个任务的CPU周期数，并不反映每个任务运行的时间
                    （因为CPU时钟频率可能会改变）。如果CPU时钟始终以240MHz的最大频率运行，
                    它将在大约17秒后溢出。

            config FREERTOS_RUN_TIME_STATS_USING_CPU_CLK
                # Todo: This should be disabled for multi-core due to different CCOUNTs (IDF-4986)
                bool "使用CPU时钟进行运行时统计"
                depends on FREERTOS_SYSTICK_USES_CCOUNT
                help
                    CPU时钟将用作生成运行时统计的时钟源。CPU时钟的频率取决于ESP_DEFAULT_CPU_FREQ_MHZ
                    和动态频率缩放（DFS）。因此，CPU时钟频率可能在80到240MHz之间波动。使用CPU时钟
                    生成的运行时统计表示分配给每个任务的CPU周期数，而不反映每个任务运行的时间
                    （因为CPU时钟频率可能会改变）。如果CPU时钟始终以240MHz的最大频率运行，
                    它将在大约17秒后溢出。
        endchoice # FREERTOS_RUN_TIME_STATS_CLK

        config FREERTOS_PLACE_FUNCTIONS_INTO_FLASH
            bool "将FreeRTOS函数放入Flash"
            default n
            help
                启用后，选定的非ISR FreeRTOS函数将被放置到Flash内存中，而不是IRAM中。
                这可以根据使用的函数节省多达8KB的IRAM。

        config FREERTOS_CHECK_PORT_CRITICAL_COMPLIANCE
            # Todo: Check if we still need this (IDF-4986)
            bool "测试与原生FreeRTOS port*_CRITICAL调用的兼容性"
            default n
            help
                如果启用，将检查port*_CRITICAL调用的上下文（ISR或非ISR）是否符合
                原生FreeRTOS。例如，从ISR上下文调用port*_CRITICAL将导致断言失败。

    endmenu # Port

    # Hidden or compatibility options

    config FREERTOS_PORT
        # This invisible config value indicates the FreeRTOS is selected as the current RTOS used by ESP-IDF
        bool
        default y

    config FREERTOS_NO_AFFINITY
        # This invisible config value sets the value of tskNO_AFFINITY in task.h.
        # Intended to be used as a constant from other Kconfig files.
        # Value is (32-bit) INT_MAX.
        hex
        default 0x7FFFFFFF if !FREERTOS_SMP
        default 0xFFFFFFFF if FREERTOS_SMP

    config FREERTOS_SUPPORT_STATIC_ALLOCATION
        # Always enabled. Kconfig option preserved for compatibility with code which checked for
        # CONFIG_FREERTOS_SUPPORT_STATIC_ALLOCATION.
        # Todo: Check if we still need this (IDF-4986)
        bool
        default y

    config FREERTOS_DEBUG_OCDAWARE
        bool
        help
            隐藏选项，由CONFIG_ESP_DEBUG_OCDAWARE选择

    config FREERTOS_ENABLE_TASK_SNAPSHOT
        # Invisible option that is always enabled. Task Snapshot APIs are now private thus are always enabled. This
        # option is kept here in case any user code conditionally depends on this option.
        # Todo: Remove in v6.0 (IDF-8143)
        bool
        default y

    config FREERTOS_PLACE_SNAPSHOT_FUNS_INTO_FLASH
        # Invisible option that is always enabled. Task Snapshot APIs are now private API thus are always placed into
        # flash by default. This option is kept here in case any user code conditionally depends on this option.
        # Todo: Remove in v6.0 (IDF-8143)
        bool
        default y
        depends on !ESP_PANIC_HANDLER_IRAM

    config FREERTOS_NUMBER_OF_CORES
        # Invisible option to configure the number of cores on which FreeRTOS runs
        # Todo: Unhide this option and deprecate CONFIG_FREERTOS_UNICORE (IDF-9156)
        int
        range 1 2
        default 1 if FREERTOS_UNICORE
        default 2 if !FREERTOS_UNICORE

endmenu # FreeRTOS
```
